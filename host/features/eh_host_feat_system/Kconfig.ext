## host/features/eh_host_feat_wifi/Kconfig.ext
```kconfig
menuconfig ESP_HOSTED_HOST_FEAT_WIFI
	bool "WiFi"
	default y if ESP_WIFI_REMOTE_LIBRARY_HOSTED
	default n
	depends on ESP_HOSTED_HOST && ESP_HOSTED_HOST_FEAT_RPC
	depends on ESP_HOSTED_HOST_FEAT_RPC_EXT_V2_READY
	help
	  Host-side driver for the coprocessor's Wi-Fi stack: connect /
	  scan / AP-mode RPCs + Wi-Fi events on the port event bus.

if ESP_HOSTED_HOST_FEAT_WIFI

	config ESP_HOSTED_HOST_FEAT_WIFI_AUTO_INIT
		bool "Auto-initialize Wi-Fi feature at boot"
		default y
		depends on ESP_HOSTED_HOST_AUTO_FEAT_INIT
		help
		  Run eh_host_feat_wifi_init() from the auto-init walk.

	config ESP_HOSTED_HOST_WIFI_SCAN_BLOCK_TIMEOUT_MS
		int "Blocking scan RPC timeout (ms)"
		default 30000
		range 5000 120000
		help
		  esp_wifi_scan_start(cfg, block=true) returns only after the
		  CP's scan completes; a dual-band sweep can take ~10 s, far
		  past the default sync-RPC timeout. Applied to blocking scans
		  only — a non-blocking scan keeps the default timeout.

	config ESP_HOSTED_HOST_FEAT_WIFI_DECODE_RESERVED_FIELD
		bool "Decode Wi-Fi reserved fields"
		default n
		help
		  Preserve reserved bit fields for strict wire compatibility.

	config ESP_HOSTED_HOST_FEAT_WIFI_STA_AUTO_CONNECT_ON_START
		bool "Auto-call esp_wifi_connect() on WIFI_EVENT_STA_START"
		default n
		help
		  Host auto-connects on STA_START.

	config ESP_HOSTED_HOST_FEAT_WIFI_STA_AUTO_RECONNECT_ON_DISCONNECT
		bool "Auto-call esp_wifi_connect() on WIFI_EVENT_STA_DISCONNECTED"
		default n
		help
		  Host auto-reconnects on STA_DISCONNECTED.

	# Wi-Fi extensions nest here so menuconfig shows them under Wi-Fi.
	orsource "../eh_host_feat_wifi_ext_ent/Kconfig.ext"
	orsource "../eh_host_feat_wifi_ext_itwt/Kconfig.ext"
	orsource "../eh_host_feat_wifi_ext_dpp/Kconfig.ext"

endif # ESP_HOSTED_HOST_FEAT_WIFI

config ESP_HOSTED_HOST_FEAT_WIFI_READY
	bool
	default y if ESP_HOSTED_HOST_FEAT_WIFI && ESP_HOSTED_HOST_FEAT_RPC_READY && ESP_HOSTED_HOST_FEAT_RPC_EXT_V2_READY
```

## host/features/eh_host_feat_wifi_ext_dpp/Kconfig.ext
```kconfig
menuconfig ESP_HOSTED_HOST_FEAT_WIFI_EXT_DPP
	bool "WiFi DPP"
	default n
	depends on ESP_HOSTED_HOST_FEAT_WIFI
	depends on ESP_HOSTED_HOST_FEAT_RPC_EXT_V2_READY
	help
	  Host-side mirror of coprocessor/features/eh_cp_feat_wifi_ext_dpp.
	  Provides typed C wrappers for the 5 DPP RPCs (Init, Deinit,
	  BootstrapGen for QR-code bootstrap, StartListen, StopListen);
	  request entry points live in eh_host_wifi_dpp.h with
	  upstream-aligned signatures.
	  Cap-bit + Kconfig wire the feature into the auto-init walk.

## Lifecycle is owned by the parent Wi-Fi feature
## (eh_host_feat_wifi_init/deinit drives this ext's init/deinit).
## No standalone auto-init knob — the parent's auto-init covers it.

if ESP_HOSTED_HOST_FEAT_WIFI_EXT_DPP
	config ESP_HOSTED_HOST_FEAT_WIFI_EXT_DPP_URI_LEN_MAX
		int "Max DPP URI length"
		default 255
		range 32 2048
		help
		  Maximum URI length accepted for DPP bootstrap QR payloads.
endif

config ESP_HOSTED_HOST_FEAT_WIFI_EXT_DPP_READY
	bool
	default y if ESP_HOSTED_HOST_FEAT_WIFI_EXT_DPP && ESP_HOSTED_HOST_FEAT_WIFI_READY
```

## host/features/eh_host_feat_wifi_ext_ent/Kconfig.ext
```kconfig
menuconfig ESP_HOSTED_HOST_FEAT_WIFI_EXT_ENT
	bool "WiFi Enterprise"
	default n
	depends on ESP_HOSTED_HOST_FEAT_WIFI
	depends on ESP_HOSTED_HOST_FEAT_RPC_EXT_V2_READY
	help
	  Host-side mirror of coprocessor/features/eh_cp_feat_wifi_ext_ent.
	  Provides typed C wrappers (eh_host_feat_wifi_ext_ent.h) for the
	  23 RPCs under the Enterprise / EAP umbrella
	  (gen_v2.h: RpcReqEap* + RpcReqWifiStaEnterprise*):

	    - lifecycle:    eh_host_wifi_sta_enterprise_{enable,disable}
	    - credentials:  eh_host_wifi_sta_eap_{set,clear}_{identity,
	                    username,password,new_password,ca_cert}
	    - cert + key:   eh_host_wifi_sta_eap_{set,clear}_certificate_and_key
	    - flags:        eh_host_wifi_sta_eap_set_disable_time_check,
	                    set_ttls_phase2_method,
	                    set_suiteb_192bit_certification,
	                    set_pac_file, set_fast_params,
	                    use_default_cert_bundle,
	                    set_domain_name, set_eap_methods

	  Each blob-accepting setter copies the caller's buffer
	  immediately; callers may free/reuse the original on return.
	  set/clear pairs always release the matching CP-side state.

## Lifecycle is owned by the parent Wi-Fi feature
## (eh_host_feat_wifi_init/deinit drives this ext's init/deinit).
## No standalone auto-init knob — the parent's auto-init covers it.

config ESP_HOSTED_HOST_FEAT_WIFI_EXT_ENT_READY
	bool
	default y if ESP_HOSTED_HOST_FEAT_WIFI_EXT_ENT && ESP_HOSTED_HOST_FEAT_WIFI_READY
```

## host/features/eh_host_feat_wifi_ext_itwt/Kconfig.ext
```kconfig
menuconfig ESP_HOSTED_HOST_FEAT_WIFI_EXT_ITWT
	bool "WiFi iTWT"
	default n
	depends on ESP_HOSTED_HOST_FEAT_WIFI
	depends on ESP_HOSTED_HOST_FEAT_RPC_EXT_V2_READY
	help
	  Host-side mirror of coprocessor/features/eh_cp_feat_wifi_ext_itwt.
	  Provides typed C wrappers (eh_host_feat_wifi_ext_itwt.h) for the
	  6 iTWT RPCs:

	    - eh_host_wifi_sta_itwt_setup       (TWT agreement setup;
	                                         packed bitmask_1 carries
	                                         trigger / flow_type /
	                                         flow_id / wake_invl_expn /
	                                         wake_duration_unit)
	    - eh_host_wifi_sta_itwt_teardown
	    - eh_host_wifi_sta_itwt_suspend
	    - eh_host_wifi_sta_itwt_send_probe_req
	    - eh_host_wifi_sta_itwt_set_target_wake_time_offset
	    - eh_host_wifi_sta_itwt_get_flow_id_status (active-flow bitmap)

	  Subscribes to the 4 iTWT events (StaItwtSetup / Teardown /
	  Suspend / Probe; IDs 778-781) and dispatches them via
	  eh_host_wifi_sta_itwt_on_{setup,teardown,suspend,probe} (single
	  callback slot per event; passing NULL clears the slot but leaves
	  the internal handler registered so the RX worker keeps draining).

## Lifecycle is owned by the parent Wi-Fi feature
## (eh_host_feat_wifi_init/deinit drives this ext's init/deinit).
## No standalone auto-init knob — the parent's auto-init covers it.

config ESP_HOSTED_HOST_FEAT_WIFI_EXT_ITWT_READY
	bool
	default y if ESP_HOSTED_HOST_FEAT_WIFI_EXT_ITWT && ESP_HOSTED_HOST_FEAT_WIFI_READY
```

## host/linux/eh_host_linux_vserial/Kconfig.ext
```kconfig
config ESP_HOSTED_HOST_VSERIAL_LINUX
	bool
	default y if ESP_HOSTED_HOST_TYPE_POSIX
	default n
	depends on ESP_HOSTED_HOST

config ESP_HOSTED_HOST_VSERIAL_LINUX_READY
	bool
	default y if ESP_HOSTED_HOST_VSERIAL_LINUX
```

## host/mcu/eh_host_mcu_transport/Kconfig.ext
```kconfig
config ESP_HOSTED_HOST_TRANSPORT_MCU
	bool
	default y if ESP_HOSTED_HOST_TYPE_MCU
	default n
	depends on ESP_HOSTED_HOST

config ESP_HOSTED_HOST_TRANSPORT_MCU_READY
	bool
	default y if ESP_HOSTED_HOST_TRANSPORT_MCU

if ESP_HOSTED_HOST_TRANSPORT_MCU
	# y if SDIO is available for the (host SoC, CP target) pair.
	config ESP_HOSTED_HOST_PRIV_SDIO_OPTION
		bool
		default y if (IDF_TARGET_ESP32 || IDF_TARGET_ESP32S3 || IDF_TARGET_ESP32P4) && (ESP_HOSTED_CP_TARGET_ESP32 || ESP_HOSTED_CP_TARGET_ESP32C5 || ESP_HOSTED_CP_TARGET_ESP32C6 || ESP_HOSTED_CP_TARGET_ESP32C61)
		default n

	choice ESP_HOSTED_HOST_TRANSPORT_BUS
		prompt "Communication bus (co-processor <== bus ==> host)"
		default ESP_HOSTED_HOST_TRANSPORT_BUS_SDIO if ESP_HOSTED_HOST_PRIV_SDIO_OPTION
		default ESP_HOSTED_HOST_TRANSPORT_BUS_SPI
		help
		  Selects which bus peripheral drives the host→CP link.
		  Pin / clock / baud defaults for the chosen bus live in the
		  corresponding Kconfig.host.<bus> sub-file.  SDIO is the
		  preferred default when both ends support it; falls back to
		  SPI Full-duplex otherwise.

		config ESP_HOSTED_HOST_TRANSPORT_BUS_SPI
			bool "SPI Full Duplex"
		config ESP_HOSTED_HOST_TRANSPORT_BUS_SDIO
			bool "SDIO"
			depends on ESP_HOSTED_HOST_PRIV_SDIO_OPTION
		config ESP_HOSTED_HOST_TRANSPORT_BUS_SPI_HD
			bool "SPI Half Duplex"
		config ESP_HOSTED_HOST_TRANSPORT_BUS_UART
			bool "UART"
	endchoice

	# _READY = bus selected AND parent transport compiled-in. Gates source pulls.
	config ESP_HOSTED_HOST_TRANSPORT_BUS_SPI_READY
		bool
		default y if ESP_HOSTED_HOST_TRANSPORT_BUS_SPI && ESP_HOSTED_HOST_TRANSPORT_MCU_READY
	config ESP_HOSTED_HOST_TRANSPORT_BUS_SDIO_READY
		bool
		default y if ESP_HOSTED_HOST_TRANSPORT_BUS_SDIO && ESP_HOSTED_HOST_TRANSPORT_MCU_READY
	config ESP_HOSTED_HOST_TRANSPORT_BUS_SPI_HD_READY
		bool
		default y if ESP_HOSTED_HOST_TRANSPORT_BUS_SPI_HD && ESP_HOSTED_HOST_TRANSPORT_MCU_READY
	config ESP_HOSTED_HOST_TRANSPORT_BUS_UART_READY
		bool
		default y if ESP_HOSTED_HOST_TRANSPORT_BUS_UART && ESP_HOSTED_HOST_TRANSPORT_MCU_READY

	orsource "Kconfig.host.spi"
	orsource "Kconfig.host.sdio"
	orsource "Kconfig.host.spi_hd"
	orsource "Kconfig.host.uart"

	menu "Transport Test"
		config ESP_HOSTED_RAW_THROUGHPUT_TRANSPORT
			bool
			default y
			help
				RawTP support is always compiled in for MCU hosts. The test
				remains idle until the host CLI starts it at runtime; there is
				no boot-time auto-start direction.

		config ESP_HOSTED_RAW_TP_REPORT_INTERVAL
			int "RawTP: periodic duration to report stats accumulated"
			default 1

		config ESP_HOSTED_RAW_TP_HOST_TO_ESP_PKT_LEN
			int "RawTP: Host to ESP packet size"
			default 1460
	endmenu

endif
```

## host/mcu/eh_host_mcu_vserial/Kconfig.ext
```kconfig
config ESP_HOSTED_HOST_VSERIAL_MCU
	bool
	default y if ESP_HOSTED_HOST_TYPE_MCU
	default n
	depends on ESP_HOSTED_HOST

config ESP_HOSTED_HOST_VSERIAL_MCU_READY
	bool
	default y if ESP_HOSTED_HOST_VSERIAL_MCU
```

## port/idf_components/log/Kconfig.ext
```kconfig
menu "Log"

	choice LOG_DEFAULT_LEVEL
		bool "Default log verbosity"
		default LOG_DEFAULT_LEVEL_INFO
		help
		    Runtime log level cap.  Mirrors IDF's CONFIG_LOG_DEFAULT_LEVEL.

		config LOG_DEFAULT_LEVEL_NONE
			bool "No output"
		config LOG_DEFAULT_LEVEL_ERROR
			bool "Error"
		config LOG_DEFAULT_LEVEL_WARN
			bool "Warning"
		config LOG_DEFAULT_LEVEL_INFO
			bool "Info"
		config LOG_DEFAULT_LEVEL_DEBUG
			bool "Debug"
		config LOG_DEFAULT_LEVEL_VERBOSE
			bool "Verbose"
	endchoice

	config LOG_DEFAULT_LEVEL
		int
		default 0 if LOG_DEFAULT_LEVEL_NONE
		default 1 if LOG_DEFAULT_LEVEL_ERROR
		default 2 if LOG_DEFAULT_LEVEL_WARN
		default 3 if LOG_DEFAULT_LEVEL_INFO
		default 4 if LOG_DEFAULT_LEVEL_DEBUG
		default 5 if LOG_DEFAULT_LEVEL_VERBOSE

	choice LOG_MAXIMUM_LEVEL
		bool "Maximum log verbosity compiled in"
		default LOG_MAXIMUM_EQUALS_DEFAULT
		help
		    Compile-time ceiling.  Anything above is filtered at compile.

		config LOG_MAXIMUM_EQUALS_DEFAULT
			bool "Same as default"
		config LOG_MAXIMUM_LEVEL_DEBUG
			bool "Debug"
		config LOG_MAXIMUM_LEVEL_VERBOSE
			bool "Verbose"
	endchoice

	config LOG_MAXIMUM_LEVEL
		int
		default LOG_DEFAULT_LEVEL if LOG_MAXIMUM_EQUALS_DEFAULT
		default 4 if LOG_MAXIMUM_LEVEL_DEBUG
		default 5 if LOG_MAXIMUM_LEVEL_VERBOSE

	config LOG_COLORS
		bool "Use ANSI color escapes"
		default y
		help
		    Adds ANSI color escapes to log output (matches IDF).

endmenu
```
