/* Pin EH_HOST_FEAT_REGISTER descriptors into the DRAM LOAD segment.
 * @EH_HOST_DESCS_REGION@ is substituted at cmake-config time.
 * Without explicit `> region`, ld parks the orphan into TCM heap and
 * heap_init overwrites the descriptors. The "undeclared region" warning
 * is harmless: memory.ld is processed after this fragment. */
SECTIONS
{
    .eh_host_feat_descs : ALIGN(4)
    {
        PROVIDE(__start_eh_host_feat_descs = .);
        KEEP(*(eh_host_feat_descs))
        PROVIDE(__stop_eh_host_feat_descs = .);
    } > @EH_HOST_DESCS_REGION@
} INSERT AFTER .dram0.data
