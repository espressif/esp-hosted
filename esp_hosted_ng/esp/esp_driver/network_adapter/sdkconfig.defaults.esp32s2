## esp_hosted_ng/esp/esp_driver/network_adapter/sdkconfig.defaults.esp32s2
```kconfig
# BT Configuration
CONFIG_BT_ENABLED=
CONFIG_BT_CONTROLLER_ONLY=
CONFIG_BT_BLUEDROID_ENABLED=
CONFIG_BT_LE_SLEEP_ENABLE=
```

## esp_hosted_ng/esp/esp_driver/network_adapter/sdkconfig.defaults.esp32s3
```kconfig
#For battery sensitive usage, can reduce the CPU frequency
CONFIG_ESP32S3_DEFAULT_CPU_FREQ_240=y
CONFIG_ESP32S3_DEFAULT_CPU_FREQ_MHZ=240

# BT Configuration
CONFIG_BT_ENABLED=y
CONFIG_BT_CONTROLLER_ONLY=y
CONFIG_BT_BLUEDROID_ENABLED=
CONFIG_BTDM_CTRL_MODE_BLE_ONLY=y
CONFIG_BTDM_CTRL_MODE_BR_EDR_ONLY=n
CONFIG_BTDM_CTRL_MODE_BTDM=n
CONFIG_BTDM_CTRL_HCI_MODE_VHCI=y

CONFIG_ESP32_WIFI_NVS_ENABLED=

CONFIG_ESP_WIFI_STATIC_RX_BUFFER_NUM=16
CONFIG_ESP_WIFI_DYNAMIC_RX_BUFFER_NUM=64
CONFIG_ESP_WIFI_DYNAMIC_TX_BUFFER_NUM=64
CONFIG_ESP_WIFI_AMPDU_TX_ENABLED=y
CONFIG_ESP_WIFI_TX_BA_WIN=32
CONFIG_ESP_WIFI_AMPDU_RX_ENABLED=y
CONFIG_ESP_WIFI_RX_BA_WIN=32
```

## esp_hosted_ng/host/Kconfig
```kconfig
# SPDX-License-Identifier: GPL-2.0-only
#
# ESP hosted (New Generation) wireless drivers
#

config ESPRESSIF_ESP_HOSTED_NG
	tristate
	help
	  The driver allows for using ESP32-series SoC as a hosted wireless transceiver.

config ESP_HOSTED_NG_SDIO
	tristate "Espressif ESP-Series hosted (NG) with SDIO"
	select ESPRESSIF_ESP_HOSTED_NG

config ESP_HOSTED_NG_SPI
	tristate "Espressif ESP-Series hosted (NG) with SPI"
	depends on SPI
	select SPI_MASTER
	select ESPRESSIF_ESP_HOSTED_NG

config ESP_HOSTED_NG_TEST_RAW_TP
	bool "-- Raw Throughput testing"
	depends on ESPRESSIF_ESP_HOSTED_NG

config ESP_HOSTED_NG_LOG_LEVEL
	int "-- Debug log verbosity level"
	depends on ESPRESSIF_ESP_HOSTED_NG
	range 0 4
	default 0
	help
	  The entry defines a verbosity level of the debug log. Allowed values are 0-4.

config ESP_HOSTED_NG_NO_ADJUST_SPI_CLOCK
	bool "-- Disallow ESP adjust SPI clock"
	depends on ESP_HOSTED_NG_SPI

config ESP_HOSTED_NG_NO_CS_CHANGE
	bool "-- Disallow CS change"
	depends on ESP_HOSTED_NG_SPI

config ESP_HOSTED_NG_MONITOR_PROCESS
	bool "-- Enable Monitoring process"
	depends on ESP_HOSTED_NG_SDIO
```

## examples/bleprph_host_only_vhci/sdkconfig.defaults
```kconfig
# Override some defaults so BT stack is enabled
# in this example

#
# BT config
#
CONFIG_BT_ENABLED=y
CONFIG_BT_CONTROLLER_DISABLED=y
CONFIG_BT_BLUEDROID_ENABLED=n
CONFIG_BT_NIMBLE_ENABLED=y
CONFIG_BT_NIMBLE_TRANSPORT_UART=n

#
# Enable ESP Hosted BT
# Used as VHCI transport between BT Host and Controller
#
CONFIG_ESP_ENABLE_BT=y
```

## examples/bluetooth/host_mcu/bluedroid/examples/hosted_hci/controller_mac_addr/main/Kconfig.projbuild
```kconfig
menu "Example Configuration"

    config EXAMPLE_UPDATE_MAC_ADDRESS
	    bool "Update MAC Address of BT Controller"
		default y
		help
		    Update the MAC Address on the BT Controller
endmenu
```

## examples/mcu_hosted_sdio_sdmmc_combined/mcu_host/main/Kconfig.projbuild
```kconfig
menu "SD/MMC Example Configuration"

    config EXAMPLE_SDMMC_SLOT_RANGE_MAX
	    int
		default 0 if IDF_TARGET_ESP32P4
		default 1 if IDF_TARGET_ESP32S3

    config EXAMPLE_SDMMC_SLOT
        int "SD/MMC slot to use"
        default 0
		range 0 EXAMPLE_SDMMC_SLOT_RANGE_MAX
        help
            Select the slot to use
            For ESP32-P4, only Slot 0 for SD Card is available as ESP-Hosted uses Slot 1

    choice EXAMPLE_SDMMC_BUS_WIDTH
        prompt "SD/MMC bus width"
        default EXAMPLE_SDMMC_BUS_WIDTH_4
        help
            Select the bus width of SD or MMC interface.
            Note that even if 1 line mode is used, D3 pin of the SD card must have a pull-up resistor connected.
            Otherwise the card may enter SPI mode, the only way to recover from which is to cycle power to the card.

        config EXAMPLE_SDMMC_BUS_WIDTH_4
            bool "4 lines (D0 - D3)"

        config EXAMPLE_SDMMC_BUS_WIDTH_1
            bool "1 line (D0)"
    endchoice

    config EXAMPLE_PIN_CARD_POWER_RESET
        int
        depends on SOC_SDMMC_IO_POWER_EXTERNAL
        prompt "Card Power Reset"
        default 45

    config EXAMPLE_PIN_CMD
        int
        prompt "CMD GPIO number" if SOC_SDMMC_USE_GPIO_MATRIX
        default 35 if IDF_TARGET_ESP32S3
        range 44 44 if IDF_TARGET_ESP32P4

    config EXAMPLE_PIN_CLK
        int
        prompt "CLK GPIO number" if SOC_SDMMC_USE_GPIO_MATRIX
        default 36 if IDF_TARGET_ESP32S3
        range 43 43 if IDF_TARGET_ESP32P4

    config EXAMPLE_PIN_D0
        int
        prompt "D0 GPIO number" if SOC_SDMMC_USE_GPIO_MATRIX
        default 37 if IDF_TARGET_ESP32S3
        range 39 39 if IDF_TARGET_ESP32P4

    if EXAMPLE_SDMMC_BUS_WIDTH_4

        config EXAMPLE_PIN_D1
            int
            prompt "D1 GPIO number" if SOC_SDMMC_USE_GPIO_MATRIX
            default 38 if IDF_TARGET_ESP32S3
            range 40 40 if IDF_TARGET_ESP32P4

        config EXAMPLE_PIN_D2
            int
            prompt "D2 GPIO number" if SOC_SDMMC_USE_GPIO_MATRIX
            default 33 if IDF_TARGET_ESP32S3
            range 41 41 if IDF_TARGET_ESP32P4

        config EXAMPLE_PIN_D3
            int
            prompt "D3 GPIO number" if SOC_SDMMC_USE_GPIO_MATRIX
            default 34 if IDF_TARGET_ESP32S3
            range 42 42 if IDF_TARGET_ESP32P4

    endif  # EXAMPLE_SDMMC_BUS_WIDTH_4

    config EXAMPLE_SD_PWR_CTRL_LDO_INTERNAL_IO
        depends on SOC_SDMMC_IO_POWER_EXTERNAL
        bool "SD power supply comes from internal LDO IO (READ HELP!)"
        default y
        help
            Only needed when the SD card is connected to specific IO pins which can be used for high-speed SDMMC.
            Please read the schematic first and check if the SD VDD is connected to any internal LDO output.
            Unselect this option if the SD card is powered by an external power supply.

    config EXAMPLE_SD_PWR_CTRL_LDO_IO_ID
        depends on SOC_SDMMC_IO_POWER_EXTERNAL && EXAMPLE_SD_PWR_CTRL_LDO_INTERNAL_IO
        int "LDO ID"
        default 4 if IDF_TARGET_ESP32P4
        help
            Please read the schematic first and input your LDO ID.
endmenu
```

## examples/network_split/station/mcu_host/sdkconfig.defaults.esp32c61
```kconfig
CONFIG_ESP_DEFAULT_CPU_FREQ_MHZ_160=y

# BT Configuration
CONFIG_BT_ENABLED=n
CONFIG_BT_CONTROLLER_ONLY=y
CONFIG_BT_BLUEDROID_ENABLED=
CONFIG_BT_LE_SLEEP_ENABLE=y

# SPI/SDIO only
CONFIG_BT_LE_HCI_INTERFACE_USE_RAM=y

CONFIG_ESP_CACHE_MALLOC=n

CONFIG_PARTITION_TABLE_CUSTOM=y
CONFIG_PARTITION_TABLE_CUSTOM_FILENAME="partitions_eh_cp_ota_4m.csv"
# CONFIG_ESP_PKT_STATS=y
```

## examples/openthread/border_router/esp_host/sdkconfig.defaults.esp32p4
```kconfig
# Increase size of bootloader due to frame pointer. Only overflowed on P4.
CONFIG_PARTITION_TABLE_OFFSET=0x9000

### enable SPIRAM, else application will not start (out of memory)
CONFIG_SPIRAM=y
CONFIG_ESP_HOSTED_DFLT_TASK_FROM_SPIRAM=y

### enable Wi-Fi in example, set co-processor target
CONFIG_EXAMPLE_CONNECT_WIFI=y
CONFIG_SLAVE_IDF_TARGET_ESP32C6=y

CONFIG_ESP_CONSOLE_UART_DEFAULT=y

### SW coexistence on the co-processor is on, so this option must be
### disabled on host to keep OpenThread capabilities consistent
CONFIG_OPENTHREAD_RX_ON_WHEN_IDLE=n
```

## examples/openthread/cli/esp_host/sdkconfig.defaults.esp32p4
```kconfig
CONFIG_PARTITION_TABLE_CUSTOM=y
CONFIG_PARTITION_TABLE_CUSTOM_FILENAME="partitions.esp32p4.csv"
CONFIG_PARTITION_TABLE_FILENAME="partitions.esp32p4.csv"
CONFIG_ESPTOOLPY_FLASHSIZE_4MB=y

### enable SPIRAM, else application will not start (out of memory)
CONFIG_SPIRAM=y
CONFIG_ESP_HOSTED_DFLT_TASK_FROM_SPIRAM=y

### SW coexistence on the co-processor is on, so this option must be
### disabled on host to keep OpenThread capabilities consistent
CONFIG_OPENTHREAD_RX_ON_WHEN_IDLE=n
```

## examples/power_save/host+cp/network_split__host_deep_sleep_cp_light_sleep/esp_host/sdkconfig.defaults.esp32c3
```kconfig
#
# ESP32C3
#

CONFIG_WIFI_RMT_STATIC_RX_BUFFER_NUM=20
CONFIG_WIFI_RMT_DYNAMIC_RX_BUFFER_NUM=40
CONFIG_WIFI_RMT_DYNAMIC_TX_BUFFER_NUM=40
CONFIG_WIFI_RMT_AMPDU_TX_ENABLED=y
CONFIG_WIFI_RMT_TX_BA_WIN=32
CONFIG_WIFI_RMT_AMPDU_RX_ENABLED=y
CONFIG_WIFI_RMT_RX_BA_WIN=32

CONFIG_LWIP_TCP_SND_BUF_DEFAULT=40960
CONFIG_LWIP_TCP_WND_DEFAULT=40960
CONFIG_LWIP_TCP_RECVMBOX_SIZE=64
CONFIG_LWIP_UDP_RECVMBOX_SIZE=64
CONFIG_LWIP_TCPIP_RECVMBOX_SIZE=64

CONFIG_ESP_DEFAULT_CPU_FREQ_MHZ_160=y
CONFIG_ESP_DEFAULT_CPU_FREQ_MHZ=160

CONFIG_LWIP_TCPIP_CORE_LOCKING=y
CONFIG_LWIP_TCPIP_CORE_LOCKING_INPUT=y
```

## examples/power_save/host+cp/network_split__host_deep_sleep_cp_light_sleep/esp_host/sdkconfig.defaults.esp32c61
```kconfig
#
# ESP32C61-Specific
#
CONFIG_IDF_ENV_FPGA=n

CONFIG_WIFI_RMT_STATIC_RX_BUFFER_NUM=20
CONFIG_WIFI_RMT_DYNAMIC_RX_BUFFER_NUM=40
CONFIG_WIFI_RMT_DYNAMIC_TX_BUFFER_NUM=36
CONFIG_WIFI_RMT_AMPDU_TX_ENABLED=y
CONFIG_WIFI_RMT_TX_BA_WIN=32
CONFIG_WIFI_RMT_AMPDU_RX_ENABLED=y
CONFIG_WIFI_RMT_RX_BA_WIN=20

CONFIG_LWIP_TCP_SND_BUF_DEFAULT=25920
CONFIG_LWIP_TCP_WND_DEFAULT=43200
CONFIG_LWIP_TCP_RECVMBOX_SIZE=48
CONFIG_LWIP_UDP_RECVMBOX_SIZE=64
CONFIG_LWIP_TCPIP_RECVMBOX_SIZE=48
CONFIG_LWIP_IP_REASS_MAX_PBUFS=15

#
# Wi-Fi
#
CONFIG_ESP_WIFI_ENABLE_WIFI_TX_STATS=y
CONFIG_ESP_WIFI_ENABLE_WIFI_RX_STATS=y
CONFIG_ESP_WIFI_ENABLE_WIFI_RX_MU_STATS=n
CONFIG_ESP_WIFI_ENABLE_DUMP_HESIGB=n
CONFIG_ESP_WIFI_ENABLE_DUMP_MU_CFO=n
CONFIG_ESP_WIFI_ENABLE_DUMP_CTRL_NDPA=n
CONFIG_ESP_WIFI_ENABLE_DUMP_CTRL_BFRP=n
CONFIG_ESP_WIFI_SLP_IRAM_OPT=n
CONFIG_LWIP_EXTRA_IRAM_OPTIMIZATION=n

CONFIG_LWIP_TCPIP_CORE_LOCKING=y
CONFIG_LWIP_TCPIP_CORE_LOCKING_INPUT=y

CONFIG_IPERF_DEF_TCP_TX_BUFFER_LEN=2880
```

## examples/power_save/host+cp/network_split__host_deep_sleep_cp_light_sleep/esp_host/sdkconfig.defaults.esp32s2
```kconfig
#
# ESP32S2-specific
#

CONFIG_WIFI_RMT_STATIC_RX_BUFFER_NUM=8
CONFIG_WIFI_RMT_DYNAMIC_RX_BUFFER_NUM=24
CONFIG_WIFI_RMT_DYNAMIC_TX_BUFFER_NUM=24
CONFIG_WIFI_RMT_AMPDU_TX_ENABLED=y
CONFIG_WIFI_RMT_TX_BA_WIN=16
CONFIG_WIFI_RMT_AMPDU_RX_ENABLED=y
CONFIG_WIFI_RMT_RX_BA_WIN=16

CONFIG_LWIP_TCP_SND_BUF_DEFAULT=17280
CONFIG_LWIP_TCP_WND_DEFAULT=28000
CONFIG_LWIP_TCP_RECVMBOX_SIZE=32
CONFIG_LWIP_UDP_RECVMBOX_SIZE=32
CONFIG_LWIP_TCPIP_RECVMBOX_SIZE=32

CONFIG_ESP_DEFAULT_CPU_FREQ_MHZ_240=y
CONFIG_ESP_DEFAULT_CPU_FREQ_MHZ=240

CONFIG_ESP32S2_INSTRUCTION_CACHE_16KB=y
CONFIG_ESP32S2_INSTRUCTION_CACHE_LINE_16B=y
CONFIG_ESP32S2_INSTRUCTION_CACHE_WRAP=y

CONFIG_LWIP_TCPIP_CORE_LOCKING=y
CONFIG_LWIP_TCPIP_CORE_LOCKING_INPUT=y
```

## examples/power_save/host/network_split__host_deep_sleep/esp_host/sdkconfig.defaults.esp32c6
```kconfig
#
# ESP32C6-Specific
#

CONFIG_WIFI_RMT_STATIC_RX_BUFFER_NUM=40
CONFIG_WIFI_RMT_DYNAMIC_RX_BUFFER_NUM=60
CONFIG_WIFI_RMT_DYNAMIC_TX_BUFFER_NUM=40
CONFIG_WIFI_RMT_AMPDU_TX_ENABLED=y
CONFIG_WIFI_RMT_TX_BA_WIN=32
CONFIG_WIFI_RMT_AMPDU_RX_ENABLED=y
CONFIG_WIFI_RMT_RX_BA_WIN=32

CONFIG_LWIP_TCP_SND_BUF_DEFAULT=51200
CONFIG_LWIP_TCP_WND_DEFAULT=65535
CONFIG_LWIP_TCP_RECVMBOX_SIZE=64
CONFIG_LWIP_UDP_RECVMBOX_SIZE=64
CONFIG_LWIP_TCPIP_RECVMBOX_SIZE=64

CONFIG_LWIP_IP_REASS_MAX_PBUFS=15

CONFIG_ESP_WIFI_ENABLE_WIFI_RX_STATS=n
CONFIG_ESP_WIFI_ENABLE_WIFI_TX_STATS=n
CONFIG_LWIP_EXTRA_IRAM_OPTIMIZATION=y

CONFIG_LWIP_TCPIP_CORE_LOCKING=y
CONFIG_LWIP_TCPIP_CORE_LOCKING_INPUT=y
```

## examples/zigbee/thermostat/esp_host/main/Kconfig.projbuild
```kconfig
menu "Example Configuration"
    config GPIO_BOOT_ON_DEVKIT
        int "BOOT GPIO on devkit"
        default 9 if IDF_TARGET_ESP32H2
        default 35 if IDF_TARGET_ESP32P4
        default 9

        help
            The GPIO connected to the BOOT button on the devkits

endmenu
```

## fg/cp/examples/cp_linux_fg/extensions/network_split/iperf/main/Kconfig.projbuild
```kconfig
menu "ESP-Hosted Example Config"
	menu "Example to run"
		depends on ESP_HOSTED_CP_EXT_NW_SPLIT

		config ESP_HOSTED_CP_EXAMPLE_MQTT_CLIENT
			bool "MQTT client example"
			default n

		menu "MQTT client config"
			depends on ESP_HOSTED_CP_EXAMPLE_MQTT_CLIENT

			choice BROKER_CHOICE
				prompt "MQTT Broker"
				default BROKER_HIVEMQ

				config BROKER_ECLIPSEPROJECTS
					bool "mqtt.eclipseprojects.io"
				config BROKER_HIVEMQ
					bool "broker.hivemq.com"
			endchoice

			config BROKER_URL
				string
				default "mqtt://mqtt.eclipseprojects.io" if BROKER_ECLIPSEPROJECTS
				default "mqtt://broker.hivemq.com" if BROKER_HIVEMQ
				help
					URL of the broker to connect to

			config BROKER_URL_FROM_STDIN
				bool
				default y if BROKER_URL = "FROM_STDIN"

		endmenu

		config ESP_HOSTED_CP_EXAMPLE_HTTP_CLIENT
			bool "HTTP client example"
			default n

		menu "HTTP client config"
			depends on ESP_HOSTED_CP_EXAMPLE_HTTP_CLIENT

			config HTTP_WEBSERVER
				string "HTTP webserver to send req"
				default "example.com"

			config HTTP_WEBSERVER_PORT
				string "HTTP webserver port"
				default "80"

			config HTTP_WEBSERVER_PATH
				string "HTTP webserver path"
				default "/"

			config HTTP_REQ_DELAY
				int "Delay after every http request (seconds)"
				default 10

		endmenu
	endmenu
endmenu
```

## fg/cp/examples/cp_linux_fg/extensions/network_split/station/sdkconfig.defaults
```kconfig
# Host Type Configuration - Linux FG
CONFIG_ESP_HOSTED_CP_FOR_LINUX__802_03=y
# CONFIG_ESP_HOSTED_CP_FOR_MCU is not set
CONFIG_ESP_HOSTED_CP_RPC_V1_LINUX=y

CONFIG_ESP_WIFI_SOFTAP_SUPPORT=n
# Network Split Configuration
CONFIG_ESP_HOSTED_CP_FEAT_WIFI=y
CONFIG_ESP_HOSTED_CP_FEAT_NW_SPLIT=y


# WiFi configuration
CONFIG_EXAMPLE_WIFI_SSID="myssid"
CONFIG_EXAMPLE_WIFI_PASSWORD="mypassword!123"
CONFIG_EXAMPLE_WIFI_CONN_MAX_RETRY=6
CONFIG_EXAMPLE_WIFI_AUTH_WPA2_PSK=y

## BT Configuration
#CONFIG_BT_ENABLED=y
#CONFIG_BT_CONTROLLER_ONLY=y

# OTA
CONFIG_ESPTOOLPY_FLASHSIZE_4MB=y
CONFIG_PARTITION_TABLE_CUSTOM=y
CONFIG_PARTITION_TABLE_CUSTOM_FILENAME="partitions_eh_cp_ota_4m.csv"

# OS
CONFIG_FREERTOS_HZ=1000
CONFIG_ESP_WIFI_NVS_ENABLED=y

CONFIG_ESP_SYSTEM_EVENT_TASK_STACK_SIZE=4096
CONFIG_COMPILER_OPTIMIZATION_PERF=y
```
