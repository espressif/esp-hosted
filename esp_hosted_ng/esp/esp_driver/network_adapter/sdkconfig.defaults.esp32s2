## fg/cp/examples/cp_linux_fg/extensions/network_split/station/sdkconfig.defaults.esp32
```kconfig
# Hosted config
#----------------
CONFIG_SDIO_DAT2_DISABLED=
CONFIG_ESP_CACHE_MALLOC=y
#       --- Debugging ---
#CONFIG_ESP_HOSTED_FUNCTION_PROFILING=y
#CONFIG_ESP_PKT_STATS=y

#       --- Network split ---
CONFIG_ESPTOOLPY_FLASHSIZE_4MB=y


## BT Configuration
#CONFIG_BT_ENABLED=y
#CONFIG_BT_CONTROLLER_ONLY=y
#CONFIG_BT_BLUEDROID_ENABLED=
#CONFIG_BTDM_CONTROLLER_MODE_BTDM=y
#CONFIG_BTDM_CONTROLLER_HCI_MODE_VHCI=y
#CONFIG_BTDM_CTRL_AUTO_LATENCY=y
#CONFIG_BTDM_CONTROLLER_MODEM_SLEEP=y
#CONFIG_BTDM_CTRL_MODEM_SLEEP=y
#
## BT over UART
##CONFIG_BTDM_CONTROLLER_HCI_MODE_UART_H4=y
##CONFIG_BTDM_CTRL_HCI_MODE_UART_H4=y
##CONFIG_BT_HCI_UART_NO=1
##CONFIG_BT_HCI_UART_BAUDRATE=921600
#
##CO-EX config
#CONFIG_FREERTOS_UNICORE=n
#CONFIG_ESP32_WIFI_TASK_PINNED_TO_CORE_1=y
#CONFIG_BTDM_CONTROLLER_PINNED_TO_CORE=0
#CONFIG_BTDM_CTRL_PINNED_TO_CORE=0
#CONFIG_BTDM_CTRL_PINNED_TO_CORE_0=y


# Wifi config
#------------

CONFIG_ESP_WIFI_STATIC_RX_BUFFER_NUM=16
CONFIG_ESP_WIFI_DYNAMIC_RX_BUFFER_NUM=64
CONFIG_ESP_WIFI_DYNAMIC_TX_BUFFER_NUM=64
CONFIG_ESP_WIFI_AMPDU_TX_ENABLED=y
CONFIG_ESP_WIFI_TX_BA_WIN=32
CONFIG_ESP_WIFI_AMPDU_RX_ENABLED=y
CONFIG_ESP_WIFI_RX_BA_WIN=32

# # LWIP
# ------
# CONFIG_LWIP_ENABLE=y
# CONFIG_LWIP_TCPIP_TASK_PRIO=22
# CONFIG_LWIP_TCP_SND_BUF_DEFAULT=7200
# CONFIG_LWIP_TCP_WND_DEFAULT=11520
# CONFIG_LWIP_TCP_RECVMBOX_SIZE=16
# CONFIG_LWIP_UDP_RECVMBOX_SIZE=16
# CONFIG_LWIP_TCPIP_RECVMBOX_SIZE=32
# CONFIG_LWIP_TCP_SACK_OUT=y
# CONFIG_LWIP_TCPIP_CORE_LOCKING=y
# CONFIG_LWIP_TCPIP_CORE_LOCKING_INPUT=y


# Optimizations
#-------------------
# CONFIG_LWIP_EXTRA_IRAM_OPTIMIZATION=n
CONFIG_COMPILER_OPTIMIZATION_PERF=y
CONFIG_ESPTOOLPY_FLASHMODE_QIO=y
CONFIG_ESP_WIFI_RX_IRAM_OPT=y
CONFIG_ESP_WIFI_IRAM_OPT=y
CONFIG_ESP_DEFAULT_CPU_FREQ_MHZ_240=y
CONFIG_ESP_DEFAULT_CPU_FREQ_MHZ=240
CONFIG_FREERTOS_PLACE_FUNCTIONS_INTO_FLASH=y
CONFIG_SPI_MASTER_ISR_IN_IRAM=n
CONFIG_RINGBUF_PLACE_FUNCTIONS_INTO_FLASH=y
CONFIG_ESP_SYSTEM_ESP32_SRAM1_REGION_AS_IRAM=y


# Partition Table
#--------------------
CONFIG_PARTITION_TABLE_CUSTOM=y
CONFIG_PARTITION_TABLE_CUSTOM_FILENAME="partitions_eh_cp_ota_4m.csv"

# OS
CONFIG_BOOTLOADER_COMPILER_OPTIMIZATION_SIZE=y
CONFIG_BOOTLOADER_COMPILER_OPTIMIZATION_PERF=n
```

## fg/cp/examples/cp_linux_fg/extensions/network_split/station/sdkconfig.defaults.esp32s2
```kconfig
# Hosted config
#----------------
CONFIG_ESP_CACHE_MALLOC=y
#       --- Debugging ---
#CONFIG_ESP_HOSTED_FUNCTION_PROFILING=y
#CONFIG_ESP_PKT_STATS=y

#       --- Network split ---


# BLE disabled in this example by default
## BLE Config
##-----------
#CONFIG_BT_ENABLED=y
#CONFIG_BT_CONTROLLER_ONLY=y
#CONFIG_BT_BLUEDROID_ENABLED=
#CONFIG_BT_LE_SLEEP_ENABLE=y
#
##  --- (Opt 1) Hci over SPI/SDIO ---
##-----------------------
#CONFIG_BT_LE_HCI_INTERFACE_USE_RAM=y
#
##  --- (Opt 2) Hci over UART ---
##-------------------
## Enable below config, delete sdkconfig, build/ and rebuild
## CONFIG_BT_LE_HCI_INTERFACE_USE_UART=y
CONFIG_ESP_CACHE_MALLOC=y


# Wifi config
#------------

CONFIG_ESP_WIFI_STATIC_RX_BUFFER_NUM=8
CONFIG_ESP_WIFI_DYNAMIC_RX_BUFFER_NUM=24
CONFIG_ESP_WIFI_DYNAMIC_TX_BUFFER_NUM=24
CONFIG_ESP_WIFI_AMPDU_TX_ENABLED=y
CONFIG_ESP_WIFI_TX_BA_WIN=16
CONFIG_ESP_WIFI_AMPDU_RX_ENABLED=y
CONFIG_ESP_WIFI_RX_BA_WIN=16

# # LWIP
# ------
# CONFIG_LWIP_ENABLE=y
# CONFIG_LWIP_TCPIP_TASK_PRIO=22
# CONFIG_LWIP_TCP_SND_BUF_DEFAULT=7200
# CONFIG_LWIP_TCP_WND_DEFAULT=11520
# CONFIG_LWIP_TCP_RECVMBOX_SIZE=16
# CONFIG_LWIP_UDP_RECVMBOX_SIZE=16
# CONFIG_LWIP_TCPIP_RECVMBOX_SIZE=32
# CONFIG_LWIP_TCP_SACK_OUT=y
# CONFIG_LWIP_TCPIP_CORE_LOCKING=y
# CONFIG_LWIP_TCPIP_CORE_LOCKING_INPUT=y
# 
# CONFIG_ESP_WIFI_ENABLE_WIFI_RX_STATS=n
# CONFIG_ESP_WIFI_ENABLE_WIFI_TX_STATS=n

# Optimizations
#-------------------
# CONFIG_LWIP_EXTRA_IRAM_OPTIMIZATION=n
CONFIG_COMPILER_OPTIMIZATION_PERF=y
CONFIG_ESPTOOLPY_FLASHMODE_QIO=y
CONFIG_ESP_WIFI_RX_IRAM_OPT=y
CONFIG_ESP_WIFI_IRAM_OPT=y
CONFIG_ESP_DEFAULT_CPU_FREQ_MHZ=240
CONFIG_FREERTOS_PLACE_FUNCTIONS_INTO_FLASH=y
CONFIG_SPI_MASTER_ISR_IN_IRAM=n


# Partition Table
#--------------------
CONFIG_PARTITION_TABLE_CUSTOM=y
CONFIG_PARTITION_TABLE_CUSTOM_FILENAME="partitions_eh_cp_ota_4m.csv"
```

## fg/cp/examples/cp_linux_fg/minimal/wifi/sdkconfig.defaults
```kconfig
CONFIG_ESP_HOSTED_CP_FOR_LINUX__802_03=y
# CONFIG_ESP_HOSTED_CP_FOR_MCU is not set
CONFIG_ESP_HOSTED_CP_RPC_V1_LINUX=y

#Disable enterprise support by default
CONFIG_ESP_WIFI_ENTERPRISE_SUPPORT=n

# BT Configuration
CONFIG_BT_ENABLED=n
#CONFIG_BT_CONTROLLER_ONLY=y

# OTA
CONFIG_ESPTOOLPY_FLASHSIZE_4MB=y
CONFIG_PARTITION_TABLE_CUSTOM=y
CONFIG_PARTITION_TABLE_CUSTOM_FILENAME="partitions_eh_cp_ota_4m.csv"

# OS
CONFIG_FREERTOS_HZ=1000
CONFIG_ESP_WIFI_NVS_ENABLED=y

CONFIG_ESP_HOSTED_CP_FEAT_WIFI=y
```

## fg/cp/examples/cp_mcu/extensions/ext_coex/sdkconfig.defaults
```kconfig
# Host Type Configuration - MCU Host
CONFIG_ESP_HOSTED_CP_FOR_MCU=y
CONFIG_ESP_HOSTED_CP_RPC_V1_MCU=y

# WiFi + External Coex features
CONFIG_ESP_HOSTED_CP_FEAT_WIFI=y
CONFIG_ESP_HOSTED_CP_FEAT_EXT_COEX=y
CONFIG_ESP_COEX_EXTERNAL_COEXIST_ENABLE=y

# BT MUST be disabled for external coex
CONFIG_BT_ENABLED=n

# OTA
CONFIG_ESPTOOLPY_FLASHSIZE_4MB=y
CONFIG_PARTITION_TABLE_CUSTOM=y
CONFIG_PARTITION_TABLE_CUSTOM_FILENAME="partitions_eh_cp_ota_4m.csv"

CONFIG_FREERTOS_HZ=1000
```

## fg/cp/examples/cp_mcu/extensions/gpio_exp/sdkconfig.defaults
```kconfig
# Host Type Configuration - MCU Host
CONFIG_ESP_HOSTED_CP_FOR_MCU=y
CONFIG_ESP_HOSTED_CP_RPC_V1_MCU=y

# GPIO Expander feature
CONFIG_ESP_HOSTED_CP_FEAT_GPIO_EXP=y

# WiFi/BT disabled
CONFIG_ESP_WIFI_ENABLED=n
CONFIG_BT_ENABLED=n

# OTA
CONFIG_ESPTOOLPY_FLASHSIZE_4MB=y
CONFIG_PARTITION_TABLE_CUSTOM=y
CONFIG_PARTITION_TABLE_CUSTOM_FILENAME="partitions_eh_cp_ota_4m.csv"

CONFIG_FREERTOS_HZ=1000
```

## fg/cp/examples/cp_mcu/extensions/host_power_save/sdkconfig.defaults
```kconfig
# ESP-Hosted coprocessor configuration
CONFIG_ESP_HOSTED=y
CONFIG_ESP_HOSTED_CP_FOR_MCU=y
# CONFIG_ESP_HOSTED_CP_FOR_LINUX__802_03 is not set
CONFIG_ESP_HOSTED_CP_RPC_V1_MCU=y

# Power Save Extension configuration
CONFIG_ESP_HOSTED_CP_FEAT_HOST_PS=y
CONFIG_ESP_HOSTED_CP_FEAT_HOST_PS_DEEP_SLEEP=y

# Host wakeup GPIO configuration (default for ESP32C6)
CONFIG_ESP_HOSTED_CP_FEAT_HOST_PS_HOST_WAKEUP_GPIO=2
CONFIG_ESP_HOSTED_CP_FEAT_HOST_PS_HOST_WAKEUP_GPIO_LEVEL_HIGH=y

# Enable full wakeup packet printing for debugging
CONFIG_ESP_HOSTED_CP_FEAT_HOST_PS_PRINT_FULL_WAKEUP_PACKET=n

# Enable CLI for power save debugging
CONFIG_ESP_HOSTED_CP_FEAT_CLI=y

# WiFi configuration
CONFIG_ESP_HOSTED_CP_FEAT_WIFI=y

# Logging configuration
CONFIG_LOG_DEFAULT_LEVEL_INFO=y

# Console configuration for debugging
CONFIG_ESP_CONSOLE_UART_DEFAULT=y
CONFIG_ESP_CONSOLE_UART_BAUDRATE=115200

# partitions
CONFIG_PARTITION_TABLE_CUSTOM=y
CONFIG_PARTITION_TABLE_CUSTOM_FILENAME="partitions_eh_cp_ota_4m.csv"
CONFIG_ESPTOOLPY_FLASHSIZE_4MB=y

# OS
CONFIG_FREERTOS_HZ=1000
CONFIG_ESP_WIFI_NVS_ENABLED=y

CONFIG_BOOTLOADER_COMPILER_OPTIMIZATION_PERF=y
CONFIG_COMPILER_OPTIMIZATION_PERF=y
CONFIG_ESP_CACHE_MALLOC=n
CONFIG_ESP_HOSTED_TASK_PRIORITY_DEFAULT=22
```

## fg/cp/examples/cp_mcu/extensions/light_sleep/sdkconfig.defaults
```kconfig
# Host Type Configuration - MCU Host
CONFIG_ESP_HOSTED_CP_FOR_MCU=y
CONFIG_ESP_HOSTED_CP_RPC_V1_MCU=y

# WiFi + Light Sleep features
CONFIG_ESP_HOSTED_CP_FEAT_WIFI=y
CONFIG_ESP_HOSTED_CP_FEAT_LIGHT_SLEEP=y

# Power management for light sleep
CONFIG_PM_ENABLE=y
CONFIG_FREERTOS_USE_TICKLESS_IDLE=y
CONFIG_PM_SLP_IRAM_OPT=y
CONFIG_PM_RTOS_IDLE_OPT=y
CONFIG_PM_SLP_DISABLE_GPIO=y
CONFIG_ESP_WIFI_SLP_IRAM_OPT=y
CONFIG_ESP_DEFAULT_CPU_FREQ_MHZ_80=y

# BT disabled
CONFIG_BT_ENABLED=n

# OTA
CONFIG_ESPTOOLPY_FLASHSIZE_4MB=y
CONFIG_PARTITION_TABLE_CUSTOM=y
CONFIG_PARTITION_TABLE_CUSTOM_FILENAME="partitions_eh_cp_ota_4m.csv"

CONFIG_FREERTOS_HZ=1000
```
