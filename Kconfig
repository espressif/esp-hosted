## common/eh_common/Kconfig.ext
```kconfig
menu "Common config (Host & Coprocessor)"
	depends on ESP_HOSTED

	config ESP_HOSTED_AUTO_CALL_INIT_BEFORE_APP_MAIN
		bool "Auto-call esp_hosted_init() before app_main()"
		default y
		help
			When y (default), ESP-Hosted installs an
			__attribute__((constructor)) wrapper that calls
			esp_hosted_init() before app_main() / setup(), so apps
			can use esp_hosted_* APIs without an explicit init.
			esp_hosted_init() dispatches to eh_host_init() on the
			host role and eh_cp_init() on the coprocessor role.

			Set to n in apps that need to override Kconfig-default
			pin assignments or clocks at runtime — call
			esp_hosted_sdio_set_config() / esp_hosted_spi_set_config()
			first, then esp_hosted_init() at the desired point.  With
			the constructor on, runtime *_set_config() calls return
			ESP_TRANSPORT_ERR_ALREADY_SET because the shadow config
			is already locked.

			Distinct from the per-feature ESP_HOSTED_*_AUTO_INIT
			knobs — those gate linker-section descriptors walked by
			auto_feat_init_task.  This knob gates the top-level
			esp_hosted_init() call only.

endmenu
```

## coprocessor/eh_cp_transport/Kconfig.cp.spi
```kconfig
menu "SPI Configuration"
	depends on EH_TRANSPORT_CP_SPI

	# Internal configurations with sensible defaults
	choice EH_TRANSPORT_CP_SPI_MODE
		bool "Slave SPI mode"
		default EH_TRANSPORT_CP_SPI_MODE_2 if IDF_TARGET_ESP32
		default EH_TRANSPORT_CP_SPI_MODE_3

		config EH_TRANSPORT_CP_SPI_MODE_0
			bool "Slave SPI mode 0"

		config EH_TRANSPORT_CP_SPI_MODE_1
			bool "Slave SPI mode 1"

		config EH_TRANSPORT_CP_SPI_MODE_2
			bool "Slave SPI mode 2"

		config EH_TRANSPORT_CP_SPI_MODE_3
			bool "Slave SPI mode 3"
	endchoice

	config EH_TRANSPORT_CP_SPI_MODE_VALUE
		int
		default 0 if EH_TRANSPORT_CP_SPI_MODE_0
		default 1 if EH_TRANSPORT_CP_SPI_MODE_1
		default 2 if EH_TRANSPORT_CP_SPI_MODE_2
		default 3 if EH_TRANSPORT_CP_SPI_MODE_3
		default 3

	choice EH_TRANSPORT_CP_SPI_CONTROLLER
		bool "SPI controller to use"
		default EH_TRANSPORT_CP_SPI_CONTROLLER_HSPI

		config EH_TRANSPORT_CP_SPI_CONTROLLER_HSPI
			bool "FSPI/HSPI"
			help
				HSPI/FSPI: SPI_controller_1

		config EH_TRANSPORT_CP_SPI_CONTROLLER_VSPI
			depends on IDF_TARGET_ESP32
			bool "VSPI"
			help
				VSPI: SPI_controller_2
	endchoice

	config EH_TRANSPORT_CP_SPI_CONTROLLER_NUM
		int
		default 2 if EH_TRANSPORT_CP_SPI_CONTROLLER_VSPI
		default 1

	menu "SPI GPIO Configuration"
		config EH_TRANSPORT_CP_SPI_HSPI_GPIO_MOSI
			depends on EH_TRANSPORT_CP_SPI_CONTROLLER_HSPI
			int "Slave GPIO pin for Host MOSI"
			default 20 if (ESP_HOSTED_P4_DEV_BOARD_FUNC_BOARD || ESP_HOSTED_C2_C5_MODULE_SUB_BOARD)
			default 8 if ESP_HOSTED_P4_C5_CORE_BOARD
			default 20 if ESP_HOSTED_P4_C6_CORE_BOARD || ESP32P4_EYE_C6_BOARD
			default 27 if ESP_HOSTED_P4_C61_CORE_BOARD
			default 8 if ESP_HOSTED_P4X_C5_DEV_BOARD_FUNC_BOARD
			default 13 if IDF_TARGET_ESP32
			default 11 if IDF_TARGET_ESP32S2 || IDF_TARGET_ESP32S3
			default 5 if IDF_TARGET_ESP32H2
			default 1 if IDF_TARGET_ESP32C5 && ESP_ESP32C5_SPI_RASPI_MATING_BOARD
			default 7

		config EH_TRANSPORT_CP_SPI_HSPI_GPIO_MISO
			depends on EH_TRANSPORT_CP_SPI_CONTROLLER_HSPI
			int "Slave GPIO pin for Host MISO"
			default 21 if (ESP_HOSTED_P4_DEV_BOARD_FUNC_BOARD || ESP_HOSTED_C2_C5_MODULE_SUB_BOARD)
			default 7 if ESP_HOSTED_P4_C5_CORE_BOARD
			default 21 if ESP_HOSTED_P4_C6_CORE_BOARD || ESP32P4_EYE_C6_BOARD
			default 28 if ESP_HOSTED_P4_C61_CORE_BOARD
			default 7 if ESP_HOSTED_P4X_C5_DEV_BOARD_FUNC_BOARD
			default 12 if IDF_TARGET_ESP32
			default 13 if IDF_TARGET_ESP32S2 || IDF_TARGET_ESP32S3
			default 0 if IDF_TARGET_ESP32H2
			default 6 if IDF_TARGET_ESP32C5 && ESP_ESP32C5_SPI_RASPI_MATING_BOARD
			default 2

		config EH_TRANSPORT_CP_SPI_HSPI_GPIO_CLK
			depends on EH_TRANSPORT_CP_SPI_CONTROLLER_HSPI
			int "Slave GPIO pin for Host CLK"
			default 19 if (ESP_HOSTED_P4_DEV_BOARD_FUNC_BOARD || ESP_HOSTED_C2_C5_MODULE_SUB_BOARD)
			default 9 if ESP_HOSTED_P4_C5_CORE_BOARD
			default 19 if ESP_HOSTED_P4_C6_CORE_BOARD || ESP32P4_EYE_C6_BOARD
			default 26 if ESP_HOSTED_P4_C61_CORE_BOARD
			default 9 if ESP_HOSTED_P4X_C5_DEV_BOARD_FUNC_BOARD
			default 27 if IDF_TARGET_ESP32C5 && ESP_ESP32C5_SPI_RASPI_MATING_BOARD
			default 3 if IDF_TARGET_ESP32C5 && ESP_HOSTED_CP_FOR_MCU
			default 0 if IDF_TARGET_ESP32C2 && (ESP_HOSTED_P4_DEV_BOARD_FUNC_BOARD || ESP_HOSTED_C2_C5_MODULE_SUB_BOARD)
			default 14 if IDF_TARGET_ESP32
			default 12 if IDF_TARGET_ESP32S2 || IDF_TARGET_ESP32S3
			default 4 if IDF_TARGET_ESP32H2
			default 6

		config EH_TRANSPORT_CP_SPI_HSPI_GPIO_CS
			depends on EH_TRANSPORT_CP_SPI_CONTROLLER_HSPI
			int "Slave GPIO pin for Host CS"
			default 18 if (ESP_HOSTED_P4_DEV_BOARD_FUNC_BOARD || ESP_HOSTED_C2_C5_MODULE_SUB_BOARD)
			default 10 if ESP_HOSTED_P4_C5_CORE_BOARD
			default 18 if ESP_HOSTED_P4_C6_CORE_BOARD || ESP32P4_EYE_C6_BOARD
			default 25 if ESP_HOSTED_P4_C61_CORE_BOARD
			default 10 if ESP_HOSTED_P4X_C5_DEV_BOARD_FUNC_BOARD
			default 15 if IDF_TARGET_ESP32
			default 10 if IDF_TARGET_ESP32S2 || IDF_TARGET_ESP32S3
			default 8 if IDF_TARGET_ESP32C61
			default 1 if IDF_TARGET_ESP32H2
			default 4 if IDF_TARGET_ESP32C5 && ESP_ESP32C5_SPI_RASPI_MATING_BOARD
			default 10

		config EH_TRANSPORT_CP_SPI_VSPI_GPIO_MOSI
			depends on EH_TRANSPORT_CP_SPI_CONTROLLER_VSPI
			int "Slave GPIO pin for Host MOSI"
			default 23

		config EH_TRANSPORT_CP_SPI_VSPI_GPIO_MISO
			depends on EH_TRANSPORT_CP_SPI_CONTROLLER_VSPI
			int "Slave GPIO pin for Host MISO"
			default 19

		config EH_TRANSPORT_CP_SPI_VSPI_GPIO_CLK
			depends on EH_TRANSPORT_CP_SPI_CONTROLLER_VSPI
			int "Slave GPIO pin for Host CLK"
			default 18

		config EH_TRANSPORT_CP_SPI_VSPI_GPIO_CS
			depends on EH_TRANSPORT_CP_SPI_CONTROLLER_VSPI
			int "Slave GPIO pin for Host CS"
			default 5

		config EH_TRANSPORT_CP_SPI_GPIO_MOSI
			int
			default EH_TRANSPORT_CP_SPI_VSPI_GPIO_MOSI if EH_TRANSPORT_CP_SPI_CONTROLLER_VSPI
			default EH_TRANSPORT_CP_SPI_HSPI_GPIO_MOSI

		config EH_TRANSPORT_CP_SPI_GPIO_MISO
			int
			default EH_TRANSPORT_CP_SPI_VSPI_GPIO_MISO if EH_TRANSPORT_CP_SPI_CONTROLLER_VSPI
			default EH_TRANSPORT_CP_SPI_HSPI_GPIO_MISO

		config EH_TRANSPORT_CP_SPI_GPIO_CLK
			int
			default EH_TRANSPORT_CP_SPI_VSPI_GPIO_CLK if EH_TRANSPORT_CP_SPI_CONTROLLER_VSPI
			default EH_TRANSPORT_CP_SPI_HSPI_GPIO_CLK

		config EH_TRANSPORT_CP_SPI_GPIO_CS
			int
			default EH_TRANSPORT_CP_SPI_VSPI_GPIO_CS if EH_TRANSPORT_CP_SPI_CONTROLLER_VSPI
			default EH_TRANSPORT_CP_SPI_HSPI_GPIO_CS

		config EH_TRANSPORT_CP_SPI_GPIO_HANDSHAKE
			int "Slave GPIO pin for handshake"
			default 22 if (ESP_HOSTED_P4_DEV_BOARD_FUNC_BOARD || ESP_HOSTED_C2_C5_MODULE_SUB_BOARD)
			default 14 if ESP_HOSTED_P4_C5_CORE_BOARD
			default 22 if ESP_HOSTED_P4_C6_CORE_BOARD || ESP32P4_EYE_C6_BOARD || ESP_HOSTED_P4_C61_CORE_BOARD
			default 14 if ESP_HOSTED_P4X_C5_DEV_BOARD_FUNC_BOARD
			default 18 if IDF_TARGET_ESP32C2 && (ESP_HOSTED_P4_DEV_BOARD_FUNC_BOARD || ESP_HOSTED_C2_C5_MODULE_SUB_BOARD)
			default 3 if IDF_TARGET_ESP32C2 && !(ESP_HOSTED_P4_DEV_BOARD_FUNC_BOARD || ESP_HOSTED_C2_C5_MODULE_SUB_BOARD)
			default 4 if IDF_TARGET_ESP32C5 && (ESP_HOSTED_P4_DEV_BOARD_FUNC_BOARD || ESP_HOSTED_C2_C5_MODULE_SUB_BOARD)
			# RasPi-mating default (25) must precede the generic C5 !board default
			# below; Kconfig is first-match, and the board is neither func nor
			# module, so a later position let default 1 win (collided with MOSI).
			default 25 if IDF_TARGET_ESP32C5 && ESP_ESP32C5_SPI_RASPI_MATING_BOARD
			default 1 if IDF_TARGET_ESP32C5 && !(ESP_HOSTED_P4_DEV_BOARD_FUNC_BOARD || ESP_HOSTED_C2_C5_MODULE_SUB_BOARD)
			default 3 if IDF_TARGET_ESP32C2 || IDF_TARGET_ESP32C3 || IDF_TARGET_ESP32C5 || IDF_TARGET_ESP32C6
			default 22 if IDF_TARGET_ESP32C61 || IDF_TARGET_ESP32H2
			default 17 if IDF_TARGET_ESP32S3 || IDF_TARGET_ESP32S2
			default 2 if ESP_HOSTED_CP_FOR_LINUX
			default 26

		config EH_TRANSPORT_CP_SPI_GPIO_DATA_READY
			int "Slave GPIO pin for data ready interrupt"
			default 23 if (ESP_HOSTED_P4_DEV_BOARD_FUNC_BOARD || ESP_HOSTED_C2_C5_MODULE_SUB_BOARD)
			default 13 if ESP_HOSTED_P4_C5_CORE_BOARD
			default 23 if ESP_HOSTED_P4_C6_CORE_BOARD || ESP32P4_EYE_C6_BOARD || ESP_HOSTED_P4_C61_CORE_BOARD
			default 13 if ESP_HOSTED_P4X_C5_DEV_BOARD_FUNC_BOARD
			default 1 if IDF_TARGET_ESP32C2 && (ESP_HOSTED_P4_DEV_BOARD_FUNC_BOARD || ESP_HOSTED_C2_C5_MODULE_SUB_BOARD)
			default 4 if IDF_TARGET_ESP32C2 && !(ESP_HOSTED_P4_DEV_BOARD_FUNC_BOARD || ESP_HOSTED_C2_C5_MODULE_SUB_BOARD)
			default 0 if IDF_TARGET_ESP32C5 && (ESP_HOSTED_P4_DEV_BOARD_FUNC_BOARD || ESP_HOSTED_C2_C5_MODULE_SUB_BOARD)
			default 2 if IDF_TARGET_ESP32C5 && ESP_ESP32C5_SPI_RASPI_MATING_BOARD
			default 4 if IDF_TARGET_ESP32C5 && !(ESP_HOSTED_P4_DEV_BOARD_FUNC_BOARD || ESP_HOSTED_C2_C5_MODULE_SUB_BOARD) && ESP_HOSTED_CP_FOR_MCU
			default 12 if IDF_TARGET_ESP32H2
			default 4

		config EH_TRANSPORT_CP_SPI_GPIO_RESET
			int "Slave GPIO pin to reset itself"
			default -1

	endmenu

	config EH_TRANSPORT_CP_SPI_DEASSERT_HS_ON_CS
		bool "Deassert Handshake when SPI CS is deasserted"
		default n if IDF_TARGET_ESP32 && ESP_HOSTED_CP_FOR_LINUX
		default y if ESP_HOSTED_CP_FOR_MCU
		default y

	config EH_TRANSPORT_CP_SPI_TX_Q_SIZE
		int "ESP to Host SPI queue size"
		default 10 if IDF_TARGET_ESP32
		default 6 if IDF_TARGET_ESP32C2 && BT_ENABLED
		default 10 if IDF_TARGET_ESP32C2
		default 20

	config EH_TRANSPORT_CP_SPI_RX_Q_SIZE
		int "Host to ESP SPI queue size"
		default 10 if IDF_TARGET_ESP32
		default 6 if IDF_TARGET_ESP32C2 && BT_ENABLED
		default 7 if IDF_TARGET_ESP32C2
		default 20

	config EH_TRANSPORT_CP_SPI_CHECKSUM
		bool "Enable SPI payload checksum"
		default y
		help
			16-bit sum over header+payload. Upstream default ON. The CP advertises
			ESP_CHECKSUM_ENABLED and the host mirrors it at runtime (agnostic — no
			host-side knob), so this is the single control point.

endmenu
```

## coprocessor/eh_cp_transport/Kconfig.cp.spi_hd
```kconfig
menu "SPI Half-duplex Configuration"
	depends on EH_TRANSPORT_CP_SPI_HD

	choice EH_TRANSPORT_CP_SPI_HD_MODE
		bool "Slave SPI mode"
		default EH_TRANSPORT_CP_SPI_HD_MODE_3

		config EH_TRANSPORT_CP_SPI_HD_MODE_0
			bool "Slave SPI mode 0"

		config EH_TRANSPORT_CP_SPI_HD_MODE_1
			bool "Slave SPI mode 1"

		config EH_TRANSPORT_CP_SPI_HD_MODE_2
			bool "Slave SPI mode 2"

		config EH_TRANSPORT_CP_SPI_HD_MODE_3
			bool "Slave SPI mode 3"
	endchoice

	config EH_TRANSPORT_CP_SPI_HD_MODE_VALUE
		int
		default 0 if EH_TRANSPORT_CP_SPI_HD_MODE_0
		default 1 if EH_TRANSPORT_CP_SPI_HD_MODE_1
		default 2 if EH_TRANSPORT_CP_SPI_HD_MODE_2
		default 3 if EH_TRANSPORT_CP_SPI_HD_MODE_3

	choice EH_TRANSPORT_CP_SPI_HD_DATA_LINES
		bool "Number of Data Lines"
		default EH_TRANSPORT_CP_SPI_HD_4_DATA_LINES

		config EH_TRANSPORT_CP_SPI_HD_4_DATA_LINES
			bool "4 data lines"

		config EH_TRANSPORT_CP_SPI_HD_2_DATA_LINES
			bool "2 data lines"

		config EH_TRANSPORT_CP_SPI_HD_1_DATA_LINE
			bool "1 data line"
	endchoice

	config EH_TRANSPORT_CP_SPI_HD_NUM_DATA_LINES
		int
		default 4 if EH_TRANSPORT_CP_SPI_HD_4_DATA_LINES
		default 2 if EH_TRANSPORT_CP_SPI_HD_2_DATA_LINES
		default 1

	menu "SPI HD GPIO Configuration"
		config EH_TRANSPORT_CP_SPI_HD_GPIO_CS
			int "CS GPIO pin"
			default 18 if (ESP_HOSTED_P4_DEV_BOARD_FUNC_BOARD || ESP_HOSTED_C2_C5_MODULE_SUB_BOARD)
			default 10 if ESP_HOSTED_P4_C5_CORE_BOARD
			default 18 if ESP_HOSTED_P4_C6_CORE_BOARD || ESP32P4_EYE_C6_BOARD
			default 25 if ESP_HOSTED_P4_C61_CORE_BOARD
			default 10 if ESP_HOSTED_P4X_C5_DEV_BOARD_FUNC_BOARD
			default 8 if IDF_TARGET_ESP32C61
			default 10

		config EH_TRANSPORT_CP_SPI_HD_GPIO_CLK
			int "CLK GPIO pin"
			default 19 if (ESP_HOSTED_P4_DEV_BOARD_FUNC_BOARD || ESP_HOSTED_C2_C5_MODULE_SUB_BOARD)
			default 9 if ESP_HOSTED_P4_C5_CORE_BOARD
			default 19 if ESP_HOSTED_P4_C6_CORE_BOARD || ESP32P4_EYE_C6_BOARD
			default 26 if ESP_HOSTED_P4_C61_CORE_BOARD
			default 9 if ESP_HOSTED_P4X_C5_DEV_BOARD_FUNC_BOARD
			default 3 if IDF_TARGET_ESP32C5
			default 0 if IDF_TARGET_ESP32C2
			default 6

		config EH_TRANSPORT_CP_SPI_HD_GPIO_D0
			int "D0 GPIO pin"
			default 20 if (ESP_HOSTED_P4_DEV_BOARD_FUNC_BOARD || ESP_HOSTED_C2_C5_MODULE_SUB_BOARD)
			default 8 if ESP_HOSTED_P4_C5_CORE_BOARD
			default 20 if ESP_HOSTED_P4_C6_CORE_BOARD || ESP32P4_EYE_C6_BOARD
			default 27 if ESP_HOSTED_P4_C61_CORE_BOARD
			default 8 if ESP_HOSTED_P4X_C5_DEV_BOARD_FUNC_BOARD
			default 7

		config EH_TRANSPORT_CP_SPI_HD_GPIO_D1
			int "D1 GPIO pin"
			default 21 if (ESP_HOSTED_P4_DEV_BOARD_FUNC_BOARD || ESP_HOSTED_C2_C5_MODULE_SUB_BOARD)
			default 7 if ESP_HOSTED_P4_C5_CORE_BOARD
			default 21 if ESP_HOSTED_P4_C6_CORE_BOARD || ESP32P4_EYE_C6_BOARD
			default 28 if ESP_HOSTED_P4_C61_CORE_BOARD
			default 7 if ESP_HOSTED_P4X_C5_DEV_BOARD_FUNC_BOARD
			default 2

		config EH_TRANSPORT_CP_SPI_HD_GPIO_D2
			depends on EH_TRANSPORT_CP_SPI_HD_4_DATA_LINES
			int "D2 GPIO pin"
			default 22 if (ESP_HOSTED_P4_DEV_BOARD_FUNC_BOARD || ESP_HOSTED_C2_C5_MODULE_SUB_BOARD)
			default 14 if ESP_HOSTED_P4_C5_CORE_BOARD
			default 22 if ESP_HOSTED_P4_C6_CORE_BOARD || ESP32P4_EYE_C6_BOARD || ESP_HOSTED_P4_C61_CORE_BOARD
			default 14 if ESP_HOSTED_P4X_C5_DEV_BOARD_FUNC_BOARD
			default 4 if IDF_TARGET_ESP32C61
			default 5

		config EH_TRANSPORT_CP_SPI_HD_GPIO_D3
			depends on EH_TRANSPORT_CP_SPI_HD_4_DATA_LINES
			int "D3 GPIO pin"
			default 23 if (ESP_HOSTED_P4_DEV_BOARD_FUNC_BOARD || ESP_HOSTED_C2_C5_MODULE_SUB_BOARD)
			default 13 if ESP_HOSTED_P4_C5_CORE_BOARD
			default 23 if ESP_HOSTED_P4_C6_CORE_BOARD || ESP32P4_EYE_C6_BOARD || ESP_HOSTED_P4_C61_CORE_BOARD
			default 13 if ESP_HOSTED_P4X_C5_DEV_BOARD_FUNC_BOARD
			default 3 if IDF_TARGET_ESP32C61
			default 4

		config EH_TRANSPORT_CP_SPI_HD_GPIO_DATA_READY
			int "Data Ready GPIO pin"
			default 2 if (ESP_HOSTED_P4_DEV_BOARD_FUNC_BOARD || ESP_HOSTED_C2_C5_MODULE_SUB_BOARD)
			default 28 if ESP_HOSTED_P4_C5_CORE_BOARD
			default 9 if ESP_HOSTED_P4_C6_CORE_BOARD || ESP32P4_EYE_C6_BOARD || ESP_HOSTED_P4_C61_CORE_BOARD
			default 2 if ESP_HOSTED_P4X_C5_DEV_BOARD_FUNC_BOARD
			default 0 if IDF_TARGET_ESP32C5
			default 1 if IDF_TARGET_ESP32C2
			default 23 if IDF_TARGET_ESP32C61
			default 11

		choice EH_TRANSPORT_CP_SPI_HD_DR_ACTIVE
			bool "DataReady GPIO Active Level"
			default EH_TRANSPORT_CP_SPI_HD_DR_ACTIVE_HIGH

			config EH_TRANSPORT_CP_SPI_HD_DR_ACTIVE_HIGH
				bool "Active High"
			config EH_TRANSPORT_CP_SPI_HD_DR_ACTIVE_LOW
				bool "Active Low"
		endchoice

		config EH_TRANSPORT_CP_SPI_HD_GPIO_RESET
			int "Reset GPIO pin"
			default -1

	endmenu

	config EH_TRANSPORT_CP_SPI_HD_Q_SIZE
		int "Queue size"
		default 12 if IDF_TARGET_ESP32C2
		default 10 if IDF_TARGET_ESP32C5
		default 10 if IDF_TARGET_ESP32C61
		default 20

	config EH_TRANSPORT_CP_SPI_HD_CHECKSUM
		bool "Enable SPI-HD payload checksum"
		default y
		help
			16-bit sum over header+payload. Upstream default ON. The CP advertises
			ESP_CHECKSUM_ENABLED and the host mirrors it at runtime (agnostic — no
			host-side knob), so this is the single control point.

endmenu
```
