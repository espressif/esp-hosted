## coprocessor/eh_cp_transport/Kconfig.ext
```kconfig
menu "CP transport"
	depends on ESP_HOSTED_CP

	choice EH_TRANSPORT_CP_INTERFACE
		depends on ESP_HOSTED_CP
		prompt "Communication bus (co-processor <== bus ==> host)"
		default EH_TRANSPORT_CP_SDIO if SOC_SDIO_SLAVE_SUPPORTED
		default EH_TRANSPORT_CP_SPI if SOC_GPSPI_SUPPORTED

	config EH_TRANSPORT_CP_SPI
		bool "SPI Full Duplex"
		depends on SOC_GPSPI_SUPPORTED

	config EH_TRANSPORT_CP_SDIO
		bool "SDIO"
		depends on SOC_SDIO_SLAVE_SUPPORTED

	config EH_TRANSPORT_CP_SPI_HD
		bool "SPI Half Duplex"
		depends on SOC_GPSPI_SUPPORTED && ESP_HOSTED_CP_FOR_MCU

	config EH_TRANSPORT_CP_UART
		bool "UART"
		depends on SOC_UART_SUPPORTED && ESP_HOSTED_CP_FOR_MCU
	endchoice

# Memory pool configuration
	config ESP_CACHE_MALLOC
		depends on ESP_HOSTED_CP
		bool "Enable Mempool"
		default n if IDF_TARGET_ESP32C2 && ESP_HOSTED_CP_FOR_LINUX
		default y if ESP_HOSTED_CP_FOR_MCU
		default y
		help
			Mempool will help to alloc buffer without going to heap for every memory allocation or free

orsource "./Kconfig.cp.spi"
orsource "./Kconfig.cp.sdio"
orsource "./Kconfig.cp.spi_hd"
orsource "./Kconfig.cp.uart"

	menu "Transport Test"
		config ESP_RAW_THROUGHPUT_TRANSPORT
			bool
			default y
			help
				RawTP support is always compiled in. The slave stays idle
				until the host selects a direction at runtime.

		config ESP_RAW_TP_ESP_TO_HOST_PKT_LEN
			depends on ESP_RAW_THROUGHPUT_TRANSPORT
			int "RawTP: ESP to Host packet size"
			range 1 1500
			default 1460

		config ESP_RAW_TP_REPORT_INTERVAL
			depends on ESP_RAW_THROUGHPUT_TRANSPORT
			int "RawTP: periodic duration to report stats accumulated"
			default 1 if ESP_HOSTED_CP_FOR_LINUX_802_3
			default 10 if ESP_HOSTED_CP_FOR_MCU
			default 1
	endmenu

endmenu
```

## coprocessor/features/eh_cp_feat_cli/Kconfig.ext
```kconfig
menuconfig ESP_HOSTED_CP_FEAT_CLI
	bool "CLI Shell"
	depends on ESP_HOSTED_CP && ESP_HOSTED_CP_FOR_MCU
	default y if ESP_HOSTED_CP_FEAT_HOST_PS
	default n if !ESP_HOSTED_CP_FEAT_HOST_PS
	help
		Enable CLI shell for debugging and control purposes.

if ESP_HOSTED_CP_FEAT_CLI

	config ESP_HOSTED_CP_FEAT_CLI_READY
		bool
		default y if ESP_HOSTED_CP_FOR_MCU

	config ESP_HOSTED_CP_FEAT_CLI_AUTO_INIT
		bool "Auto-initialise CLI Shell at boot"
		default y if ESP_HOSTED_CP_FEAT_CLI_READY && ESP_HOSTED_CP_AUTO_FEAT_INIT
		default n
		depends on ESP_HOSTED_CP_AUTO_FEAT_INIT
		help
			When enabled, CLI auto-initialises during eh_cp_init().
			Disable to manually call eh_cp_feat_cli_start() from app code.

	config ESP_HOSTED_CP_CLI_NEW_INSTANCE
		bool "Create new instance & do not re-use existing session if any"
		default y

endif # ESP_HOSTED_CP_FEAT_CLI
```

## coprocessor/features/eh_cp_feat_debug/Kconfig.ext
```kconfig
menuconfig ESP_HOSTED_CP_FEAT_DEBUG
	bool "Debug Utilities"
	depends on ESP_HOSTED_CP
	default n
	help
		CP-side debug utilities.  Heap stats and the RPC-driven
		memory monitor are toggled as sub-features below.

if ESP_HOSTED_CP_FEAT_DEBUG

	config ESP_HOSTED_CP_FEAT_DEBUG_READY
		bool
		default y

	config ESP_HOSTED_CP_FEAT_DEBUG_AUTO_INIT
		bool "Auto-initialise Debug Utilities at boot"
		default y if ESP_HOSTED_CP_FEAT_DEBUG_READY && ESP_HOSTED_CP_AUTO_FEAT_INIT
		default n
		depends on ESP_HOSTED_CP_AUTO_FEAT_INIT
		help
			When enabled, Debug Utilities auto-initialises during
			eh_cp_init().  Disable to manually call the init from app code.

	menuconfig ESP_HOSTED_CP_FEAT_DEBUG_HEAP_STATS
		bool "Heap stats and leak tracing"
		default y
		help
			Exposes eh_cp_feat_debug_heap_log() and the
			heap_cycle_begin/end APIs.  Each call prints free heap
			and minimum-ever-free heap.

	if ESP_HOSTED_CP_FEAT_DEBUG_HEAP_STATS

		config ESP_HOSTED_CP_FEAT_DEBUG_HEAP_STATS_READY
			bool
			default y

		config ESP_HOSTED_CP_FEAT_DEBUG_HEAP_TRACING
			bool "Heap leak tracing on cycle boundaries"
			default n
			depends on HEAP_TRACING_STANDALONE
			help
				Starts a HEAP_TRACE_LEAKS session at cycle begin
				and dumps it at cycle end.  Requires
				CONFIG_HEAP_TRACING_STANDALONE.

		config ESP_HOSTED_CP_FEAT_DEBUG_HEAP_TRACE_RECORDS
			int "Heap trace records buffer size"
			default 200
			range 10 1000
			depends on ESP_HOSTED_CP_FEAT_DEBUG_HEAP_TRACING

	endif # HEAP_STATS

	menuconfig ESP_HOSTED_CP_FEAT_DEBUG_MEM_MONITOR
		bool "Memory monitor"
		depends on ESP_HOSTED_CP_FEAT_RPC_EXT_V2_READY
		default n
		help
			Periodic multi-region heap sampler configured from the
			host over RPC (thresholds per heap region, interval,
			report-always).  Reports back via
			RPC_ID__Event_MemMonitor.  Used by
			examples/mem_monitor/.

	if ESP_HOSTED_CP_FEAT_DEBUG_MEM_MONITOR

		config ESP_HOSTED_CP_FEAT_DEBUG_MEM_MONITOR_READY
			bool
			default y

	endif # MEM_MONITOR

	comment "⚠  RPC MCU feature required for Memory monitor"
		depends on !ESP_HOSTED_CP_FEAT_RPC_EXT_V2_READY

endif # ESP_HOSTED_CP_FEAT_DEBUG
```

## coprocessor/features/eh_cp_feat_gpio_exp/Kconfig.ext
```kconfig
menuconfig ESP_HOSTED_CP_FEAT_GPIO_EXP
	bool "GPIO Expander"
	depends on ESP_HOSTED_CP
	default n
	help
		Enables remote GPIO control from the host via RPC.

if ESP_HOSTED_CP_FEAT_GPIO_EXP

	config ESP_HOSTED_CP_FEAT_GPIO_EXP_READY
		bool
		default y

	config ESP_HOSTED_CP_FEAT_GPIO_EXP_AUTO_INIT
		bool "Auto-initialise GPIO Expander at boot"
		default y if ESP_HOSTED_CP_FEAT_GPIO_EXP_READY && ESP_HOSTED_CP_AUTO_FEAT_INIT
		default n
		depends on ESP_HOSTED_CP_AUTO_FEAT_INIT
		help
			When enabled, GPIO Expander auto-initialises during
			eh_cp_init().  Disable to manually call the init from app code.

endif # ESP_HOSTED_CP_FEAT_GPIO_EXP
```

## coprocessor/features/eh_cp_feat_host_ps/Kconfig.ext
```kconfig
menuconfig ESP_HOSTED_CP_FEAT_HOST_PS
	bool "Host Power Save"
	depends on ESP_HOSTED_CP_FOR_MCU
	default n
	help
		Allow host to enter power save mode.
		Host will notify slave before entering and exiting the power save

if ESP_HOSTED_CP_FEAT_HOST_PS

	config ESP_HOSTED_CP_FEAT_HOST_PS_READY
		bool
		default y if ESP_HOSTED_CP_FOR_MCU

	config ESP_HOSTED_CP_FEAT_HOST_PS_AUTO_INIT
		bool "Auto-initialise Host Power Save at boot"
		default y if ESP_HOSTED_CP_FEAT_HOST_PS_READY && ESP_HOSTED_CP_AUTO_FEAT_INIT
		default n
		depends on ESP_HOSTED_CP_AUTO_FEAT_INIT
		help
			When enabled, Host Power Save auto-initialises during
			eh_cp_init().  Disable to manually call the init from app code
			(e.g. examples that pass host-PS event callbacks at init time).

	menuconfig ESP_HOSTED_CP_FEAT_HOST_PS_DEEP_SLEEP
		bool "Allow host to enter deep sleep. Slave will wakeup host using GPIO when needed"
		default y
		help
			Allow host to enter deep sleep mode. Host will notify slave before entering deep sleep.

	if ESP_HOSTED_CP_FEAT_HOST_PS_DEEP_SLEEP
	menu "Host deep sleep - wakeup config"
		config ESP_HOSTED_CP_FEAT_HOST_PS_WAKE_HOST_ON_CP_BOOT
			bool "Wake the host once when this coprocessor boots"
			default y
			help
			    Pulse the host-wakeup GPIO exactly once, during our own
			    initialisation, so a host that is deep-sleeping learns that this
			    coprocessor restarted.

			    Without it, a coprocessor restart while the host sleeps is
			    unrecoverable and silent: the host only wakes on that line, and
			    we only drive it when traffic arrives for the host - but traffic
			    needs an association, and the association is driven by the host.
			    Nothing breaks the cycle, so the pair stays down until the host
			    is power-cycled by hand.

			    Fires once at boot only. Everything after that respects the
			    normal host power-save handshake. Requires a valid wakeup GPIO.

		config ESP_HOSTED_CP_FEAT_HOST_PS_HOST_WAKEUP_GPIO
			int "Slave out: Host wakeup GPIO"
			default 23 if IDF_TARGET_ESP32 && !SPI_VSPI
			default 2 if ESP_HOSTED_P4_DEV_BOARD_FUNC_BOARD && !EH_TRANSPORT_CP_SPI_HD
			default 9 if ESP_HOSTED_P4_DEV_BOARD_FUNC_BOARD && EH_TRANSPORT_CP_SPI_HD
			default 2 if ESP_HOSTED_P4X_C5_DEV_BOARD_FUNC_BOARD && !EH_TRANSPORT_CP_SPI_HD
			default 28 if ESP_HOSTED_P4X_C5_DEV_BOARD_FUNC_BOARD && EH_TRANSPORT_CP_SPI_HD
			default 3 if ESP_HOSTED_P4_C5_CORE_BOARD
			default 2 if ESP32P4_TAB5_C6_BOARD
			default -1 if ESP_HOSTED_P4_C6_CORE_BOARD || ESP_HOSTED_P4_C61_CORE_BOARD || ESP32P4_EYE_C6_BOARD
			default 1 if IDF_TARGET_ESP32C3
			default 6 if IDF_TARGET_ESP32C2 && (ESP_HOSTED_P4_DEV_BOARD_FUNC_BOARD || ESP_HOSTED_C2_C5_MODULE_SUB_BOARD)
			default -1
		choice ESP_HOSTED_CP_FEAT_HOST_PS_HOST_WAKEUP_GPIO_LEVEL
			prompt "Host Wakeup GPIO Level"
			default ESP_HOSTED_CP_FEAT_HOST_PS_HOST_WAKEUP_GPIO_LEVEL_HIGH

			config ESP_HOSTED_CP_FEAT_HOST_PS_HOST_WAKEUP_GPIO_LEVEL_HIGH
				bool "High"
			config ESP_HOSTED_CP_FEAT_HOST_PS_HOST_WAKEUP_GPIO_LEVEL_LOW
				bool "Low"
		endchoice

		config ESP_HOSTED_CP_FEAT_HOST_PS_HOST_WAKEUP_GPIO_LEVEL
			int
			default 1 if ESP_HOSTED_CP_FEAT_HOST_PS_HOST_WAKEUP_GPIO_LEVEL_HIGH
			default 0 if ESP_HOSTED_CP_FEAT_HOST_PS_HOST_WAKEUP_GPIO_LEVEL_LOW
			help
				GPIO level to use for host wakeup from sleep.
				Set to 0 to use low level, set to 1 to use high level.
	endmenu
	endif # ESP_HOSTED_CP_FEAT_HOST_PS_DEEP_SLEEP

	config ESP_HOSTED_CP_FEAT_HOST_PS_UNLOAD_BUS_WHILE_SLEEPING
		bool "Unload low level BUS driver during host deep sleep"
		default y
		help
			Default y because it is the enabling condition for CP light
			sleep, not an optimisation: with the bus driver still
			installed the chip never really sleeps. It also made the
			transports disagree - sdio_deinit runs unconditionally while
			uart/spi/spi_hd wrap their whole body in this option, so at
			the old default n three of four never unloaded at all.

	config ESP_HOSTED_CP_FEAT_HOST_PS_PRINT_FULL_WAKEUP_PACKET
		bool "Print the full wakeup packet"
		default n

endif # ESP_HOSTED_CP_FEAT_HOST_PS
```

## coprocessor/features/eh_cp_feat_peer_data/Kconfig.ext
```kconfig
menuconfig ESP_HOSTED_CP_FEAT_PEER_DATA
	bool "Peer Data Transfer"
	depends on ESP_HOSTED_CP
	default n

if ESP_HOSTED_CP_FEAT_PEER_DATA

	config ESP_HOSTED_CP_FEAT_PEER_DATA_READY
		bool
		default y if ESP_HOSTED_CP

	config ESP_HOSTED_CP_FEAT_PEER_DATA_AUTO_INIT
		bool "Auto-initialise Peer Data Transfer at boot"
		default y if ESP_HOSTED_CP_FEAT_PEER_DATA_READY && ESP_HOSTED_CP_AUTO_FEAT_INIT
		default n
		depends on ESP_HOSTED_CP_AUTO_FEAT_INIT
		help
			When enabled, Peer Data Transfer auto-initialises during
			eh_cp_init().  Disable to manually call the init from app code.

endif # ESP_HOSTED_CP_FEAT_PEER_DATA
```

## coprocessor/features/eh_cp_feat_rpc_ext_v1/Kconfig.ext
```kconfig
config ESP_HOSTED_CP_FEAT_RPC_EXT_V1
	bool
	depends on ESP_HOSTED_CP_FEAT_RPC
	depends on ESP_HOSTED_CP_RPC_V1
	default y

config ESP_HOSTED_CP_FEAT_RPC_EXT_V1_READY
    bool
    default y if ESP_HOSTED_CP_FEAT_RPC && ESP_HOSTED_CP_RPC_V1

config ESP_HOSTED_CP_FEAT_RPC_EXT_V1_AUTO_INIT
	bool
	default y if ESP_HOSTED_CP_FEAT_RPC_EXT_V1_READY && ESP_HOSTED_CP_FEAT_RPC_AUTO_INIT && ESP_HOSTED_CP_AUTO_FEAT_INIT
	default n
	depends on ESP_HOSTED_CP_FEAT_RPC_EXT_V1_READY
	depends on ESP_HOSTED_CP_AUTO_FEAT_INIT
	help
		Derived from the RPC mode choice and ESP_HOSTED_CP_FEAT_RPC_AUTO_INIT.
		Registers the Linux-FG request-id range with the CP's RPC dispatcher.
```

## coprocessor/features/eh_cp_feat_system/Kconfig.ext
```kconfig
config ESP_HOSTED_CP_FEAT_SYSTEM
	bool
	depends on ESP_HOSTED_CP
	default y
	help
	  System (OTA, heartbeat, FW version) on the co-processor. The host
	  relies on this surface (e.g. OTA-to-CP), so it is always enabled and
	  intentionally not shown as an editable option in menuconfig.

if ESP_HOSTED_CP_FEAT_SYSTEM

	config ESP_HOSTED_CP_FEAT_SYSTEM_READY
		bool
		default y

	config ESP_HOSTED_CP_FEAT_SYSTEM_AUTO_INIT
		bool "Auto-initialise System at boot"
		default y if ESP_HOSTED_CP_FEAT_SYSTEM_READY && ESP_HOSTED_CP_AUTO_FEAT_INIT
		default n
		depends on ESP_HOSTED_CP_AUTO_FEAT_INIT
		help
			When enabled, System (OTA / heartbeat / FW version)
			auto-initialises during eh_cp_init().  Disable to manually
			call the init from app code.

endif # ESP_HOSTED_CP_FEAT_SYSTEM
```

## examples/bluetooth/bluedroid_hosted_hci/ble_advertise_minimal/mcu_host/main/Kconfig.projbuild
```kconfig
menu "BLE Advertise Minimal config"

config EXAMPLE_DEVICE_NAME
    string "BLE device name (advertised)"
    default "ESP_HOSTED_BLE"

config EXAMPLE_ADV_INTERVAL_MS
    int "Advertising interval (ms)"
    default 100
    range 20 10240
    help
      Advertising interval as seen by Bluedroid's `adv_int_min/max`.
      Converted to 0.625 ms units internally.

config EXAMPLE_USE_SETUP_HELPER
    bool "Use one-shot eh_host_bluedroid_init() helper"
    default y
    help
      If y, app_main() calls the port helper eh_host_bluedroid_init(),
      which does controller_init+enable+attach_hci_driver in one line.
      If n, app_main() calls each step individually (useful for
      learning the sequence or for finer error handling).

endmenu
```

## examples/bluetooth/cp/standard_hci_uart/sdkconfig.defaults.esp32
```kconfig
CONFIG_ESP32_DEFAULT_CPU_FREQ_240=y

# BT Configuration
CONFIG_BT_ENABLED=y
CONFIG_BT_CONTROLLER_ONLY=y
CONFIG_BT_BLUEDROID_ENABLED=
CONFIG_BTDM_CONTROLLER_MODE_BTDM=y
CONFIG_BTDM_CTRL_AUTO_LATENCY=y
CONFIG_BTDM_CONTROLLER_MODEM_SLEEP=y
CONFIG_BTDM_CTRL_MODEM_SLEEP=y

# BT over UART
CONFIG_BTDM_CONTROLLER_HCI_MODE_UART_H4=y
CONFIG_BTDM_CTRL_HCI_MODE_UART_H4=y

#CO-EX config
CONFIG_FREERTOS_UNICORE=n
CONFIG_BTDM_CONTROLLER_PINNED_TO_CORE=0
CONFIG_BTDM_CTRL_PINNED_TO_CORE=0
CONFIG_BTDM_CTRL_PINNED_TO_CORE_0=y


# OTA
CONFIG_ESPTOOLPY_FLASHSIZE_4MB=y

# partitions
CONFIG_PARTITION_TABLE_CUSTOM=y
CONFIG_PARTITION_TABLE_CUSTOM_FILENAME="partitions_eh_cp_ota_4m.csv"

# iram optimization
CONFIG_ESP_SYSTEM_ESP32_SRAM1_REGION_AS_IRAM=y

CONFIG_COMPILER_OPTIMIZATION_PERF=y
#CONFIG_FREERTOS_GENERATE_RUN_TIME_STATS=y

# OS
CONFIG_BOOTLOADER_COMPILER_OPTIMIZATION_SIZE=y
CONFIG_BOOTLOADER_COMPILER_OPTIMIZATION_PERF=n
```

## examples/bluetooth/cp/wifi_standard_hci_uart/main/Kconfig.projbuild
```kconfig
menu "Bluetooth CP wifi_standard_hci_uart"

config EXAMPLE_WIFI_STANDARD_HCI_UART_CP
    bool "Enable Wi-Fi + BT(UART-H4) CP profile"
    default y
    help
      This example enables Wi-Fi and Bluetooth controller-only mode on CP,
      with BT HCI on direct UART H4 path.

endmenu
```

## examples/bluetooth/esp_hosted_bluedroid/ble_advertise_minimal/mcu_host/main/Kconfig.projbuild
```kconfig
menu "BLE Advertise Minimal config"

config EXAMPLE_DEVICE_NAME
    string "BLE device name (advertised)"
    default "ESP_HOSTED_BLE"

config EXAMPLE_ADV_INTERVAL_MS
    int "Advertising interval (ms)"
    default 100
    range 20 10240
    help
      Advertising interval as seen by Bluedroid's `adv_int_min/max`.
      Converted to 0.625 ms units internally.

endmenu
```
