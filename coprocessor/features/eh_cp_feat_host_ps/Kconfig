## coprocessor/features/eh_cp_feat_wifi_ext_dpp/Kconfig.ext
```kconfig
config ESP_HOSTED_CP_FEAT_WIFI_EXT_DPP
    bool "WiFi DPP (Device Provisioning Protocol) feature extension"
    depends on ESP_HOSTED_CP_FEAT_WIFI
    default n
    help
        Enables WiFi Easy Connect (DPP): supplicant and WiFi DPP event paths.

comment "⚠️  Enable [✓] ESP_WIFI_DPP_SUPPORT  (Component config → Wi-Fi → DPP)"
    depends on ESP_HOSTED_CP_FEAT_WIFI_EXT_DPP && !ESP_WIFI_DPP_SUPPORT

config ESP_HOSTED_CP_FEAT_WIFI_EXT_DPP_READY
    bool
    default y if ESP_HOSTED_CP_FEAT_WIFI_EXT_DPP && ESP_WIFI_DPP_SUPPORT
```

## coprocessor/features/eh_cp_feat_wifi_ext_ent/Kconfig.ext
```kconfig
config ESP_HOSTED_CP_FEAT_WIFI_EXT_ENT
    bool "WiFi Enterprise (802.1X) feature extension"
    depends on ESP_HOSTED_CP_FEAT_WIFI
    default n
    help
        Enables WiFi Enterprise (EAP) support: identity, certs, TTLS, FAST, Suite-B.

comment "⚠️  Enable [✓] ESP_WIFI_ENTERPRISE_SUPPORT  (Component config → Wi-Fi → Enterprise)"
    depends on ESP_HOSTED_CP_FEAT_WIFI_EXT_ENT && !ESP_WIFI_ENTERPRISE_SUPPORT

config ESP_HOSTED_CP_FEAT_WIFI_EXT_ENT_READY
    bool
    default y if ESP_HOSTED_CP_FEAT_WIFI_EXT_ENT && ESP_WIFI_ENTERPRISE_SUPPORT
```

## coprocessor/features/eh_cp_feat_wifi_ext_itwt/Kconfig.ext
```kconfig
config ESP_HOSTED_CP_FEAT_WIFI_EXT_ITWT
    bool "WiFi iTWT (individual Target Wake Time) feature extension"
    depends on ESP_HOSTED_CP_FEAT_WIFI
    default n
    help
        Enables iTWT (802.11ax Target Wake Time) support.

comment "⚠️  Requires SOC with WiFi HE support (CONFIG_SOC_WIFI_HE_SUPPORT)"
    depends on ESP_HOSTED_CP_FEAT_WIFI_EXT_ITWT && !SOC_WIFI_HE_SUPPORT

config ESP_HOSTED_CP_FEAT_WIFI_EXT_ITWT_READY
    bool
    default y if ESP_HOSTED_CP_FEAT_WIFI_EXT_ITWT && SOC_WIFI_HE_SUPPORT
```

## esp/esp_driver/network_adapter/main/Kconfig.projbuild
```kconfig
menu "Example Configuration"

    choice ESP_HOST_INTERFACE
        bool "Transport layer"
        default ESP_SDIO_HOST_INTERFACE
        help
	    Bus interface to be used for communication with the host

        config ESP_SDIO_HOST_INTERFACE
            bool "SDIO interface"
            help
                Enable/Disable SDIO host interface

        config ESP_SPI_HOST_INTERFACE
            bool "SPI interface"
            help
                Enable/Disable SPI host interface
    endchoice

    config ESP_SERIAL_DEBUG
        bool "Debug Serial driver data path"
        default 0
        help
            Enable/disable debug prints in serial driver data path

    config ESP_WLAN_DEBUG
        bool "Debug Wlan driver data path"
        default 0
        help
            Enable/disable debug prints in wlan driver data path

    config ESP_SPI_CONTROLLER
        int "SPI controller to use"
        default 3
	range 2 3
        help
            SPI controller to be used. HSPI->2, VSPI->3

    config ESP_SPI_GPIO_HANDSHAKE
        int "GPIO pin for handshake"
        default 2
        help
            GPIO pin to use for handshake with other spi controller

    config ESP_SPI_GPIO_DATA_READY
        int "GPIO pin for data ready interrupt"
        default 4
        help
            GPIO pin for indicating host that SPI slave has data to be read by host

endmenu
```

## esp/esp_driver/network_adapter/sdkconfig.defaults
```kconfig
CONFIG_ESP32_DEFAULT_CPU_FREQ_160=y
CONFIG_ESP32_DEFAULT_CPU_FREQ_MHZ=160
CONFIG_FREERTOS_UNICORE=y
CONFIG_SDIO_DAT2_DISABLED=

# BT Configuration
CONFIG_BT_ENABLED=y
CONFIG_BT_CONTROLLER_ONLY=y
CONFIG_BT_BLUEDROID_ENABLED=
CONFIG_BTDM_CONTROLLER_MODE_BTDM=y
CONFIG_BTDM_CONTROLLER_HCI_MODE_VHCI=y

# SPI config
# possible values CONFIG_ESP_SPI_CONTROLLER for are 2 and 3
CONFIG_ESP_SPI_CONTROLLER=2

#Used GPIO number for handshake for SPI
CONFIG_ESP_SPI_GPIO_HANDSHAKE=2

CONFIG_ESP32_WIFI_NVS_ENABLED=
```

## esp_hosted_fg/esp/esp_driver/network_adapter/components/iperf/Kconfig
```kconfig
menu "Iperf"

    config IPERF_SOCKET_RX_TIMEOUT
        int "iperf socket TCP/UDP rx timeout in seconds"
        default 10
        help
            The value is used for iperf socket TCP/UDP rx timeout, iperf will be aborted
            and socket will be closed and shutdown.

    config IPERF_SOCKET_TCP_TX_TIMEOUT
        int "iperf socket TCP tx timeout in seconds"
        default 10
        help
            The value is used for iperf socket TCP tx timeout, iperf will be aborted
            and socket will be closed and shutdown.

    config IPERF_TRAFFIC_TASK_PRIORITY
        int "iperf traffic task priority"
        default 4
        help
           The value is used for iperf traffic task priority.

    config IPERF_REPORT_TASK_PRIORITY
        int "iperf result report task priority"
        default 6
        help
           The value is used for iperf result report task priority.

    config IPERF_DEF_TCP_TX_BUFFER_LEN
        int "default tcp tx buffer length"
        default 16384
        help
           The value of default tcp tx buffer length.

    config IPERF_DEF_TCP_RX_BUFFER_LEN
        int "default tcp rx buffer length"
        default 16384
        help
           The value of default tcp rx buffer length.

    config IPERF_DEF_IPV4_UDP_TX_BUFFER_LEN
        int "default ipv4 udp tx buffer length"
        default 1470
        help
           The value of default ipv4 udp tx buffer length.

    config IPERF_DEF_IPV6_UDP_TX_BUFFER_LEN
        int "default ipv6 udp tx buffer length"
        default 1450
        help
           The value of default ipv6 udp tx buffer length.

    config IPERF_DEF_UDP_RX_BUFFER_LEN
        int "default udp rx buffer length"
        default 16384
        help
           The value of default udp rx buffer length.
           Not recommended to set the value too small due to udp does not support fragmentation.

endmenu
```
