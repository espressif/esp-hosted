## esp_hosted_fg/esp/main/Kconfig.projbuild
```kconfig
menu "Example Configuration"

    choice ESP_HOST_INTERFACE
        bool "Transport layer"
        default ESP_SDIO_HOST_INTERFACE if IDF_TARGET_ESP32
        default ESP_SPI_HOST_INTERFACE if IDF_TARGET_ESP32S2
        default ESP_SPI_HOST_INTERFACE if IDF_TARGET_ESP32S3
        default ESP_SPI_HOST_INTERFACE if IDF_TARGET_ESP32C2
        default ESP_SPI_HOST_INTERFACE if IDF_TARGET_ESP32C3
        default ESP_SPI_HOST_INTERFACE if IDF_TARGET_ESP32C6
        help
            Bus interface to be used for communication with the host

        config ESP_SDIO_HOST_INTERFACE
            bool "SDIO interface"
            depends on IDF_TARGET_ESP32 || IDF_TARGET_ESP32C6
            help
                Enable/Disable SDIO host interface

		config ESP_SPI_HOST_INTERFACE
			bool "SPI interface"
			help
				Enable/Disable SPI host interface
	endchoice

	menu "SPI Configuration"
		depends on ESP_SPI_HOST_INTERFACE

		choice ESP_SPI_PRIV_MODE
			bool "Slave SPI mode"
			default ESP_SPI_PRIV_MODE_2

			config ESP_SPI_PRIV_MODE_0
				bool "Slave SPI mode 0"

			config ESP_SPI_PRIV_MODE_1
				bool "Slave SPI mode 1"

			config ESP_SPI_PRIV_MODE_2
				bool "Slave SPI mode 2"

			config ESP_SPI_PRIV_MODE_3
				bool "Slave SPI mode 3"
		endchoice

		config ESP_SPI_MODE
			int
			default 0 if ESP_SPI_PRIV_MODE_0
			default 1 if ESP_SPI_PRIV_MODE_1
			default 2 if ESP_SPI_PRIV_MODE_2
			default 3 if ESP_SPI_PRIV_MODE_3
			default 2


		choice SPI_CONTROLLER
			bool "SPI controller to use"
			default SPI_HSPI

			config SPI_HSPI
				bool "FSPI/HSPI"
				help
					"HSPI/FSPI: SPI_controller_1"

			config SPI_VSPI
				depends on IDF_TARGET_ESP32
				bool "VSPI"
				help
					"VSPI: SPI_controller_2"

		endchoice

		config ESP_SPI_CONTROLLER
			int
			default 2 if SPI_VSPI
			default 1

		menu "Hosted SPI GPIOs Config"
			config ESP_SPI_HSPI_GPIO_MOSI
				depends on SPI_HSPI
				int "GPIO pin for Host MOSI"
				default 13 if IDF_TARGET_ESP32
				default 11 if IDF_TARGET_ESP32S2 || IDF_TARGET_ESP32S3
				default 7
				help
					SPI controller Host MOSI

			config ESP_SPI_HSPI_GPIO_MISO
				depends on SPI_HSPI
				int "GPIO pin for Host MISO"
				default 12 if IDF_TARGET_ESP32
				default 13 if IDF_TARGET_ESP32S2 || IDF_TARGET_ESP32S3
				default 2
				help
					SPI controller Host MISO

			config ESP_SPI_HSPI_GPIO_CLK
				depends on SPI_HSPI
				int "GPIO pin for Host CLK"
				default 14 if IDF_TARGET_ESP32
				default 12 if IDF_TARGET_ESP32S2 || IDF_TARGET_ESP32S3
				default 6
				help
					SPI controller Host CLK

			config ESP_SPI_HSPI_GPIO_CS
				depends on SPI_HSPI
				int "GPIO pin for Host  CS"
				default 15 if IDF_TARGET_ESP32
				default 10 if IDF_TARGET_ESP32S2 || IDF_TARGET_ESP32S3
				default 10
				help
					SPI controller Host CS

			config ESP_SPI_VSPI_GPIO_MOSI
				depends on SPI_VSPI
				int "GPIO pin for Host MOSI"
				default 23
				help
					SPI controller Host MOSI

			config ESP_SPI_VSPI_GPIO_MISO
				depends on SPI_VSPI
				int "GPIO pin for Host MISO"
				default 19
				help
					SPI controller Host MISO

			config ESP_SPI_VSPI_GPIO_CLK
				depends on SPI_VSPI
				int "GPIO pin for Host CLK"
				default 18
				help
					SPI controller Host CLK

			config ESP_SPI_VSPI_GPIO_CS
				depends on SPI_VSPI
				int "GPIO pin for Host CS"
				default 5
				help
					SPI controller Host CS

			config ESP_SPI_GPIO_MOSI
				int
				default ESP_SPI_VSPI_GPIO_MOSI if SPI_VSPI
				default ESP_SPI_HSPI_GPIO_MOSI

			config ESP_SPI_GPIO_MISO
				int
				default ESP_SPI_VSPI_GPIO_MISO if SPI_VSPI
				default ESP_SPI_HSPI_GPIO_MISO

			config ESP_SPI_GPIO_CLK
				int
				default ESP_SPI_VSPI_GPIO_CLK if SPI_VSPI
				default ESP_SPI_HSPI_GPIO_CLK

			config ESP_SPI_GPIO_CS
				int
				default ESP_SPI_VSPI_GPIO_CS if SPI_VSPI
				default ESP_SPI_HSPI_GPIO_CS

			config ESP_SPI_GPIO_HANDSHAKE
				int "GPIO pin for handshake"
				default 3 if IDF_TARGET_ESP32C2 || IDF_TARGET_ESP32C3 || IDF_TARGET_ESP32C6
				default 17 if IDF_TARGET_ESP32S3
				default 26
				help
					GPIO pin to use for handshake with other spi controller

			config ESP_SPI_GPIO_DATA_READY
				int "GPIO pin for data ready interrupt"
				default 4
				help
					GPIO pin for indicating host that SPI slave has data to be read by host
		endmenu


		config ESP_SPI_TX_Q_SIZE
			int "ESP to Host SPI queue size"
			default 10 if IDF_TARGET_ESP32
			default 20
			help
				Very small tx queue will lower ESP -- SPI --> Host data rate

		config ESP_SPI_RX_Q_SIZE
			int "Host to ESP SPI queue size"
			default 10 if IDF_TARGET_ESP32
			default 20
			help
				Very small RX queue will lower ESP <-- SPI -- Host data rate

		config ESP_SPI_CHECKSUM
			bool "SPI checksum ENABLE/DISABLE"
			default y
			help
				ENABLE/DISABLE software SPI checksum
	endmenu

	menu "SDIO Configuration"
		depends on ESP_SDIO_HOST_INTERFACE

		config ESP_SDIO_CHECKSUM
			bool "SDIO checksum ENABLE/DISABLE"
			help
				ENABLE/DISABLE software SDIO checksum

	endmenu

	config EXAMPLE_HCI_UART_BAUDRATE
		int "UART Baudrate for HCI: Only applicable for ESP32-C3/ESP32-S3"
		range 115200 921600
		depends on IDF_TARGET_ESP32C3 || IDF_TARGET_ESP32S3
		depends on BT_CTRL_HCI_MODE_UART_H4
		default 921600
		help
			UART Baudrate for HCI over ESP32C3/ESP32S3. Please use standard baudrate.

	config ESP_DEFAULT_TASK_STACK_SIZE
		int "ESP-Hosted task stack size"
		default 4096
		help
			Default task size of ESP-Hosted tasks

	config ESP_DEFAULT_TASK_PRIO
		int "ESP-Hosted task priority"
		default 22
		help
			Default task priority of ESP-Hosted tasks

	config ESP_CACHE_MALLOC
		bool "Cache allocated memory like mempool - helps to reduce malloc calls"
		default y
		help
			Cache allocated memory - reduces number of malloc calls

	config ESP_OTA_WORKAROUND
		bool "OTA workaround - Add sleeps while OTA write"
		default y
		help
			Enable/disable sleeps while OTA operations

	config ESP_RAW_THROUGHPUT_TRANSPORT
		bool "RawTP: Transport level throughput debug test"
		default n
			help
				Find max transport performance which helps to assess stability of porting done

	config ESP_RAW_TP_ESP_TO_HOST_PKT_LEN
		depends on ESP_RAW_THROUGHPUT_TRANSPORT
		int "RawTP: ESP to Host packet size"
		range 1 1500
		default 1460

	config ESP_RAW_TP_REPORT_INTERVAL
		depends on ESP_RAW_THROUGHPUT_TRANSPORT
		int "RawTP: periodic duration to report stats accumulated"
		default 1

endmenu
```

## esp_hosted_fg/esp/sdkconfig.defaults.esp32c6
```kconfig
CONFIG_SDIO_DAT2_DISABLED=

# BT Configuration
CONFIG_BT_ENABLED=y
CONFIG_BT_CONTROLLER_ONLY=y
CONFIG_BT_BLUEDROID_ENABLED=
CONFIG_BTDM_CTRL_MODE_BLE_ONLY=y
CONFIG_BTDM_CTRL_MODE_BR_EDR_ONLY=n
CONFIG_BTDM_CTRL_MODE_BTDM=n

# SPI/SDIO only
CONFIG_BT_LE_HCI_INTERFACE_USE_RAM=y

# BLE over UART:
# Enable below config, delete sdkconfig, build/ and rebuild
# CONFIG_BT_LE_HCI_INTERFACE_USE_UART=y
# CONFIG_BT_LE_HCI_UART_TX_PIN=5
# CONFIG_BT_LE_HCI_UART_RX_PIN=12
# CONFIG_BT_LE_HCI_UART_FLOWCTRL=n
# # 4 pin solution is not working yet for c6
# #CONFIG_BT_LE_HCI_UART_RTS_PIN=9
# #CONFIG_BT_LE_HCI_UART_CTS_PIN=13

CONFIG_ESP32_WIFI_NVS_ENABLED=

CONFIG_ESP_CACHE_MALLOC=y
```

## esp_hosted_fg/esp/sdkconfig.defaults.esp32s3
```kconfig
#For battery sensitive usage, can reduce the CPU frequency
CONFIG_ESP32_DEFAULT_CPU_FREQ_240=y
CONFIG_ESP32_DEFAULT_CPU_FREQ_MHZ=240

# BT Configuration
CONFIG_BT_ENABLED=y
CONFIG_BT_CONTROLLER_ONLY=y
CONFIG_BT_BLUEDROID_ENABLED=
CONFIG_BTDM_CTRL_MODE_BLE_ONLY=y
CONFIG_BTDM_CTRL_MODE_BR_EDR_ONLY=n
CONFIG_BTDM_CTRL_MODE_BTDM=n
CONFIG_BTDM_CTRL_HCI_MODE_VHCI=y

CONFIG_ESP32_WIFI_NVS_ENABLED=
```

## esp_hosted_fg/host/microcontrollers/port/esp/examples/wifi/iperf/main/Kconfig.projbuild
```kconfig
menu "Example Configuration"

    config ESP_WIFI_SSID
        string "WiFi SSID"
        default "myssid"
        help
            SSID (network name) for the example to connect to.

    config ESP_WIFI_PASSWORD
        string "WiFi Password"
        default "mypassword"
        help
            WiFi password (WPA or WPA2) for the example to use.

    config ESP_MAXIMUM_RETRY
        int "Maximum retry"
        default 5
        help
            Set the Maximum retry to avoid station reconnecting to the AP unlimited when the AP is really inexistent.

    choice ESP_WIFI_SCAN_AUTH_MODE_THRESHOLD
        prompt "WiFi Scan auth mode threshold"
        default ESP_WIFI_AUTH_WPA2_PSK
        help
            The weakest authmode to accept in the scan mode.
            This value defaults to ESP_WIFI_AUTH_WPA2_PSK incase password is present and ESP_WIFI_AUTH_OPEN is used.
            Please select ESP_WIFI_AUTH_WEP/ESP_WIFI_AUTH_WPA_PSK incase AP is operating in WEP/WPA mode.

        config ESP_WIFI_AUTH_OPEN
            bool "OPEN"
        config ESP_WIFI_AUTH_WEP
            bool "WEP"
        config ESP_WIFI_AUTH_WPA_PSK
            bool "WPA PSK"
        config ESP_WIFI_AUTH_WPA2_PSK
            bool "WPA2 PSK"
        config ESP_WIFI_AUTH_WPA_WPA2_PSK
            bool "WPA/WPA2 PSK"
        config ESP_WIFI_AUTH_WPA3_PSK
            bool "WPA3 PSK"
        config ESP_WIFI_AUTH_WPA2_WPA3_PSK
            bool "WPA2/WPA3 PSK"
        config ESP_WIFI_AUTH_WAPI_PSK
            bool "WAPI PSK"
    endchoice


	menu "ESP-Hosted config"

	    choice ESP_HOST_INTERFACE
	        bool "Transport layer"
	        default ESP_SPI_HOST_INTERFACE if IDF_TARGET_ESP32
	        default ESP_SPI_HOST_INTERFACE
	        help
	            Bus interface to be used for communication with the host

#	        config ESP_SDIO_HOST_INTERFACE
#	            bool "SDIO interface"
#	            depends on IDF_TARGET_ESP32
#	            help
#	                Enable/Disable SDIO host interface

	        config ESP_SPI_HOST_INTERFACE
	            bool "SPI interface"
	            help
	                Enable/Disable SPI host interface
	    endchoice


		menu "SPI Configuration"
    	    depends on ESP_SPI_HOST_INTERFACE

			menu "GPIOs Config"
				config ESP_SPI_CONTROLLER
    			    int "SPI controller to use"
    			    depends on IDF_TARGET_ESP32 && ESP_SPI_HOST_INTERFACE
    			    default 2
    			    range 2 3
    			    help
    			        SPI controller to be used. HSPI->2, VSPI->3


    			config ESP_SPI_GPIO_MOSI
    			    int "GPIO pin for MOSI"
    			    default 12 if IDF_TARGET_ESP32
    			    default 11 if IDF_TARGET_ESP32S2
    			    default 11 if IDF_TARGET_ESP32S3
					default 7
    			    help
    			        GPIO pin for SPI MOSI

    			config ESP_SPI_GPIO_MISO
    			    int "GPIO pin for MISO"
    			    default 13 if IDF_TARGET_ESP32
    			    default 13 if IDF_TARGET_ESP32S2
    			    default 13 if IDF_TARGET_ESP32S3
					default 2
    			    help
    			        GPIO pin for SPI MISO

    			config ESP_SPI_GPIO_CLK
    			    int "GPIO pin for CLK"
    			    default 15 if IDF_TARGET_ESP32
    			    default 12 if IDF_TARGET_ESP32S2
    			    default 12 if IDF_TARGET_ESP32S3
					default 6
    			    help
    			        GPIO pin for SPI CLK

    			config ESP_SPI_GPIO_CS
    			    int "GPIO pin for CS"
    			    default 14 if IDF_TARGET_ESP32
    			    default 10 if IDF_TARGET_ESP32S2
    			    default 10 if IDF_TARGET_ESP32S3
					default 10
    			    help
    			        GPIO pin for SPI CS

    			config ESP_SPI_GPIO_HANDSHAKE
    			    int "GPIO pin for handshake"
    			    default 3 if IDF_TARGET_ESP32C2
    			    default 3 if IDF_TARGET_ESP32C3
    			    default 3 if IDF_TARGET_ESP32C6
    			    default 17 if IDF_TARGET_ESP32S3
    			    default 26
    			    help
    			        GPIO pin to use for handshake with other spi controller

    			config ESP_SPI_GPIO_DATA_READY
    			    int "GPIO pin for data ready interrupt"
    			    default 4
    			    help
    			        GPIO pin for indicating host that SPI slave has data to be read by host

    			config ESP_SPI_GPIO_RESET_SLAVE
    			    int "GPIO pin for Reseting slave ESP"
    			    default 5
    			    help
    			        GPIO pin for Resetting ESP SPI slave device. Should be connected to RST/EN of ESP SPI slave device.
			endmenu

    		config ESP_SPI_TX_Q_SIZE
    		    int "ESP to Host SPI queue size"
    		    default 10
    		    help
    		        Very small tx queue will lower ESP -- SPI --> Host data rate

    		config ESP_SPI_RX_Q_SIZE
    		    int "Host to ESP SPI queue size"
    		    default 10
    		    help
    		        Very small RX queue will lower ESP <-- SPI -- Host data rate

		endmenu

		menu "Debug Logs"
			config SERIAL_LOG_LEVEL
			int "Print host serial logs (0: No logs) (1: verbose) (2: info)"
			default 0

			config SPI_LOG_LEVEL
			int "Print host spi logs (0: No logs) (1: verbose) (2: info)"
			default 0

			config RPC_LOG_LEVEL
			int "Print host RPC logs (0: No logs) (1: verbose) (2: info)"
			default 0

			config TRANSPORT_LOG_LEVEL
			int "Print host Transport logs (0: No logs) (1: verbose) (2: info)"
			default 1

		endmenu

		config ESP_USE_MEMPOOL
    	    bool "Cache allocated memory like mempool - helps to reduce malloc calls"
    	    default y
    	    help
    	        Cache allocated memory - reduces number of malloc calls
	endmenu

endmenu
```
