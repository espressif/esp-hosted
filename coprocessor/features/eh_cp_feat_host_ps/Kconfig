## esp_hosted_fg/host/microcontrollers/port/esp/examples/wifi/scan/main/Kconfig.projbuild
```kconfig
menu "Example Configuration"

    config EXAMPLE_SCAN_LIST_SIZE
        int "Max size of scan list"
        range 0 20
        default 10
        help
            The size of array that will be used to retrieve the list of access points.


	menu "ESP-Hosted config"

	    choice ESP_HOST_INTERFACE
	        bool "Transport layer"
	        default ESP_SPI_HOST_INTERFACE if IDF_TARGET_ESP32
	        default ESP_SPI_HOST_INTERFACE
	        help
	            Bus interface to be used for communication with the host

#	        config ESP_SDIO_HOST_INTERFACE
#	            bool "SDIO interface"
#	            depends on IDF_TARGET_ESP32
#	            help
#	                Enable/Disable SDIO host interface

	        config ESP_SPI_HOST_INTERFACE
	            bool "SPI interface"
	            help
	                Enable/Disable SPI host interface
	    endchoice


		menu "Wi-Fi Config inherited from ESP-IDF"

			config ESP32_WIFI_STATIC_RX_BUFFER_NUM
    		    int "param static rx buffs"
    		    default 10

			config ESP32_WIFI_DYNAMIC_RX_BUFFER_NUM
    		    int "param dynamic rx buffs"
    		    default 32

			config ESP32_WIFI_TX_BUFFER_TYPE
    		    int "param tx buff type"
    		    default 1

			config ESP_WIFI_ESPNOW_MAX_ENCRYPT_NUM
    		    int "esp now mac encrypt"
    		    default 2

		endmenu

		menu "SPI Configuration"
    	    depends on ESP_SPI_HOST_INTERFACE

			menu "GPIOs Config"
				config ESP_SPI_CONTROLLER
    			    int "SPI controller to use"
    			    depends on IDF_TARGET_ESP32 && ESP_SPI_HOST_INTERFACE
    			    default 2
    			    range 2 3
    			    help
    			        SPI controller to be used. HSPI->2, VSPI->3


    			config ESP_SPI_GPIO_MOSI
    			    int "GPIO pin for MOSI"
    			    default 12 if IDF_TARGET_ESP32
    			    default 11 if IDF_TARGET_ESP32S2
    			    default 11 if IDF_TARGET_ESP32S3
					default 7
    			    help
    			        GPIO pin for SPI MOSI

    			config ESP_SPI_GPIO_MISO
    			    int "GPIO pin for MISO"
    			    default 13 if IDF_TARGET_ESP32
    			    default 13 if IDF_TARGET_ESP32S2
    			    default 13 if IDF_TARGET_ESP32S3
					default 2
    			    help
    			        GPIO pin for SPI MISO

    			config ESP_SPI_GPIO_CLK
    			    int "GPIO pin for CLK"
    			    default 15 if IDF_TARGET_ESP32
    			    default 12 if IDF_TARGET_ESP32S2
    			    default 12 if IDF_TARGET_ESP32S3
					default 6
    			    help
    			        GPIO pin for SPI CLK

    			config ESP_SPI_GPIO_CS
    			    int "GPIO pin for CS"
    			    default 14 if IDF_TARGET_ESP32
    			    default 10 if IDF_TARGET_ESP32S2
    			    default 10 if IDF_TARGET_ESP32S3
					default 10
    			    help
    			        GPIO pin for SPI CS

    			config ESP_SPI_GPIO_HANDSHAKE
    			    int "GPIO pin for handshake"
    			    default 3 if IDF_TARGET_ESP32C2
    			    default 3 if IDF_TARGET_ESP32C3
    			    default 17
    			    help
    			        GPIO pin to use for handshake with other spi controller

    			config ESP_SPI_GPIO_DATA_READY
    			    int "GPIO pin for data ready interrupt"
    			    default 4
    			    help
    			        GPIO pin for indicating host that SPI slave has data to be read by host

    			config ESP_SPI_GPIO_RESET_SLAVE
    			    int "GPIO pin for Reseting slave ESP"
    			    default 5
    			    help
    			        GPIO pin for Resetting ESP SPI slave device. Should be connected to RST/EN of ESP SPI slave device.
			endmenu

    		config ESP_SPI_TX_Q_SIZE
    		    int "ESP to Host SPI queue size"
    		    default 10
    		    help
    		        Very small tx queue will lower ESP -- SPI --> Host data rate (Only ESP32-C2)

    		config ESP_SPI_RX_Q_SIZE
    		    int "Host to ESP SPI queue size"
    		    default 10
    		    help
    		        Very small RX queue will lower ESP <-- SPI -- Host data rate (Only ESP32-C2)

		endmenu

		menu "Debug Logs"
			config SERIAL_LOG_LEVEL
			int "Print host serial logs (0: No logs) (1: verbose) (2: info)"
			default 0

			config SPI_LOG_LEVEL
			int "Print host spi logs (0: No logs) (1: verbose) (2: info)"
			default 0

			config RPC_LOG_LEVEL
			int "Print host RPC logs (0: No logs) (1: verbose) (2: info)"
			default 0

			config TRANSPORT_LOG_LEVEL
			int "Print host Transport logs (0: No logs) (1: verbose) (2: info)"
			default 1

		endmenu

		config ESP_CACHE_MALLOC
    	    bool "Cache allocated memory like mempool - helps to reduce malloc calls"
    	    default y
    	    help
    	        Cache allocated memory - reduces number of malloc calls
	endmenu

endmenu
```

## esp_hosted_fg/host/microcontrollers/port/esp/examples/wifi/station/main/Kconfig.projbuild
```kconfig
menu "Example Configuration"

	config ESP_WIFI_SSID
		string "WiFi SSID"
		default "myssid"
		help
			SSID (network name) for the example to connect to.

	config ESP_WIFI_PASSWORD
		string "WiFi Password"
		default "mypassword"
		help
			WiFi password (WPA or WPA2) for the example to use.

	config ESP_MAXIMUM_RETRY
		int "Maximum retry"
		default 5
		help
			Set the Maximum retry to avoid station reconnecting to the AP unlimited when the AP is really inexistent.

	choice ESP_WIFI_SCAN_AUTH_MODE_THRESHOLD
		prompt "WiFi Scan auth mode threshold"
		default ESP_WIFI_AUTH_WPA2_PSK
		help
			The weakest authmode to accept in the scan mode.
			This value defaults to ESP_WIFI_AUTH_WPA2_PSK incase password is present and ESP_WIFI_AUTH_OPEN is used.
			Please select ESP_WIFI_AUTH_WEP/ESP_WIFI_AUTH_WPA_PSK incase AP is operating in WEP/WPA mode.

		config ESP_WIFI_AUTH_OPEN
			bool "OPEN"
		config ESP_WIFI_AUTH_WEP
			bool "WEP"
		config ESP_WIFI_AUTH_WPA_PSK
			bool "WPA PSK"
		config ESP_WIFI_AUTH_WPA2_PSK
			bool "WPA2 PSK"
		config ESP_WIFI_AUTH_WPA_WPA2_PSK
			bool "WPA/WPA2 PSK"
		config ESP_WIFI_AUTH_WPA3_PSK
			bool "WPA3 PSK"
		config ESP_WIFI_AUTH_WPA2_WPA3_PSK
			bool "WPA2/WPA3 PSK"
		config ESP_WIFI_AUTH_WAPI_PSK
			bool "WAPI PSK"
	endchoice


	menu "ESP-Hosted config"

		choice ESP_HOST_INTERFACE
			bool "Hosted Transport layer"
			default ESP_SPI_HOST_INTERFACE if IDF_TARGET_ESP32
			default ESP_SPI_HOST_INTERFACE
			help
				Bus interface to be used for communication with the host

#			config ESP_SDIO_HOST_INTERFACE
#				bool "SDIO interface"
#				depends on IDF_TARGET_ESP32
#				help
#					Enable/Disable SDIO host interface

			config ESP_SPI_HOST_INTERFACE
				bool "SPI Transport"
				help
					Enable/Disable SPI host interface
		endchoice


		choice ESP_HOSTED_SLAVE_CHIPSET_USED
			bool "Slave chipset to be used"

			config SLAVE_CHIPSET_ESP32
				bool "Slave as ESP32"

			config SLAVE_CHIPSET_ESP32S2
				bool "Slave as ESP32S2"

			config SLAVE_CHIPSET_ESP32S3
				bool "Slave as ESP32S3"

			config SLAVE_CHIPSET_ESP32C2
				bool "Slave as ESP32C2"

			config SLAVE_CHIPSET_ESP32C3
				bool "Slave as ESP32C3"

			config SLAVE_CHIPSET_ESP32C6
				bool "Slave as ESP32C6"
		endchoice

		menu "Hosted SPI Configuration"
			depends on ESP_SPI_HOST_INTERFACE


			choice ESP_SPI_PRIV_MODE
				bool "Host SPI mode"
				default ESP_SPI_PRIV_MODE_3

				config ESP_SPI_PRIV_MODE_0
					bool "Host  SPI mode 0"

				config ESP_SPI_PRIV_MODE_1
					bool "Host  SPI mode 1"

				config ESP_SPI_PRIV_MODE_2
					bool "Host  SPI mode 2"

				config ESP_SPI_PRIV_MODE_3
					bool "Host  SPI mode 3"
			endchoice

			config ESP_SPI_MODE
				int
				default 0 if ESP_SPI_PRIV_MODE_0
				default 1 if ESP_SPI_PRIV_MODE_1
				default 2 if ESP_SPI_PRIV_MODE_2
				default 3

			choice SPI_CONTROLLER
				bool "Host SPI controller to use"
				default SPI_HSPI

				config SPI_HSPI
					bool "HSPI/FSPI"
					help
						"HSPI/FSPI SPI controller"

				config SPI_VSPI
					depends on IDF_TARGET_ESP32
					bool "VSPI"
					help
						"VSPI SPI controller"

			endchoice

			config ESP_SPI_CONTROLLER
				int
				default 2 if SPI_VSPI
				default 1

			menu "Hosted SPI GPIOs Config"

				config ESP_SPI_HSPI_GPIO_MOSI
					depends on SPI_HSPI
					int "GPIO pin for Host MOSI"
					default 13 if IDF_TARGET_ESP32
					default 11 if IDF_TARGET_ESP32S2 || IDF_TARGET_ESP32S3
					default 7
					help
						SPI controller Host MOSI

				config ESP_SPI_HSPI_GPIO_MISO
					depends on SPI_HSPI
					int "GPIO pin for Host MISO"
					default 12 if IDF_TARGET_ESP32
					default 13 if IDF_TARGET_ESP32S2 || IDF_TARGET_ESP32S3
					default 2
					help
						SPI controller Host MISO

				config ESP_SPI_HSPI_GPIO_CLK
					depends on SPI_HSPI
					int "GPIO pin for Host CLK"
					default 14 if IDF_TARGET_ESP32
					default 12 if IDF_TARGET_ESP32S2 || IDF_TARGET_ESP32S3
					default 6
					help
						SPI controller Host CLK

				config ESP_SPI_HSPI_GPIO_CS
					depends on SPI_HSPI
					int "GPIO pin for Host  CS"
					default 15 if IDF_TARGET_ESP32
					default 10 if IDF_TARGET_ESP32S2 || IDF_TARGET_ESP32S3
					default 10
					help
						SPI controller Host CS

				config ESP_SPI_VSPI_GPIO_MOSI
					depends on SPI_VSPI
					int "GPIO pin for Host MOSI"
					default 23
					help
						SPI controller Host MOSI

				config ESP_SPI_VSPI_GPIO_MISO
					depends on SPI_VSPI
					int "GPIO pin for Host MISO"
					default 19
					help
						SPI controller Host MISO

				config ESP_SPI_VSPI_GPIO_CLK
					depends on SPI_VSPI
					int "GPIO pin for Host CLK"
					default 18
					help
						SPI controller Host CLK

				config ESP_SPI_VSPI_GPIO_CS
					depends on SPI_VSPI
					int "GPIO pin for Host CS"
					default 5
					help
						SPI controller Host CS

				config ESP_SPI_GPIO_MOSI
					int
					default ESP_SPI_VSPI_GPIO_MOSI if SPI_VSPI
					default ESP_SPI_HSPI_GPIO_MOSI

				config ESP_SPI_GPIO_MISO
					int
					default ESP_SPI_VSPI_GPIO_MISO if SPI_VSPI
					default ESP_SPI_HSPI_GPIO_MISO

				config ESP_SPI_GPIO_CLK
					int
					default ESP_SPI_VSPI_GPIO_CLK if SPI_VSPI
					default ESP_SPI_HSPI_GPIO_CLK

				config ESP_SPI_GPIO_CS
					int
					default ESP_SPI_VSPI_GPIO_CS if SPI_VSPI
					default ESP_SPI_HSPI_GPIO_CS

				config ESP_SPI_GPIO_HANDSHAKE
					int "GPIO pin for handshake"
					default 3 if IDF_TARGET_ESP32C2 || IDF_TARGET_ESP32C3 || IDF_TARGET_ESP32C6
					default 17 if IDF_TARGET_ESP32S3
					default 26
					help
						GPIO pin to use for handshake with other spi controller

				config ESP_SPI_GPIO_DATA_READY
					int "GPIO pin for data ready interrupt"
					default 4
					help
						GPIO pin for indicating host that SPI slave has data to be read by host

				config ESP_SPI_GPIO_RESET_SLAVE
					int "GPIO pin for Reseting slave ESP"
					default 5
					help
						GPIO pin for Resetting ESP SPI slave device. Should be connected to RST/EN of ESP SPI slave device.
			endmenu

ESP32XX_SPI_CLK_FREQ_RANGE_MIN := 1
ESP32_SPI_CLK_FREQ_RANGE_MAX := 10
ESP32S2_SPI_CLK_FREQ_RANGE_MAX := 40
ESP32XX_SPI_CLK_FREQ_RANGE_MAX := 60

		config ESP_SPI_FREQ_ESP32
			depends on SLAVE_CHIPSET_ESP32
			int "SPI Clock Freq"
			default 10
			range $(ESP32XX_SPI_CLK_FREQ_RANGE_MIN) $(ESP32_SPI_CLK_FREQ_RANGE_MAX)
			help
				"Optimize SPI CLK by increasing till host practically can support"

		config ESP_SPI_FREQ_ESP32S2
			depends on SLAVE_CHIPSET_ESP32S2
			int "SPI Clock Freq"
			default 30
			range $(ESP32XX_SPI_CLK_FREQ_RANGE_MIN) $(ESP32S2_SPI_CLK_FREQ_RANGE_MAX)
			help
				"Optimize SPI CLK by increasing till host practically can support"

		config ESP_SPI_FREQ_ESP32XX
			depends on SLAVE_CHIPSET_ESP32C2 || SLAVE_CHIPSET_ESP32C3 || SLAVE_CHIPSET_ESP32C6 || SLAVE_CHIPSET_ESP32S3
			int "SPI Clock Freq"
			default 30 if SLAVE_CHIPSET_ESP32C2 || SLAVE_CHIPSET_ESP32C3 || SLAVE_CHIPSET_ESP32C6 || SLAVE_CHIPSET_ESP32S3
			range $(ESP32XX_SPI_CLK_FREQ_RANGE_MIN) $(ESP32XX_SPI_CLK_FREQ_RANGE_MAX)
			help
				"Optimize SPI CLK by increasing till host practically can support"


		config ESP_SPI_CLK_FREQ
			int
			default ESP_SPI_FREQ_ESP32 if SLAVE_CHIPSET_ESP32
			default ESP_SPI_FREQ_ESP32S2 if SLAVE_CHIPSET_ESP32S2
			default ESP_SPI_FREQ_ESP32XX if SLAVE_CHIPSET_ESP32C2 || SLAVE_CHIPSET_ESP32C3 || SLAVE_CHIPSET_ESP32C6 || SLAVE_CHIPSET_ESP32S3
			help
				"Optimize SPI CLK by increasing till host practically can support"

			config ESP_SPI_TX_Q_SIZE
				int "ESP to Host SPI queue size"
				default 10
				help
					Very small tx queue will lower ESP -- SPI --> Host data rate

			config ESP_SPI_RX_Q_SIZE
				int "Host to ESP SPI queue size"
				default 10
				help
					Very small RX queue will lower ESP <-- SPI -- Host data rate

		endmenu

		config ESP_USE_MEMPOOL
			bool "Cache allocated memory like mempool - helps to reduce malloc calls"
			default y
			help
				Cache allocated memory - reduces number of malloc calls
	endmenu

endmenu
```
