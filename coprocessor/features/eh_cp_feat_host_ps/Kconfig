## esp_hosted_fg/esp/esp_driver/network_adapter/main/Kconfig.projbuild
```kconfig
menu "Example Configuration"
	config ESP_HOSTED_COPROCESSOR
		bool
		default y

	# set this to y to use the ESP32-C5 RaspPi Mating Board in SPI mode
	config ESP_ESP32C5_SPI_RASPI_MATING_BOARD
		bool
		default n

	comment "SPI Configuration set for ESP32-C5 RaspPi Mating Board"
		depends on ESP_ESP32C5_SPI_RASPI_MATING_BOARD

	choice ESP_HOST_INTERFACE
		bool "Transport layer"
		default ESP_SPI_HOST_INTERFACE if ESP_ESP32C5_SPI_RASPI_MATING_BOARD
		default ESP_SDIO_HOST_INTERFACE if SOC_SDIO_SLAVE_SUPPORTED
		default ESP_SPI_HOST_INTERFACE
		help
			Bus interface to be used for communication with the host

		config ESP_SDIO_HOST_INTERFACE
			bool "SDIO interface"
			depends on SOC_SDIO_SLAVE_SUPPORTED
			help
				Enable/Disable SDIO host interface

		config ESP_SPI_HOST_INTERFACE
			bool "SPI interface"
			help
				Enable/Disable SPI host interface
	endchoice

	menu "Transport Priority Queue Configuration"
		config ESP_ENABLE_TX_PRIORITY_QUEUES
			depends on !ESP_SDIO_HOST_INTERFACE
			bool "Enable TX priority queues"
			default n
			help
				Enable separate priority queues for TX based on interface type (WiFi, BT, Serial)

		config ESP_TX_WIFI_Q_SIZE
			int "TX WiFi queue size"
			depends on ESP_ENABLE_TX_PRIORITY_QUEUES
			default 10 if IDF_TARGET_ESP32C2
			default 20
			help
				Size of TX queue for WiFi packets

		config ESP_TX_BT_Q_SIZE
			int "TX BT queue size"
			depends on ESP_ENABLE_TX_PRIORITY_QUEUES
			default 3
			help
				Size of TX queue for BT packets

		config ESP_TX_SERIAL_Q_SIZE
			int "TX Serial queue size"
			depends on ESP_ENABLE_TX_PRIORITY_QUEUES
			default 2
			help
				Size of TX queue for Serial packets

		config ESP_TX_Q_SIZE
			int "ESP to Host transport queue size"
			depends on !ESP_ENABLE_TX_PRIORITY_QUEUES
			default 6 if IDF_TARGET_ESP32C2
			default 10
			help
				Size of Tx queue for packets

		config ESP_ENABLE_RX_PRIORITY_QUEUES
			bool "Enable RX priority queues"
			default n
			help
				Enable separate priority queues for RX based on interface type (WiFi, BT, Serial)

		config ESP_RX_WIFI_Q_SIZE
			int "RX WiFi queue size"
			depends on ESP_ENABLE_RX_PRIORITY_QUEUES
			default 10 if IDF_TARGET_ESP32C2
			default 20
			help
				Size of RX queue for WiFi packets

		config ESP_RX_BT_Q_SIZE
			int "RX BT queue size"
			depends on ESP_ENABLE_RX_PRIORITY_QUEUES
			default 3
			help
				Size of RX queue for BT packets

		config ESP_RX_SERIAL_Q_SIZE
			int "RX Serial queue size"
			depends on ESP_ENABLE_RX_PRIORITY_QUEUES
			default 2
			help
				Size of RX queue for Serial packets

		config ESP_RX_Q_SIZE
			int "Host to ESP transport queue size"
			depends on !ESP_ENABLE_RX_PRIORITY_QUEUES
			default 6 if IDF_TARGET_ESP32C2
			default 10
			help
				Size of Rx queue for packets
	endmenu

	menu "SPI Full-duplex Configuration"
		depends on ESP_SPI_HOST_INTERFACE

		choice ESP_SPI_PRIV_MODE
			bool "Slave SPI mode"
			default ESP_SPI_PRIV_MODE_2 if IDF_TARGET_ESP32
			default ESP_SPI_PRIV_MODE_3

			config ESP_SPI_PRIV_MODE_0
				bool "Slave SPI mode 0"

			config ESP_SPI_PRIV_MODE_1
				bool "Slave SPI mode 1"

			config ESP_SPI_PRIV_MODE_2
				bool "Slave SPI mode 2"

			config ESP_SPI_PRIV_MODE_3
				bool "Slave SPI mode 3"
		endchoice

		config ESP_SPI_MODE
			int
			default 0 if ESP_SPI_PRIV_MODE_0
			default 1 if ESP_SPI_PRIV_MODE_1
			default 2 if ESP_SPI_PRIV_MODE_2
			default 3 if ESP_SPI_PRIV_MODE_3
			default 3


		choice SPI_CONTROLLER
			bool "SPI controller to use"
			default SPI_HSPI

			config SPI_HSPI
				bool "FSPI/HSPI"
				help
					"HSPI/FSPI: SPI_controller_1"

			config SPI_VSPI
				depends on IDF_TARGET_ESP32
				bool "VSPI"
				help
					"VSPI: SPI_controller_2"

		endchoice

		config ESP_SPI_CONTROLLER
			int
			default 2 if SPI_VSPI
			default 1

		menu "Hosted SPI GPIOs"
			config ESP_SPI_HSPI_GPIO_MOSI
				depends on SPI_HSPI
				int "Slave GPIO pin for Host MOSI"
				default 13 if IDF_TARGET_ESP32
				default 11 if IDF_TARGET_ESP32S2 || IDF_TARGET_ESP32S3
				default 1 if IDF_TARGET_ESP32C5 && ESP_ESP32C5_SPI_RASPI_MATING_BOARD
				default 7
				help
					SPI controller Host MOSI

			config ESP_SPI_HSPI_GPIO_MISO
				depends on SPI_HSPI
				int "Slave GPIO pin for Host MISO"
				default 12 if IDF_TARGET_ESP32
				default 13 if IDF_TARGET_ESP32S2 || IDF_TARGET_ESP32S3
				default 6 if IDF_TARGET_ESP32C5 && ESP_ESP32C5_SPI_RASPI_MATING_BOARD
				default 2
				help
					SPI controller Host MISO

			config ESP_SPI_HSPI_GPIO_CLK
				depends on SPI_HSPI
				int "Slave GPIO pin for Host CLK"
				default 14 if IDF_TARGET_ESP32
				default 12 if IDF_TARGET_ESP32S2 || IDF_TARGET_ESP32S3
				default 27 if IDF_TARGET_ESP32C5 && ESP_ESP32C5_SPI_RASPI_MATING_BOARD
				default 6
				help
					SPI controller Host CLK

			config ESP_SPI_HSPI_GPIO_CS
				depends on SPI_HSPI
				int "Slave GPIO pin for Host  CS"
				default 15 if IDF_TARGET_ESP32
				default 10 if IDF_TARGET_ESP32S2 || IDF_TARGET_ESP32S3
				default 4 if IDF_TARGET_ESP32C5  && ESP_ESP32C5_SPI_RASPI_MATING_BOARD
				default 10
				help
					SPI controller Host CS

			config ESP_SPI_VSPI_GPIO_MOSI
				depends on SPI_VSPI
				int "Slave GPIO pin for Host MOSI"
				default 23
				help
					SPI controller Host MOSI

			config ESP_SPI_VSPI_GPIO_MISO
				depends on SPI_VSPI
				int "Slave GPIO pin for Host MISO"
				default 19
				help
					SPI controller Host MISO

			config ESP_SPI_VSPI_GPIO_CLK
				depends on SPI_VSPI
				int "Slave GPIO pin for Host CLK"
				default 18
				help
					SPI controller Host CLK

			config ESP_SPI_VSPI_GPIO_CS
				depends on SPI_VSPI
				int "Slave GPIO pin for Host CS"
				default 5
				help
					SPI controller Host CS

			config ESP_SPI_GPIO_MOSI
				int
				default ESP_SPI_VSPI_GPIO_MOSI if SPI_VSPI
				default ESP_SPI_HSPI_GPIO_MOSI

			config ESP_SPI_GPIO_MISO
				int
				default ESP_SPI_VSPI_GPIO_MISO if SPI_VSPI
				default ESP_SPI_HSPI_GPIO_MISO

			config ESP_SPI_GPIO_CLK
				int
				default ESP_SPI_VSPI_GPIO_CLK if SPI_VSPI
				default ESP_SPI_HSPI_GPIO_CLK

			config ESP_SPI_GPIO_CS
				int
				default ESP_SPI_VSPI_GPIO_CS if SPI_VSPI
				default ESP_SPI_HSPI_GPIO_CS

			config ESP_SPI_GPIO_HANDSHAKE
				int "Slave GPIO pin for handshake"
				default 25 if IDF_TARGET_ESP32C5 && ESP_ESP32C5_SPI_RASPI_MATING_BOARD
				default 3 if IDF_TARGET_ESP32C2 || IDF_TARGET_ESP32C3 || IDF_TARGET_ESP32C5 || IDF_TARGET_ESP32C6
				default 2
				help
					Slave GPIO pin to use for handshake with other spi controller

			config ESP_SPI_GPIO_DATA_READY
				int "Slave GPIO pin for data ready interrupt"
				default 2 if IDF_TARGET_ESP32C5 && ESP_ESP32C5_SPI_RASPI_MATING_BOARD
				default 4
				help
					Slave GPIO pin for indicating host that SPI slave has data to be read by host

			config ESP_SPI_GPIO_RESET
				int "Slave GPIO pin to reset itself"
				default -1
				help
					Host uses this pin to reset the slave ESP. To re-use ESP 'RST' or 'EN' GPIO, set value to -1
		endmenu

		config ESP_SPI_DEASSERT_HS_ON_CS
			bool "Deassert Handshake when SPI CS is deasserted"
			default n if IDF_TARGET_ESP32
			default y
			help
				Deassert Handshake and prepare a new SPI transaction only after
				CS has been deasserted. This helps prevent data loss with MCUs
				that delay deasserting CS after the end of a SPI transaction
				by prematurely starting a new slave SPI transaction
				since CS is detected by the slave as still asserted.

		config ESP_SPI_CHECKSUM
			bool "SPI checksum ENABLE/DISABLE"
			default y
			help
				ENABLE/DISABLE software SPI checksum
	endmenu

	menu "SDIO Configuration"
		depends on ESP_SDIO_HOST_INTERFACE

		config ESP_SDIO_STREAMING_MODE
			bool "Enable SDIO Streaming Mode"
			default n
			help
				Enable Streaming Mode. Host to receive queued data from slave
				as one stream instead of individual packets. This can improve
				host SDIO read performance by doing one large read transaction
				instead of many smaller read transactions.

		config ESP_SDIO_GPIO_RESET
			int "Slave GPIO pin to reset itself"
			default -1
			help
				Host uses this pin to reset the slave ESP. To re-use ESP 'RST' or 'EN' GPIO, set value to -1

		choice
			prompt "SDIO Bus Speed"
			default ESP_SDIO_HIGH_SPEED
			help
				Select the SDIO Slave Bus Speed. Actual speed in use depends on SDIO bus speed the SDIO Master can support

			config ESP_SDIO_DEFAULT_SPEED
				bool "Default Speed (upto 20 MHz)"

			config ESP_SDIO_HIGH_SPEED
				bool "High Speed (upto 50 MHz)"
		endchoice


		menu "Hosted SDIO GPIOs"
			config ESP_SDIO_PIN_CMD
				int "CMD GPIO number"
				range 15 15 if IDF_TARGET_ESP32
				range 18 18 if IDF_TARGET_ESP32C6
				range 10 10 if IDF_TARGET_ESP32C5
				help
					"Value cannot be configured. Displayed for reference."

			config ESP_SDIO_PIN_CLK
				int "CLK GPIO number"
				range 14 14 if IDF_TARGET_ESP32
				range 19 19 if IDF_TARGET_ESP32C6
				range 9 9 if IDF_TARGET_ESP32C5
				help
					"Value cannot be configured. Displayed for reference."

			config ESP_SDIO_PIN_D0
				int "D0 GPIO number"
				range 2 2 if IDF_TARGET_ESP32
				range 20 20 if IDF_TARGET_ESP32C6
				range 8 8 if IDF_TARGET_ESP32C5
				help
					"Value cannot be configured. Displayed for reference."

			config ESP_SDIO_PIN_D1
				int "D1 GPIO number"
				range 4 4 if IDF_TARGET_ESP32
				range 21 21 if IDF_TARGET_ESP32C6
				range 7 7 if IDF_TARGET_ESP32C5
				help
					"Value cannot be configured. Displayed for reference."

			config ESP_SDIO_PIN_D2
				int "D2 GPIO number"
				range 12 12 if IDF_TARGET_ESP32
				range 22 22 if IDF_TARGET_ESP32C6
				range 14 14 if IDF_TARGET_ESP32C5
				help
					"Value cannot be configured. Displayed for reference."

			config ESP_SDIO_PIN_D3
				int "D3 GPIO number"
				range 13 13 if IDF_TARGET_ESP32
				range 23 23 if IDF_TARGET_ESP32C6
				range 13 13 if IDF_TARGET_ESP32C5
				help
					"Value cannot be configured. Displayed for reference."
		endmenu

		choice
			prompt "SDIO Slave Timing"
			default ESP_SDIO_NSEND_PSAMPLE if IDF_TARGET_ESP32C6
			default ESP_SDIO_PSEND_PSAMPLE
			help
				Select the SDIO timing used by slave. Default value works with most
				SDMMC controllers but if transfer errors are encountered, selecting a
				different timing may help resolve the errors.
				See https://docs.espressif.com/projects/esp-idf/en/latest/esp32/api-reference/peripherals/sdio_slave.html#_CPPv419sdio_slave_timing_t
				for more information

			config ESP_SDIO_PSEND_PSAMPLE
				bool "Send at positive edge, sample at positive edge"

			config ESP_SDIO_NSEND_PSAMPLE
				bool "Send at negative edge, sample at positive edge"

			config ESP_SDIO_PSEND_NSAMPLE
				bool "Send at positive edge, sample at negative edge"

			config ESP_SDIO_NSEND_NSAMPLE
				bool "Send at negative edge, sample at negative edge"
		endchoice

		config ESP_SDIO_CHECKSUM
			bool "SDIO checksum ENABLE/DISABLE"
			default n
			help
				ENABLE/DISABLE software SDIO checksum
	endmenu

	config ESP_GPIO_SLAVE_RESET
		int
		default ESP_SPI_GPIO_RESET if ESP_SPI_HOST_INTERFACE
		default ESP_SDIO_GPIO_RESET if ESP_SDIO_HOST_INTERFACE

	config EXAMPLE_HCI_UART_BAUDRATE
		int "UART Baudrate for HCI: Only applicable for ESP32-C3/ESP32-S3"
		range 115200 921600
		depends on IDF_TARGET_ESP32C3 || IDF_TARGET_ESP32S3 || IDF_TARGET_ESP32C2 || IDF_TARGET_ESP32C6
		depends on BT_CTRL_HCI_MODE_UART_H4
		default 921600
		help
			UART Baudrate for HCI over ESP32-C2/C3/C6/S3. Please use standard baudrate.

	menu "ESP-Hosted Task config"
		config ESP_DEFAULT_TASK_STACK_SIZE
			int "ESP-Hosted task stack size"
			default 4096
			help
				Default task size of ESP-Hosted tasks

		config ESP_HOSTED_TASK_PRIORITY_LOW
			int "ESP-Hosted task priority low"
			default 5
			help
				Low priority of ESP-Hosted tasks

		config ESP_HOSTED_TASK_PRIORITY_DEFAULT
			int "ESP-Hosted task priority default"
			default 21
			help
				Default task priority of ESP-Hosted tasks

		config ESP_HOSTED_TASK_PRIORITY_HIGH
			int "ESP-Hosted task priority high"
			default 22
			help
				High priority of ESP-Hosted tasks
	endmenu

	config ESP_CACHE_MALLOC
		bool "Enable Mempool"
		default n if IDF_TARGET_ESP32C2
		default y
		help
			Mempool will help to alloc buffer without going to heap for every memory allocation or free

	menu "Hosted Debugging"
		config ESP_RAW_THROUGHPUT_TRANSPORT
			bool "RawTP: Transport level throughput debug test"
			default n
				help
					Find max transport performance which helps to assess stability of porting done

		config ESP_RAW_TP_ESP_TO_HOST_PKT_LEN
			depends on ESP_RAW_THROUGHPUT_TRANSPORT
			int "RawTP: ESP to Host packet size"
			range 1 1500
			default 1460

		config ESP_RAW_TP_REPORT_INTERVAL
			depends on ESP_RAW_THROUGHPUT_TRANSPORT
			int "RawTP: periodic duration to report stats accumulated"
			default 1

		config ESP_PKT_STATS
			bool "Transport level packet stats"
			default n if HOSTED_ON_LOW_MEM
			default y
			help
				On comparing with slave packet stats helps to understand any packet loss at hosted

		config ESP_PKT_STATS_INTERVAL_SEC
			depends on ESP_PKT_STATS
			int "Packet stats reporting interval (sec)"
			default 30

		config ESP_HOSTED_FUNCTION_PROFILING
			bool "Enable function execution time profiling"
			default n
			help
				Enable this option to measure and report function execution times.
				This is useful for performance profiling and optimization.

		config ESP_HOSTED_FUNCTION_PROFILING_MAX_ENTRIES
			int "Maximum number of functions to profile"
			depends on ESP_HOSTED_FUNCTION_PROFILING
			default 10
			range 1 50
			help
				Maximum number of unique functions that can be profiled simultaneously.
				Each entry consumes memory, so keep this value reasonable based on
				available memory.
	endmenu

	config NETWORK_SPLIT_ENABLED
		depends on !IDF_TARGET_ESP32C2 && !IDF_TARGET_ESP32C3
		bool "Allow Network Split using packet port number"
		default y
		help
			Enable the LWIP at slave, additionally to host network stack

	menu "Network split mode configuration"
		depends on NETWORK_SPLIT_ENABLED

		menu "Slave side (local) LWIP port range (static)"
			config LWIP_TCP_LOCAL_PORT_RANGE_START
				int "Slave TCP start port"
				default 61440
				help
					Slave side TCP start port. Host defaults to 49152
					Slave range: 61440-65535
					Host range: 49152-61439

			config LWIP_TCP_LOCAL_PORT_RANGE_END
				int "Slave TCP end port"
				default 65535
				help
					Slave side TCP end port. Host defaults to 61439
					Slave range: 61440-65535
					Host range: 49152-61439

			config LWIP_UDP_LOCAL_PORT_RANGE_START
				int "Slave UDP start port"
				default 61440
				help
					Slave side UDP start port. Host defaults to 49152
					Slave range: 61440-65535
					Host range: 49152-61439

			config LWIP_UDP_LOCAL_PORT_RANGE_END
				int "Slave UDP end port"
				default 65535
				help
					Slave side UDP end port. Host defaults to 61439
					Slave range: 61440-65535
					Host range: 49152-61439
		endmenu

		menu "Host side (remote) LWIP port range (static)"
			config LWIP_TCP_REMOTE_PORT_RANGE_START
				int "Host TCP start port"
				default 49152
				help
					Host side TCP start port. Slave defaults to 61440
					Slave range: 61440-65535
					Host range: 49152-61439

			config LWIP_TCP_REMOTE_PORT_RANGE_END
				int "Host TCP end port"
				default 61439
				help
					Host side TCP end port. Slave defaults to 65535
					Slave range: 61440-65535
					Host range: 49152-61439

			config LWIP_UDP_REMOTE_PORT_RANGE_START
				int "Host UDP start port"
				default 49152
				help
					Host side UDP start port. Slave defaults to 61440
					Slave range: 61440-65535
					Host range: 49152-61439

			config LWIP_UDP_REMOTE_PORT_RANGE_END
				int "Host UDP end port"
				default 61439
				help
					Host side UDP end port. Slave defaults to 65535
					Slave range: 61440-65535
					Host range: 49152-61439
		endmenu

		config ESP_HOSTED_HOST_RESERVED_PORTS_CONFIGURED
			bool "Extra port forwarding to host (static)"
			default y
			help
				Enable static port forwarding to host for specific ports

		menu "Host Static Port Forwarding"
			depends on ESP_HOSTED_HOST_RESERVED_PORTS_CONFIGURED

			config ESP_HOSTED_HOST_RESERVED_TCP_SRC_PORTS
				string "TCP source ports to forward to host (comma separated)"
				default "22,8554"
				help
					Comma separated list of TCP source ports that will be allowed from host (Max 10)

			config ESP_HOSTED_HOST_RESERVED_TCP_DEST_PORTS
				string "TCP destination ports to forward to host (comma separated)"
				default "22,80,443,8080,8554"
				help
					Comma separated list of TCP destination ports that will be forwarded to host (Max 10)

			config ESP_HOSTED_HOST_RESERVED_UDP_SRC_PORTS
				string "UDP source ports to allowed from host (comma separated)"
				default ""
				help
					Comma separated list of UDP source ports that will be forwarded to host (Max 10)

			config ESP_HOSTED_HOST_RESERVED_UDP_DEST_PORTS
				string "UDP destination ports to forward to host (comma separated)"
				default "53,123"
				help
					Comma separated list of UDP destination ports that will be forwarded to host (Max 10)
		endmenu

		choice
			prompt "Destination LWIP for unfiltered packet"
			default ESP_DEFAULT_LWIP_SLAVE
			help
				Packets having destination port within 'remote' port range are forwarded to host. Rest unfiltered packets, are to be sent to this LWIP. Please note:
				(1) These settings are only for IP packets, yet.
				(2) Extra filtering may be in effect to respond some packets locally by slave LWIP.

			config ESP_DEFAULT_LWIP_SLAVE
				bool "Send packet to slave LWIP"

			config ESP_DEFAULT_LWIP_HOST
				bool "Send packet to host LWIP"

			config ESP_DEFAULT_LWIP_BOTH
				bool "Send packet to both LWIPs"
		endchoice

	endmenu

	config HOST_DEEP_SLEEP_ALLOWED
		bool "Allow host to enter deep sleep. Slave will wakeup host using GPIO"
		default n
		help
			Allow host to power save.
			Please note: This is not yet supported, would be added in upcoming releases

	menu "Host deep sleep config"
		depends on HOST_DEEP_SLEEP_ALLOWED

		config HOST_WAKEUP_GPIO
			int "Host wakeup GPIO"
			default 23 if IDF_TARGET_ESP32 && !SPI_VSPI
			default 2 if IDF_TARGET_ESP32C6
			default 1 if IDF_TARGET_ESP32C3
			default 25 if IDF_TARGET_ESP32C5
			default 6 if IDF_TARGET_ESP32C2 && C2_C5_MODULE_SUB_BOARD
			default -1
	endmenu

	config ESP_HOSTED_CLI_ENABLED
		depends on !IDF_TARGET_ESP32C2 && !IDF_TARGET_ESP32C3
		bool "Start CLI at slave"
		default y

	choice "Wi-Fi control"
		prompt "Wi-Fi control"
		default SLAVE_MANAGES_WIFI

		config SLAVE_MANAGES_WIFI
			bool "Slave manages Wi-Fi"
			help
				If true, slave will manage Wi-Fi.

		config HOST_MANAGES_WIFI
			bool "Host manages Wi-Fi"
			help
				If true, host will manage Wi-Fi.

		config BOTH_MANAGES_WIFI
			bool "Both host and slave manage Wi-Fi"
			help
				If true, both host and slave will manage Wi-Fi.
	endchoice

	menu "Wi-Fi Default Example config"

		config ESP_WIFI_SSID
			string "WiFi SSID"
			default "myssid"
			help
				SSID (network name) for the example to connect to.

		config ESP_WIFI_PASSWORD
			string "WiFi Password"
			default "mypassword"
			help
				WiFi password (WPA or WPA2) for the example to use.

		choice ESP_WIFI_SAE_MODE
			prompt "WPA3 SAE mode selection"
			default ESP_WPA3_SAE_PWE_BOTH
			help
				Select mode for SAE as Hunt and Peck, H2E or both.
			config ESP_WPA3_SAE_PWE_HUNT_AND_PECK
				bool "HUNT AND PECK"
			config ESP_WPA3_SAE_PWE_HASH_TO_ELEMENT
				bool "H2E"
			config ESP_WPA3_SAE_PWE_BOTH
				bool "BOTH"
		endchoice

		config ESP_WIFI_PW_ID
			string "PASSWORD IDENTIFIER"
			depends on  ESP_WPA3_SAE_PWE_HASH_TO_ELEMENT|| ESP_WPA3_SAE_PWE_BOTH
			default ""
			help
				password identifier for SAE H2E

		config ESP_MAXIMUM_RETRY
			int "Maximum retry"
			default 5
			help
				Set the Maximum retry to avoid station reconnecting to the AP unlimited when the AP is really inexistent.

		choice ESP_WIFI_SCAN_AUTH_MODE_THRESHOLD
			prompt "WiFi Scan auth mode threshold"
			default ESP_WIFI_AUTH_WPA2_PSK
			help
				The weakest authmode to accept in the scan mode.
				This value defaults to ESP_WIFI_AUTH_WPA2_PSK incase password is present and ESP_WIFI_AUTH_OPEN is used.
				Please select ESP_WIFI_AUTH_WEP/ESP_WIFI_AUTH_WPA_PSK incase AP is operating in WEP/WPA mode.

			config ESP_WIFI_AUTH_OPEN
				bool "OPEN"
			config ESP_WIFI_AUTH_WEP
				bool "WEP"
			config ESP_WIFI_AUTH_WPA_PSK
				bool "WPA PSK"
			config ESP_WIFI_AUTH_WPA2_PSK
				bool "WPA2 PSK"
			config ESP_WIFI_AUTH_WPA_WPA2_PSK
				bool "WPA/WPA2 PSK"
			config ESP_WIFI_AUTH_WPA3_PSK
				bool "WPA3 PSK"
			config ESP_WIFI_AUTH_WPA2_WPA3_PSK
				bool "WPA2/WPA3 PSK"
			config ESP_WIFI_AUTH_WAPI_PSK
				bool "WAPI PSK"
		endchoice

#		choice WIFI_CMD_DEFAULT_COUNTRY
#			prompt "Set default country during initialize wifi"
#			default WIFI_CMD_DEFAULT_COUNTRY_CN
#			help
#				Set default wifi country during initialize wifi
#
#			config WIFI_CMD_DEFAULT_COUNTRY_NONE
#				bool
#				prompt "Do not set country code"
#
#			config WIFI_CMD_DEFAULT_COUNTRY_CN
#				bool
#				prompt "Set country code to CN (1-13)"
#		endchoice
	endmenu


	menu "Example to run"
		depends on NETWORK_SPLIT_ENABLED

		config ESP_HOSTED_COPROCESSOR_EXAMPLE_MQTT
			bool "MQTT client example"
			default y

		menu "MQTT client config"
			depends on ESP_HOSTED_COPROCESSOR_EXAMPLE_MQTT
			config BROKER_URL
				string "Broker URL"
				default "mqtt://mqtt.eclipseprojects.io"
				help
					URL of the broker to connect to

			config BROKER_URL_FROM_STDIN
				bool
				default y if BROKER_URL = "FROM_STDIN"

		endmenu

		config ESP_HOSTED_COPROCESSOR_EXAMPLE_HTTP_CLIENT
			bool "HTTP client example"
			default y

		menu "HTTP client config"
			depends on ESP_HOSTED_COPROCESSOR_EXAMPLE_HTTP_CLIENT

			config HTTP_WEBSERVER
				string "HTTP webserver to send req"
				default "example.com"

			config HTTP_WEBSERVER_PORT
				string "HTTP webserver port"
				default "80"

			config HTTP_WEBSERVER_PATH
				string "HTTP webserver path"
				default "/"

			config HTTP_REQ_DELAY
				int "Delay after every http request (seconds)"
				default 10

		endmenu
	endmenu
endmenu
```
