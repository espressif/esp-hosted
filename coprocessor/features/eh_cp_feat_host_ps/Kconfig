## esp_hosted_ng/esp/esp_driver/network_adapter/main/Kconfig.projbuild
```kconfig
menu "Example Configuration"

    choice ESP_HOST_INTERFACE
        bool "Transport layer"
        default ESP_SDIO_HOST_INTERFACE if SOC_SDIO_SLAVE_SUPPORTED
        default ESP_SPI_HOST_INTERFACE
        help
            Bus interface to be used for communication with the host

        config ESP_SDIO_HOST_INTERFACE
            bool "SDIO interface"
            depends on SOC_SDIO_SLAVE_SUPPORTED
            help
                Enable/Disable SDIO host interface

        config ESP_SPI_HOST_INTERFACE
            bool "SPI interface"
            help
                Enable/Disable SPI host interface
    endchoice

    menu "SPI Configuration"
        depends on ESP_SPI_HOST_INTERFACE

    config ESP_SPI_CONTROLLER
        int "SPI controller to use"
        depends on IDF_TARGET_ESP32 && ESP_SPI_HOST_INTERFACE
        default 2
	range 2 3
        help
            SPI controller to be used. HSPI->2, VSPI->3

    config ESP_SPI_GPIO_HANDSHAKE
        int "GPIO pin for handshake"
        default 3 if IDF_TARGET_ESP32C2
        default 3 if IDF_TARGET_ESP32C3
        default 3 if IDF_TARGET_ESP32C6
        default 3 if IDF_TARGET_ESP32C5
        default 2
        help
            GPIO pin to use for handshake with other spi controller

    config ESP_SPI_GPIO_DATA_READY
        int "GPIO pin for data ready interrupt"
        default 4
        help
            GPIO pin for indicating host that SPI slave has data to be read by host

    config ESP_SPI_TX_Q_SIZE
        int "ESP to Host SPI queue size"
        default 10 if IDF_TARGET_ESP32
        default 20
        help
            Very small tx queue will lower ESP == SPI ==> Host data rate

    config ESP_SPI_RX_Q_SIZE
        int "Host to ESP SPI queue size"
        default 10 if IDF_TARGET_ESP32
        default 20
        help
            Very small RX queue will lower ESP <== SPI == Host data rate

    config ESP_SPI_CHECKSUM
        bool "SPI checksum ENABLE/DISABLE"
        default y
        help
            ENABLE/DISABLE software SPI checksum
    endmenu

    menu "SDIO Configuration"
        depends on ESP_SDIO_HOST_INTERFACE

    config ESP_SDIO_CHECKSUM
        bool "SDIO checksum ENABLE/DISABLE"
        default n
        help
            ENABLE/DISABLE software SDIO checksum

    endmenu

    config HOST_WAKEUP_GPIO
        int "GPIO to wakeup GPIO"
        depends on ESP_SDIO_HOST_INTERFACE
        default 22 if IDF_TARGET_ESP32
        default 4 if IDF_TARGET_ESP32C6
        default 5 if IDF_TARGET_ESP32C5
        help
            GPIO pin used to wake-up host

    config SDIO_CARD_DETECTION_PIN_SUPPORT
        bool "SDIO CD Pin support"
        default n
        help
            Some hosts' implementations may require an additional signal by firmware
            to indicate that it's ready for communication. This config option enables
            support for that extra signal. GPIO pin number can be configured using SDIO_CD_PIN_GPIO.

    config SDIO_CD_PIN_GPIO
        int "CD Pin GPIO"
        depends on ESP_SDIO_HOST_INTERFACE
        depends on SDIO_CARD_DETECTION_PIN_SUPPORT
        default 6
        help
            Some hosts' implementations may require an additional signal by firmware
            to indicate that it's ready for communication. This GPIO pin used to indicate
            host that card is ready for communication.

    choice SDIO_SLAVE_SPEED
        prompt "SDIO slave speed"
        depends on ESP_SDIO_HOST_INTERFACE
        default SDIO_HIGH_SPEED
        help
            SDIO slave speed, could be either default speed or high speed.
            Enabling this will cause the host to see highspeed capability.

        config SDIO_DEFAULT_SPEED
            bool "Default Speed"

        config SDIO_HIGH_SPEED
            bool "High Speed"
    endchoice

    config ESP_OTA_WORKAROUND
        bool "OTA workaround - Add sleeps while OTA write"
        default y
        help
            Enable/disable sleeps while OTA operations

    config ESP_SERIAL_DEBUG
        bool "Debug Serial driver data path"
        default 0
        help
            Enable/disable debug prints in serial driver data path

    config ESP_WLAN_DEBUG
        bool "Debug Wlan driver data path"
        default 0
        help
            Enable/disable debug prints in wlan driver data path

    config ESP_BT_DEBUG
        bool "Debug Bluetooth driver data path"
        default 0
        help
            Enable/disable debug prints in Bluetooth driver data path

    config EXAMPLE_HCI_UART_BAUDRATE
        int "UART Baudrate for HCI"
        range 115200 921600
        depends on IDF_TARGET_ESP32C3 || IDF_TARGET_ESP32S3 || IDF_TARGET_ESP32C2 || IDF_TARGET_ESP32C6
        default 921600
        help
            UART Baudrate for HCI over ESP32C3/S3/C6. Please use standard baudrate.

endmenu
```

## esp_hosted_ng/esp/esp_driver/network_adapter/sdkconfig.defaults.esp32c2
```kconfig
CONFIG_ESP_DEFAULT_CPU_FREQ_MHZ_120=y
CONFIG_ESP_DEFAULT_CPU_FREQ_MHZ=120
CONFIG_FREERTOS_UNICORE=y

# BT Configuration
CONFIG_BT_ENABLED=y
CONFIG_BT_CONTROLLER_ONLY=y
CONFIG_BT_BLUEDROID_ENABLED=
CONFIG_BT_LE_SLEEP_ENABLE=y

#UART pins, Enable below config, delete sdkconfig and rebuild
#CONFIG_BT_LE_HCI_INTERFACE_USE_UART=y
CONFIG_BT_LE_HCI_UART_FLOWCTRL=n
CONFIG_BT_LE_HCI_UART_TX_PIN=5
CONFIG_BT_LE_HCI_UART_RX_PIN=18

CONFIG_ESP_WIFI_NVS_ENABLED=

CONFIG_ESPTOOLPY_FLASHSIZE_4MB=n
CONFIG_ESPTOOLPY_FLASHSIZE_2MB=y
CONFIG_PARTITION_TABLE_TWO_OTA=y
CONFIG_PARTITION_TABLE_CUSTOM=y
CONFIG_PARTITION_TABLE_CUSTOM_FILENAME="partitions.esp32c2.csv"
CONFIG_PARTITION_TABLE_FILENAME="partitions.esp32c2.csv"

CONFIG_ESP_SPI_RX_Q_SIZE=6
CONFIG_ESP_SPI_TX_Q_SIZE=6

CONFIG_ESP_WIFI_STATIC_RX_BUFFER_NUM=14
CONFIG_ESP_WIFI_DYNAMIC_RX_BUFFER_NUM=6
CONFIG_ESP_WIFI_DYNAMIC_TX_BUFFER_NUM=6
CONFIG_ESP_WIFI_AMPDU_TX_ENABLED=y
CONFIG_ESP_WIFI_TX_BA_WIN=6
CONFIG_ESP_WIFI_AMPDU_RX_ENABLED=y
CONFIG_ESP_WIFI_RX_BA_WIN=6

CONFIG_BT_BTC_TASK_STACK_SIZE=4096
# CONFIG_BT_BLE_50_FEATURES_SUPPORTED is not set
CONFIG_BT_BLE_42_FEATURES_SUPPORTED=y
CONFIG_BT_BLE_ACT_SCAN_REP_ADV_SCAN=y
CONFIG_BT_GATTC_CONNECT_RETRY_COUNT=20


# less memory usage
CONFIG_BT_ACL_CONNECTIONS=2
CONFIG_BT_LE_MSYS_1_BLOCK_COUNT=6
CONFIG_BT_LE_MSYS_2_BLOCK_COUNT=8
CONFIG_BT_LE_ACL_BUF_COUNT=8
CONFIG_BT_LE_HCI_EVT_HI_BUF_COUNT=16
CONFIG_BT_LE_HCI_EVT_LO_BUF_COUNT=4
CONFIG_LWIP_MAX_SOCKETS=4
CONFIG_LWIP_TCPIP_RECVMBOX_SIZE=6
CONFIG_FREERTOS_PLACE_FUNCTIONS_INTO_FLASH=y
CONFIG_FREERTOS_PLACE_SNAPSHOT_FUNS_INTO_FLASH=y
CONFIG_RINGBUF_PLACE_FUNCTIONS_INTO_FLASH=y
```

## esp_hosted_ng/esp/esp_driver/network_adapter/sdkconfig.defaults.esp32c3
```kconfig
CONFIG_ESP32_DEFAULT_CPU_FREQ_160=y
CONFIG_ESP32_DEFAULT_CPU_FREQ_MHZ=160
CONFIG_FREERTOS_UNICORE=y
CONFIG_SDIO_DAT2_DISABLED=

# BT Configuration
CONFIG_BT_ENABLED=y
CONFIG_BT_CONTROLLER_ONLY=y
CONFIG_BT_BLUEDROID_ENABLED=
CONFIG_BTDM_CTRL_MODE_BLE_ONLY=y
CONFIG_BTDM_CTRL_MODE_BR_EDR_ONLY=n
CONFIG_BTDM_CTRL_MODE_BTDM=n
CONFIG_BTDM_CTRL_HCI_MODE_VHCI=y

# BT over UART
# Enable below config and delete sdkconfig, build/ and rebuild for UART HCI
#CONFIG_BTDM_CTRL_HCI_MODE_UART_H4=y
#CONFIG_BTDM_CTRL_HCI_UART_NO=1
#CONFIG_BTDM_CTRL_HCI_UART_BAUDRATE=921600
#CONFIG_BTDM_CTRL_HCI_UART_FLOW_CTRL_EN=y
#CONFIG_BTDM_CTRL_HCI_UART_TX_PIN=5
#CONFIG_BTDM_CTRL_HCI_UART_RX_PIN=18
#CONFIG_BTDM_CTRL_HCI_UART_CTS_PIN=8
#CONFIG_BTDM_CTRL_HCI_UART_RTS_PIN=19

CONFIG_ESP32_WIFI_NVS_ENABLED=
CONFIG_ESP_WIFI_STATIC_RX_BUFFER_NUM=20
CONFIG_ESP_WIFI_DYNAMIC_RX_BUFFER_NUM=40
CONFIG_ESP_WIFI_DYNAMIC_TX_BUFFER_NUM=40
CONFIG_ESP_WIFI_AMPDU_TX_ENABLED=y
CONFIG_ESP_WIFI_TX_BA_WIN=32
CONFIG_ESP_WIFI_AMPDU_RX_ENABLED=y
CONFIG_ESP_WIFI_RX_BA_WIN=32
```

## esp_hosted_ng/esp/esp_driver/network_adapter/sdkconfig.defaults.esp32c5
```kconfig
# BLE over UART:
# Enable below config, delete sdkconfig, build/ and rebuild for UART HCI
#CONFIG_BT_LE_HCI_INTERFACE_USE_UART=y
#CONFIG_BT_LE_HCI_UART_TX_PIN=23
#CONFIG_BT_LE_HCI_UART_RX_PIN=24
#CONFIG_BT_LE_HCI_UART_FLOWCTRL=n
CONFIG_PARTITION_TABLE_CUSTOM=y
CONFIG_PARTITION_TABLE_CUSTOM_FILENAME="partitions.esp32c5.csv"
CONFIG_PARTITION_TABLE_FILENAME="partitions.esp32c5.csv"

CONFIG_ESP_WIFI_STATIC_RX_BUFFER_NUM=10
CONFIG_ESP_WIFI_DYNAMIC_RX_BUFFER_NUM=32
CONFIG_ESP_WIFI_DYNAMIC_TX_BUFFER_NUM=32
CONFIG_ESP_WIFI_AMPDU_TX_ENABLED=y
CONFIG_ESP_WIFI_TX_BA_WIN=6
CONFIG_ESP_WIFI_AMPDU_RX_ENABLED=y
CONFIG_ESP_WIFI_RX_BA_WIN=6
CONFIG_ESP_WIFI_NVS_ENABLED=n
CONFIG_ESP_WIFI_ENABLE_WIFI_RX_STATS=n
CONFIG_ESP_WIFI_ENABLE_WIFI_TX_STATS=n
```

## esp_hosted_ng/esp/esp_driver/network_adapter/sdkconfig.defaults.esp32c61
```kconfig
# BT Configuration
CONFIG_BT_ENABLED=y
CONFIG_BT_CONTROLLER_ONLY=y
CONFIG_BT_BLUEDROID_ENABLED=
CONFIG_BTDM_CTRL_MODE_BLE_ONLY=y
CONFIG_BTDM_CTRL_MODE_BR_EDR_ONLY=n
CONFIG_BTDM_CTRL_MODE_BTDM=n
CONFIG_PARTITION_TABLE_CUSTOM=y
CONFIG_PARTITION_TABLE_CUSTOM_FILENAME="partitions.esp32c61.csv"
CONFIG_PARTITION_TABLE_FILENAME="partitions.esp32c61.csv"

# SPI/SDIO only
CONFIG_BT_LE_HCI_INTERFACE_USE_RAM=y

# BLE over UART:
# Enable below config, delete sdkconfig, build/ and rebuild
# CONFIG_BT_LE_HCI_INTERFACE_USE_UART=y
 CONFIG_BT_LE_HCI_UART_TX_PIN=5
 CONFIG_BT_LE_HCI_UART_RX_PIN=12
 CONFIG_BT_LE_HCI_UART_FLOWCTRL=n
 # 4 pin solution is not working yet for c6
# #CONFIG_BT_LE_HCI_UART_RTS_PIN=9
# #CONFIG_BT_LE_HCI_UART_CTS_PIN=13

CONFIG_BT_LE_HCI_TRANS_TASK_STACK_SIZE=2048

CONFIG_ESP32_WIFI_NVS_ENABLED=

CONFIG_BT_BTC_TASK_STACK_SIZE=4096
# CONFIG_BT_BLE_50_FEATURES_SUPPORTED is not set
CONFIG_BT_BLE_42_FEATURES_SUPPORTED=y
CONFIG_BT_BLE_ACT_SCAN_REP_ADV_SCAN=y
CONFIG_BT_GATTC_CONNECT_RETRY_COUNT=20


CONFIG_BT_ACL_CONNECTIONS=2
CONFIG_BT_LE_MSYS_1_BLOCK_COUNT=6
CONFIG_BT_LE_MSYS_2_BLOCK_COUNT=8
CONFIG_BT_LE_ACL_BUF_COUNT=8
CONFIG_BT_LE_HCI_EVT_HI_BUF_COUNT=16
CONFIG_BT_LE_HCI_EVT_LO_BUF_COUNT=4
CONFIG_LWIP_MAX_SOCKETS=4
CONFIG_LWIP_TCPIP_RECVMBOX_SIZE=6
CONFIG_FREERTOS_PLACE_FUNCTIONS_INTO_FLASH=y
CONFIG_FREERTOS_PLACE_SNAPSHOT_FUNS_INTO_FLASH=y
CONFIG_RINGBUF_PLACE_FUNCTIONS_INTO_FLASH=y
```
