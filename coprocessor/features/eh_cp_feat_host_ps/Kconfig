## esp_hosted_fg/esp/esp_driver/network_adapter/sdkconfig.defaults
```kconfig
# BT Configuration
CONFIG_BT_ENABLED=y
CONFIG_BT_CONTROLLER_ONLY=y

# OTA
CONFIG_ESPTOOLPY_FLASHSIZE_4MB=y
CONFIG_PARTITION_TABLE_TWO_OTA=y

# OS
CONFIG_FREERTOS_HZ=1000
CONFIG_ESP_WIFI_NVS_ENABLED=y

# Linux Host Deep Sleep allowed?
#-------------------------------
# Linux host power save is not yet supported on FG
CONFIG_HOST_DEEP_SLEEP_ALLOWED=n
CONFIG_HOST_WAKEUP_GPIO=-1
```

## esp_hosted_fg/esp/esp_driver/network_adapter/sdkconfig.defaults.esp32
```kconfig
CONFIG_ESP32_DEFAULT_CPU_FREQ_240=y
CONFIG_SDIO_DAT2_DISABLED=

# BT Configuration
CONFIG_BT_ENABLED=y
CONFIG_BT_CONTROLLER_ONLY=y
CONFIG_BT_BLUEDROID_ENABLED=
CONFIG_BTDM_CONTROLLER_MODE_BTDM=y
CONFIG_BTDM_CONTROLLER_HCI_MODE_VHCI=y
CONFIG_BTDM_CTRL_AUTO_LATENCY=y
CONFIG_BTDM_CONTROLLER_MODEM_SLEEP=y
CONFIG_BTDM_CTRL_MODEM_SLEEP=y

# BT over UART
#CONFIG_BTDM_CONTROLLER_HCI_MODE_UART_H4=y
#CONFIG_BTDM_CTRL_HCI_MODE_UART_H4=y
#CONFIG_BT_HCI_UART_NO=1
#CONFIG_BT_HCI_UART_BAUDRATE=921600

#CO-EX config
CONFIG_FREERTOS_UNICORE=n
CONFIG_ESP32_WIFI_TASK_PINNED_TO_CORE_1=y
CONFIG_BTDM_CONTROLLER_PINNED_TO_CORE=0
CONFIG_BTDM_CTRL_PINNED_TO_CORE=0
CONFIG_BTDM_CTRL_PINNED_TO_CORE_0=y

CONFIG_ESP32_WIFI_STATIC_RX_BUFFER_NUM=16
CONFIG_ESP32_WIFI_DYNAMIC_RX_BUFFER_NUM=32
CONFIG_ESP32_WIFI_DYNAMIC_TX_BUFFER=y
CONFIG_ESP32_WIFI_DYNAMIC_TX_BUFFER_NUM=64

# OTA
CONFIG_ESPTOOLPY_FLASHSIZE_4MB=y

# partitions
CONFIG_PARTITION_TABLE_CUSTOM=y
CONFIG_PARTITION_TABLE_CUSTOM_FILENAME="partitions.esp32.csv"

# iram optimization
CONFIG_ESP_WIFI_RX_IRAM_OPT=y
CONFIG_ESP_WIFI_IRAM_OPT=y
CONFIG_FREERTOS_PLACE_FUNCTIONS_INTO_FLASH=y
CONFIG_RINGBUF_PLACE_FUNCTIONS_INTO_FLASH=y
CONFIG_ESP_SYSTEM_ESP32_SRAM1_REGION_AS_IRAM=y

CONFIG_COMPILER_OPTIMIZATION_PERF=y
#CONFIG_FREERTOS_GENERATE_RUN_TIME_STATS=y
```

## esp_hosted_fg/esp/esp_driver/network_adapter/sdkconfig.defaults.esp32c2
```kconfig
# 1. CPU
#--------
CONFIG_ESP_DEFAULT_CPU_FREQ_MHZ_120=y

# 2. BT Configuration
#---------------------
CONFIG_BT_ENABLED=n
CONFIG_BT_CONTROLLER_ONLY=y
CONFIG_BT_LE_SLEEP_ENABLE=y

# 2.1 BLE over SPI/SDIO
#-----------------------
CONFIG_BT_LE_HCI_INTERFACE_USE_RAM=y

# 2.2 BLE over UART
#-------------------
#UART pins, Enable below config, delete sdkconfig and rebuild
#CONFIG_BT_LE_HCI_INTERFACE_USE_UART=y
#CONFIG_BT_LE_HCI_UART_FLOWCTRL=n
#CONFIG_BT_LE_HCI_UART_TX_PIN=5
#CONFIG_BT_LE_HCI_UART_RX_PIN=18


# 3. Partition Table
#--------------------
CONFIG_PARTITION_TABLE_CUSTOM=y
CONFIG_PARTITION_TABLE_CUSTOM_FILENAME="partitions.esp32c2.csv"

# 4. Mempool
#------------
CONFIG_ESP_CACHE_MALLOC=y


# 5 LWIP split
#---------------

CONFIG_NETWORK_SPLIT_ENABLED=n


# 6. Wifi config
#----------------
#CONFIG_WIFI_CMD_BASIC_ONLY=y

CONFIG_ESP_WIFI_STATIC_RX_BUFFER_NUM=8
CONFIG_ESP_WIFI_DYNAMIC_RX_BUFFER_NUM=16
CONFIG_ESP_WIFI_DYNAMIC_TX_BUFFER_NUM=16
CONFIG_ESP_WIFI_AMPDU_TX_ENABLED=y
CONFIG_ESP_WIFI_TX_BA_WIN=8
#CONFIG_ESP_WIFI_TX_BA_WIN=16
CONFIG_ESP_WIFI_AMPDU_RX_ENABLED=y
CONFIG_ESP_WIFI_RX_BA_WIN=8
#CONFIG_ESP_WIFI_RX_BA_WIN=14

CONFIG_ESP_WIFI_RX_IRAM_OPT=y
CONFIG_ESP_WIFI_IRAM_OPT=y


# 7. Optimizations
#-------------------
CONFIG_COMPILER_OPTIMIZATION_SIZE=y
#CONFIG_COMPILER_OPTIMIZATION_PERF=y
CONFIG_ESPTOOLPY_FLASHMODE_QIO=y


# 8. Stats
#-----------
CONFIG_ESP_PKT_STATS=y


# 9. Mem optimizations
#---------------------
CONFIG_FREERTOS_PLACE_FUNCTIONS_INTO_FLASH=y
CONFIG_ESP32_DEFAULT_CPU_FREQ_120=y
CONFIG_ESP32_DEFAULT_CPU_FREQ_MHZ=120
CONFIG_FREERTOS_UNICORE=y

#10. C2 specific opts
#---------------------
CONFIG_ESPTOOLPY_FLASHSIZE_4MB=n
CONFIG_ESPTOOLPY_FLASHSIZE_2MB=y

CONFIG_ESP_DEFAULT_TASK_STACK_SIZE=2048

#11. C2 26 MHz XTAL chips
# C2 generally in MP has 26MHz.
# If your C2 has 40MHz, just comment below lines
#---------------------------------
CONFIG_SOC_XTAL_SUPPORT_26M=y
CONFIG_XTAL_FREQ_26=y
```

## esp_hosted_fg/esp/esp_driver/network_adapter/sdkconfig.defaults.esp32c3
```kconfig
# 1. CPU
#--------
CONFIG_ESP_DEFAULT_CPU_FREQ_MHZ_160=y

# 2. BT Configuration
#---------------------
CONFIG_BT_ENABLED=y
CONFIG_BT_CONTROLLER_ONLY=y
CONFIG_BT_BLUEDROID_ENABLED=
CONFIG_BT_LE_SLEEP_ENABLE=y

# 3.1 BLE over SPI/SDIO
#-----------------------
CONFIG_BT_LE_HCI_INTERFACE_USE_RAM=y

# 3.2 BLE over UART
#-------------------
# Enable below config, delete sdkconfig, build/ and rebuild
# CONFIG_BT_LE_HCI_INTERFACE_USE_UART=y
# CONFIG_BT_LE_HCI_UART_TX_PIN=5
# CONFIG_BT_LE_HCI_UART_RX_PIN=18
# CONFIG_BT_LE_HCI_UART_FLOWCTRL=n
# #CONFIG_BT_LE_HCI_UART_RTS_PIN=19
# #CONFIG_BT_LE_HCI_UART_CTS_PIN=8


# 4. Partition Table
#--------------------
CONFIG_PARTITION_TABLE_CUSTOM=y
CONFIG_PARTITION_TABLE_CUSTOM_FILENAME="partitions.esp32c3.csv"

# 5. Mempool
#------------
CONFIG_ESP_CACHE_MALLOC=y


# 6.1 LWIP split
#---------------

CONFIG_SLAVE_LWIP_ENABLED=y
CONFIG_LWIP_TCP_LOCAL_PORT_RANGE_START=61440
CONFIG_LWIP_TCP_LOCAL_PORT_RANGE_END=65535
CONFIG_LWIP_UDP_LOCAL_PORT_RANGE_START=61440
CONFIG_LWIP_UDP_LOCAL_PORT_RANGE_END=65535

CONFIG_ESP_DEFAULT_LWIP_SLAVE=y

# 6.2 LWIP split examples
#-------------------------
CONFIG_ESP_HOSTED_COPROCESSOR_EXAMPLE_MQTT=n


# 7. Transport config
#---------------------
# CONFIG_ESP_SDIO_NSEND_PSAMPLE=y
# CONFIG_ESP_SDIO_DEFAULT_SPEED=y
# CONFIG_ESP_SDIO_STREAMING_MODE=n

# For SPI Full duplex C6 on ESP32-P4-Function-EV-Board, please uncomment below
#CONFIG_C6_SPI_WITH_P4=y


# 8. Wifi config
#----------------
CONFIG_WIFI_CMD_BASIC_ONLY=y

CONFIG_ESP_WIFI_STATIC_RX_BUFFER_NUM=10
CONFIG_ESP_WIFI_DYNAMIC_RX_BUFFER_NUM=32
CONFIG_ESP_WIFI_DYNAMIC_TX_BUFFER_NUM=32
CONFIG_ESP_WIFI_AMPDU_TX_ENABLED=y
CONFIG_ESP_WIFI_TX_BA_WIN=16
CONFIG_ESP_WIFI_AMPDU_RX_ENABLED=y
CONFIG_ESP_WIFI_RX_BA_WIN=16

CONFIG_ESP_WIFI_RX_IRAM_OPT=y
CONFIG_ESP_WIFI_IRAM_OPT=y

# 9. LWIP config
#----------------
CONFIG_LWIP_TCP_SND_BUF_DEFAULT=11520
CONFIG_LWIP_TCP_WND_DEFAULT=11520
CONFIG_LWIP_TCP_RECVMBOX_SIZE=16
CONFIG_LWIP_UDP_RECVMBOX_SIZE=16
CONFIG_LWIP_TCPIP_RECVMBOX_SIZE=32
CONFIG_LWIP_TCP_SACK_OUT=y
CONFIG_LWIP_TCPIP_CORE_LOCKING=y
CONFIG_LWIP_TCPIP_CORE_LOCKING_INPUT=y


# 10. Optimizations
#-------------------
CONFIG_COMPILER_OPTIMIZATION_PERF=y
CONFIG_ESPTOOLPY_FLASHMODE_QIO=y
CONFIG_ESPTOOLPY_FLASHFREQ_80M=y
CONFIG_SPI_MASTER_ISR_IN_IRAM=n


# 11. Stats
#-----------
#CONFIG_ESP_HOSTED_FUNCTION_PROFILING=y
CONFIG_ESP_PKT_STATS=y

# 12. Priorities
----------------
CONFIG_IPERF_TRAFFIC_TASK_PRIORITY=18
CONFIG_IPERF_REPORT_TASK_PRIORITY=18
CONFIG_ESP_DEFAULT_TASK_PRIO=18


#13. Mem optimizations
#---------------------
CONFIG_FREERTOS_PLACE_FUNCTIONS_INTO_FLASH=y
```

## esp_hosted_fg/esp/esp_driver/network_adapter/sdkconfig.defaults.esp32c6
```kconfig
CONFIG_SDIO_DAT2_DISABLED=

# BT Configuration
CONFIG_BT_ENABLED=y
CONFIG_BT_CONTROLLER_ONLY=y
CONFIG_BT_BLUEDROID_ENABLED=
CONFIG_BT_LE_SLEEP_ENABLE=y

# SPI/SDIO only
CONFIG_BT_LE_HCI_INTERFACE_USE_RAM=y

# BLE over UART:
# Enable below config, delete sdkconfig, build/ and rebuild
# CONFIG_BT_LE_HCI_INTERFACE_USE_UART=y
CONFIG_BT_LE_HCI_UART_TX_PIN=5
CONFIG_BT_LE_HCI_UART_RX_PIN=12
# CONFIG_BT_LE_HCI_UART_FLOWCTRL=n
# # 4 pin solution is not working yet for c6
# #CONFIG_BT_LE_HCI_UART_RTS_PIN=9
# #CONFIG_BT_LE_HCI_UART_CTS_PIN=13

CONFIG_ESP_CACHE_MALLOC=y
CONFIG_ESP_WIFI_STATIC_RX_BUFFER_NUM=40
CONFIG_ESP_WIFI_DYNAMIC_RX_BUFFER_NUM=60
CONFIG_ESP_WIFI_DYNAMIC_TX_BUFFER_NUM=40
CONFIG_ESP_WIFI_AMPDU_TX_ENABLED=y
CONFIG_ESP_WIFI_TX_BA_WIN=32
CONFIG_ESP_WIFI_AMPDU_RX_ENABLED=y
CONFIG_ESP_WIFI_RX_BA_WIN=32
CONFIG_ESP_WIFI_ENABLE_WIFI_RX_STATS=n
CONFIG_ESP_WIFI_ENABLE_WIFI_TX_STATS=n

# partitions
CONFIG_PARTITION_TABLE_CUSTOM=y
CONFIG_PARTITION_TABLE_CUSTOM_FILENAME="partitions.esp32c6.csv"
```

## esp_hosted_fg/esp/esp_driver/network_adapter/sdkconfig.defaults.esp32s2
```kconfig
# 1. CPU
#--------
CONFIG_ESP_DEFAULT_CPU_FREQ_MHZ=240

# 2. Partition Table
#--------------------
CONFIG_PARTITION_TABLE_CUSTOM=y
CONFIG_PARTITION_TABLE_CUSTOM_FILENAME="partitions.esp32s2.csv"

# 3. Mempool
#------------
CONFIG_ESP_CACHE_MALLOC=y


# 4.1 LWIP split
#---------------

CONFIG_NETWORK_SPLIT_ENABLED=y
CONFIG_LWIP_TCP_LOCAL_PORT_RANGE_START=61440
CONFIG_LWIP_TCP_LOCAL_PORT_RANGE_END=65535
CONFIG_LWIP_UDP_LOCAL_PORT_RANGE_START=61440
CONFIG_LWIP_UDP_LOCAL_PORT_RANGE_END=65535

CONFIG_ESP_DEFAULT_LWIP_SLAVE=y

# 4.2 LWIP split examples
#-------------------------
CONFIG_ESP_HOSTED_COPROCESSOR_EXAMPLE_MQTT=n


# 5. Transport config
#---------------------
# CONFIG_ESP_SDIO_NSEND_PSAMPLE=y
# CONFIG_ESP_SDIO_DEFAULT_SPEED=y
# CONFIG_ESP_SDIO_STREAMING_MODE=n

# For SPI Full duplex C6 on ESP32-P4-Function-EV-Board, please uncomment below
#CONFIG_C6_SPI_WITH_P4=y


# 6. Wifi config
#----------------
CONFIG_WIFI_CMD_BASIC_ONLY=y

CONFIG_ESP_WIFI_STATIC_RX_BUFFER_NUM=10
CONFIG_ESP_WIFI_DYNAMIC_RX_BUFFER_NUM=32
CONFIG_ESP_WIFI_DYNAMIC_TX_BUFFER_NUM=32
CONFIG_ESP_WIFI_AMPDU_TX_ENABLED=y
CONFIG_ESP_WIFI_TX_BA_WIN=16
CONFIG_ESP_WIFI_AMPDU_RX_ENABLED=y
CONFIG_ESP_WIFI_RX_BA_WIN=16

CONFIG_ESP_WIFI_RX_IRAM_OPT=y
CONFIG_ESP_WIFI_IRAM_OPT=y

# 7. LWIP config
#----------------
CONFIG_LWIP_TCP_SND_BUF_DEFAULT=11520
CONFIG_LWIP_TCP_WND_DEFAULT=11520
CONFIG_LWIP_TCP_RECVMBOX_SIZE=16
CONFIG_LWIP_UDP_RECVMBOX_SIZE=16
CONFIG_LWIP_TCPIP_RECVMBOX_SIZE=32
CONFIG_LWIP_TCP_SACK_OUT=y
CONFIG_LWIP_TCPIP_CORE_LOCKING=y
CONFIG_LWIP_TCPIP_CORE_LOCKING_INPUT=y


# 8. Optimizations
#-------------------
CONFIG_COMPILER_OPTIMIZATION_PERF=y
CONFIG_ESPTOOLPY_FLASHMODE_QIO=y
CONFIG_ESPTOOLPY_FLASHFREQ_80M=y
CONFIG_SPI_MASTER_ISR_IN_IRAM=n


# 9. Stats
#-----------
#CONFIG_ESP_HOSTED_FUNCTION_PROFILING=y
CONFIG_ESP_PKT_STATS=y

# 10. Priorities
----------------
CONFIG_IPERF_TRAFFIC_TASK_PRIORITY=18
CONFIG_IPERF_REPORT_TASK_PRIORITY=18
CONFIG_ESP_DEFAULT_TASK_PRIO=18


# 11. Mem optimizations
#---------------------
CONFIG_FREERTOS_PLACE_FUNCTIONS_INTO_FLASH=y
```
