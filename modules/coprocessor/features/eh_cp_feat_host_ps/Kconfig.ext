## slave/sdkconfig.defaults.esp32c5
```kconfig
CONFIG_PARTITION_TABLE_CUSTOM=y
CONFIG_PARTITION_TABLE_CUSTOM_FILENAME="partitions.esp32c5.csv"
```

## slave_driver/network_adapter/main/Kconfig.projbuild
```kconfig
menu "Example Configuration"

    config ESP_SERIAL_DEBUG
        bool "Debug Serial driver data path"
        default 0
        help
            Enable/disable debug prints in serial driver data path

    config ESP_WLAN_DEUG
        bool "Debug Wlan driver data path"
        default 0
        help
            Enable/disable debug prints in wlan driver data path
endmenu
```

## slave_driver/network_adapter/sdkconfig.defaults
```kconfig
CONFIG_ESP32_DEFAULT_CPU_FREQ_160=y
CONFIG_ESP32_DEFAULT_CPU_FREQ_MHZ=160
CONFIG_FREERTOS_UNICORE=y
CONFIG_SDIO_DAT2_DISABLED=

# BT Configuration
CONFIG_BT_ENABLED=y
CONFIG_BTDM_CONTROLLER_MODE_BTDM=y
CONFIG_BTDM_CONTROLLER_HCI_MODE_UART_H4=y
CONFIG_BT_HCI_UART=y
CONFIG_BT_HCI_UART_NO=1
CONFIG_BT_HCI_UART_BAUDRATE=115200
```
