## modules/coprocessor/features/eh_cp_feat_host_ps/Kconfig.ext
```kconfig
menuconfig ESP_HOSTED_CP_FEAT_HOST_PS
	depends on ESP_HOSTED_CP_FOR_MCU
	bool "Host Power Save"
	default n
	help
		Allow host to enter power save mode.
		Host will notify slave before entering and exiting the power save

if ESP_HOSTED_CP_FEAT_HOST_PS

	config ESP_HOSTED_CP_FEAT_HOST_PS_READY
		bool
		default y if ESP_HOSTED_CP_FOR_MCU

	config ESP_HOSTED_CP_FEAT_HOST_PS_DEEP_SLEEP
		bool "Allow host to enter deep sleep. Slave will wakeup host using GPIO when needed"
		default y
		help
			Allow host to enter deep sleep mode. Host will notify slave before entering deep sleep.

	menu "Host deep sleep - wakeup config"
		config ESP_HOSTED_CP_FEAT_HOST_PS_HOST_WAKEUP_GPIO
			int "Slave out: Host wakeup GPIO"
			default 23 if IDF_TARGET_ESP32 && !SPI_VSPI
			default 2 if IDF_TARGET_ESP32C6 && !EH_TRANSPORT_CP_SPI_HD
			default 9 if IDF_TARGET_ESP32C6 && EH_TRANSPORT_CP_SPI_HD
			default 1 if IDF_TARGET_ESP32C3
			default 25 if IDF_TARGET_ESP32C5
			default 6 if IDF_TARGET_ESP32C2 && C2_C5_MODULE_SUB_BOARD
			default -1
		choice ESP_HOSTED_CP_FEAT_HOST_PS_HOST_WAKEUP_GPIO_LEVEL
			prompt "Host Wakeup GPIO Level"
			default ESP_HOSTED_CP_FEAT_HOST_PS_HOST_WAKEUP_GPIO_LEVEL_HIGH

			config ESP_HOSTED_CP_FEAT_HOST_PS_HOST_WAKEUP_GPIO_LEVEL_HIGH
				bool "High"
			config ESP_HOSTED_CP_FEAT_HOST_PS_HOST_WAKEUP_GPIO_LEVEL_LOW
				bool "Low"
		endchoice

		config ESP_HOSTED_CP_FEAT_HOST_PS_HOST_WAKEUP_GPIO_LEVEL
			int
			default 1 if ESP_HOSTED_CP_FEAT_HOST_PS_HOST_WAKEUP_GPIO_LEVEL_HIGH
			default 0 if ESP_HOSTED_CP_FEAT_HOST_PS_HOST_WAKEUP_GPIO_LEVEL_LOW
			help
				GPIO level to use for host wakeup from sleep.
				Set to 0 to use low level, set to 1 to use high level.
	endmenu

	config ESP_HOSTED_CP_FEAT_HOST_PS_UNLOAD_BUS_WHILE_SLEEPING
		bool "Unload low level BUS driver during host deep sleep"
		default n

	config ESP_HOSTED_CP_FEAT_HOST_PS_PRINT_FULL_WAKEUP_PACKET
		bool "Print the full wakeup packet"
		default n

	config ESP_HOSTED_CP_FEAT_HOST_PS_AUTO_INIT
	    bool "Auto-initialize Host Power Save at boot"
	    default y
	    depends on ESP_HOSTED_CP_AUTO_FEAT_INIT
	    help
	        When enabled, Host Power Save feature auto-initializes during eh_cp_init().
	        Disable to manually call eh_cp_feat_host_ps_cp__init().

endif # ESP_HOSTED_CP_FEAT_HOST_PS
```

## modules/coprocessor/features/eh_cp_feat_light_sleep/Kconfig.ext
```kconfig
config ESP_HOSTED_CP_FEAT_LIGHT_SLEEP
    bool "Light Sleep"
    depends on ESP_HOSTED_CP && PM_ENABLE
    default n
    help
        Enables automatic light sleep with PM lock management.

config ESP_HOSTED_CP_FEAT_LIGHT_SLEEP_READY
    bool
    default y if ESP_HOSTED_CP_FEAT_LIGHT_SLEEP

config ESP_HOSTED_CP_FEAT_LIGHT_SLEEP_AUTO_INIT
    bool "Auto-initialize Light Sleep at boot"
    default y
    depends on ESP_HOSTED_CP_AUTO_FEAT_INIT
    help
        When enabled, Light Sleep feature auto-initializes during eh_cp_init().
        Disable to manually call eh_cp_feat_light_sleep_init().
```

## modules/coprocessor/features/eh_cp_feat_mem_monitor/Kconfig.ext
```kconfig
config ESP_HOSTED_CP_FEAT_MEM_MONITOR
    bool "Memory Monitor"
    depends on ESP_HOSTED_CP
    default n
    help
        Enables periodic heap memory monitoring with threshold alerts.

config ESP_HOSTED_CP_FEAT_MEM_MONITOR_READY
    bool
    default y if ESP_HOSTED_CP_FEAT_MEM_MONITOR

config ESP_HOSTED_CP_FEAT_MEM_MONITOR_AUTO_INIT
    bool "Auto-initialize Memory Monitor at boot"
    default y
    depends on ESP_HOSTED_CP_AUTO_FEAT_INIT
    help
        When enabled, Memory Monitor feature auto-initializes during eh_cp_init().
        Disable to manually call eh_cp_feat_mem_monitor_init().
```

## modules/coprocessor/features/eh_cp_feat_nw_split/Kconfig.ext
```kconfig
menuconfig ESP_HOSTED_CP_FEAT_NW_SPLIT
	bool "Network Split"
	depends on ESP_HOSTED_CP
	default n


if ESP_HOSTED_CP_FEAT_NW_SPLIT

	comment "⚠️  Enable [✓] ESP_HOSTED_CP_FEAT_WIFI  (Extensions → WiFi feature extension)"
		depends on !ESP_HOSTED_CP_FEAT_WIFI_READY
	comment "⚠️  Enable [✓] ESP_HOSTED_CP_WIFI_ENABLED  (Component config → ESP-Hosted CP)"
		depends on !ESP_HOSTED_CP_WIFI_ENABLED
	comment "⚠️  Enable [✓] LWIP_ENABLE  (Component config → LWIP => Enable LwIP stack)"
		depends on !LWIP_ENABLE
	comment "⚠️  Enable [✓] ESP_NETIF_TCPIP_LWIP  (Component config → LWIP => TCP/IP stack)"
		depends on !ESP_NETIF_TCPIP_LWIP

	config ESP_HOSTED_CP_FEAT_NW_SPLIT_READY
    	bool
    	default y if ESP_HOSTED_CP_FEAT_NW_SPLIT && ESP_HOSTED_CP && ESP_HOSTED_CP_FEAT_WIFI_READY && ESP_HOSTED_CP_WIFI_ENABLED && LWIP_ENABLE && ESP_NETIF_TCPIP_LWIP

	config ESP_HOSTED_CP_FEAT_NW_SPLIT_WIFI_AUTO_CONNECT_ON_STA_START
		bool "Auto-connect WiFi on STA_START (network split)"
		default y
		help
			Automatically trigger esp_wifi_connect() when STA starts.
			Disable to keep application control over connection timing.

	choice ESP_HOSTED_DEFAULT_NETWORK_STACK
		prompt "Default network stack for unfiltered packets"
		default ESP_HOSTED_DEFAULT_NETWORK_STACK_COPROCESSOR
		help
			Select the default network stack for packets that don't match any filter rules.

		config ESP_HOSTED_DEFAULT_NETWORK_STACK_COPROCESSOR
			bool "Coprocessor network stack"
			help
				Route unfiltered packets to the co-processor network stack.

		config ESP_HOSTED_DEFAULT_NETWORK_STACK_HOST
			bool "Host network stack"
			help
				Route unfiltered packets to the host network stack.

		config ESP_HOSTED_DEFAULT_NETWORK_STACK_BOTH
			bool "Replicate the packet towards both network stacks (Non recommended)"
			help
				Route unfiltered packets to both coprocessor and host network stacks.
	endchoice

	choice ESP_HOSTED_DEFAULT_NETWORK_STACK_DHCP
		prompt "Default DHCP client location"
		default ESP_HOSTED_DEFAULT_NETWORK_STACK_DHCP_BOTH
		help
			Select where the DHCP client should run.

		config ESP_HOSTED_DEFAULT_NETWORK_STACK_DHCP_COPROCESSOR
			bool "Use DHCP at co-processor"
			help
				Run the DHCP client on the co-processor. Host would simply query the co-processor for IP to be used at its network stack.

		config ESP_HOSTED_DEFAULT_NETWORK_STACK_DHCP_HOST
			bool "Use DHCP at Host"
			help
				Run the DHCP client on the host.

		config ESP_HOSTED_DEFAULT_NETWORK_STACK_DHCP_BOTH
			bool "Use DHCP at Both sides"
			help
				Replicate the DHCP response to both co-processor and host.

	endchoice

	menu "Slave side (local) LWIP port range (static)"
		config LWIP_TCP_LOCAL_PORT_RANGE_START
			int "Slave TCP start port"
			default 61440
			help
				Slave side TCP start port. Host defaults to 49152
				Slave range: 61440-65535
				Host range: 49152-61439

		config LWIP_TCP_LOCAL_PORT_RANGE_END
			int "Slave TCP end port"
			default 65535
			help
				Slave side TCP end port. Host defaults to 61439
				Slave range: 61440-65535
				Host range: 49152-61439

		config LWIP_UDP_LOCAL_PORT_RANGE_START
			int "Slave UDP start port"
			default 61440
			help
				Slave side UDP start port. Host defaults to 49152
				Slave range: 61440-65535
				Host range: 49152-61439

		config LWIP_UDP_LOCAL_PORT_RANGE_END
			int "Slave UDP end port"
			default 65535
			help
				Slave side UDP end port. Host defaults to 61439
				Slave range: 61440-65535
				Host range: 49152-61439
	endmenu

	menu "Host side (remote) LWIP port range (static)"
		config LWIP_TCP_REMOTE_PORT_RANGE_START
			int "Host TCP start port"
			default 49152
			help
				Host side TCP start port. Slave defaults to 61440
				Slave range: 61440-65535
				Host range: 49152-61439

		config LWIP_TCP_REMOTE_PORT_RANGE_END
			int "Host TCP end port"
			default 61439
			help
				Host side TCP end port. Slave defaults to 65535
				Slave range: 61440-65535
				Host range: 49152-61439

		config LWIP_UDP_REMOTE_PORT_RANGE_START
			int "Host UDP start port"
			default 49152
			help
				Host side TCP start port. Slave defaults to 61440
				Slave range: 61440-65535
				Host range: 49152-61439

		config LWIP_UDP_REMOTE_PORT_RANGE_END
			int "Host UDP end port"
			default 61439
			help
				Host side UDP end port. Slave defaults to 65535
				Slave range: 61440-65535
				Host range: 49152-61439
	endmenu

	config ESP_HOSTED_HOST_ONLY_PORTS_CONFIGURED
		bool "Configure extra ports dedicated for host network stack"
		default y
		help
			Extra ports to configure to route the packet to host. Each port is compared individually with packet

	menu "Host only ports"
		depends on ESP_HOSTED_HOST_ONLY_PORTS_CONFIGURED

		config ESP_HOSTED_HOST_TCP_SRC_PORTS
			string "Host reserved TCP source ports"
			default ""
			help
				Comma-separated list of TCP source ports to be forwarded to the host.

		config ESP_HOSTED_HOST_TCP_DST_PORTS
			string "Host reserved TCP destination ports"
			default "22,8554"
			help
				Comma-separated list of TCP destination ports to be forwarded to the host.

		config ESP_HOSTED_HOST_UDP_SRC_PORTS
			string "Host reserved UDP source ports"
			default ""
			help
				Comma-separated list of UDP source ports to be forwarded to the host.

		config ESP_HOSTED_HOST_UDP_DST_PORTS
			string "Host reserved UDP destination ports"
			default ""
			help
				Comma-separated list of UDP destination ports to be forwarded to the host.
	endmenu
	config ESP_HOSTED_CP_FEAT_NW_SPLIT_AUTO_INIT
	    bool "Auto-initialize Network Split at boot"
	    default y
	    depends on ESP_HOSTED_CP_AUTO_FEAT_INIT
	    help
	        When enabled, Network Split feature auto-initializes during eh_cp_init().
	        Disable to manually call eh_cp_feat_nw_split_init().

endif # ESP_HOSTED_CP_FEAT_NW_SPLIT
```

## modules/coprocessor/features/eh_cp_feat_peer_data/Kconfig.ext
```kconfig
menuconfig ESP_HOSTED_CP_FEAT_PEER_DATA_TRANSFER
	bool "Peer Data Transfer"
	depends on ESP_HOSTED_CP
	default n

if ESP_HOSTED_CP_FEAT_PEER_DATA_TRANSFER

	config ESP_HOSTED_CP_FEAT_PEER_DATA_TRANSFER_READY
		bool
		default y if ESP_HOSTED_CP

	config ESP_HOSTED_CP_FEAT_PEER_DATA_AUTO_INIT
	    bool "Auto-initialize Peer Data Transfer at boot"
	    default y
	    depends on ESP_HOSTED_CP_AUTO_FEAT_INIT
	    help
	        When enabled, Peer Data Transfer feature auto-initializes during eh_cp_init().
	        Disable to manually call eh_cp_feat_peer_data_init().

endif # ESP_HOSTED_CP_FEAT_PEER_DATA_TRANSFER
```

## modules/coprocessor/features/eh_cp_feat_rpc/Kconfig.ext
```kconfig
config ESP_HOSTED_CP_EXT_RPC
	bool
	depends on ESP_HOSTED_CP
	default y if (ESP_HOSTED_CP_FOR_LINUX__802_03 || ESP_HOSTED_CP_FOR_MCU) && !ESP_HOSTED_CP_RPC_DISABLED
	default n

config ESP_HOSTED_CP_FEAT_RPC_READY
    bool
    default y if ESP_HOSTED_CP_EXT_RPC

choice ESP_HOSTED_CP_RPC_MODE
	prompt "RPC Support"
	default ESP_HOSTED_CP_RPC_V2 if ESP_HOSTED_CP_FOR_LINUX__802_03 || ESP_HOSTED_CP_FOR_MCU
	default ESP_HOSTED_CP_RPC_DISABLED
	help
		Select which RPC mode this coprocessor uses.

	config ESP_HOSTED_CP_RPC_V2
		bool "RPC - RPC V2"
		help
			Unified V2 RPC for new hosts.

	config ESP_HOSTED_CP_RPC_V1_LINUX
		bool "RPC - RPC V1 -Compat Linux"
		depends on ESP_HOSTED_CP_FOR_LINUX__802_03
		help
			Imitates old Linux FG slave for testing with a new host.

	config ESP_HOSTED_CP_RPC_V1_MCU
		bool "RPC - RPC V1 -Compat MCU"
		depends on ESP_HOSTED_CP_FOR_MCU
		help
			Imitates old MCU slave for testing with a new host.

	config ESP_HOSTED_CP_RPC_DISABLED
		bool "RPC - Disable"
endchoice

config ESP_HOSTED_CP_FEAT_RPC_AUTO_INIT
    bool "Auto-initialize RPC at boot"
    default y
    depends on ESP_HOSTED_CP_AUTO_FEAT_INIT
    help
        When enabled, RPC feature auto-initializes during eh_cp_init().

menu "RPC: Legacy Compatibility (disable to drop old host support)"
	depends on ESP_HOSTED_CP_RPC_V1_LINUX
	help
		Options in this section preserve backward compatibility with older
		Linux FG host firmware. Each item can be disabled independently
		once all connected hosts have been updated.

	config ESP_HOSTED_LEGACY_ADD_ENDPOINT_API
		bool "Legacy eh_cp_protocomm_add_endpoint() API"
		default n
		help
			Preserves the old per-extension direct protocomm endpoint
			registration API (eh_cp_protocomm_add_endpoint).
			Extensions should use eh_cp_rpc_req_register() instead.

			Disable when all extensions have migrated to the SLIST registry.

	config ESP_HOSTED_LEGACY_SEND_EVENT_TO_HOST_API
		bool "Legacy eh_send_event_to_host() API"
		default n
		help
			Preserves the old event-send API that takes an explicit endpoint
			name string. New code uses eh_cp_rpc_send_event() which
			routes through the SLIST registry and serialise callback.

			Disable when all callers have migrated to eh_cp_rpc_send_event().

	config ESP_HOSTED_LEGACY_WIRE_INTERFACE_TYPES
		bool "Legacy wire interface IDs (STA=0, AP=1, SERIAL=2, ...)"
		default y if ESP_HOSTED_CP_RPC_V1_LINUX
		default n
		help
			Use legacy on-wire interface numbering expected by older Linux FG
			hosts:
			  STA=0 AP=1 SERIAL=2 HCI=3 PRIV=4 TEST=5 MAX=6

			When disabled, the new numbering is used:
			  INVALID=0 STA=1 AP=2 SERIAL=3 HCI=4 PRIV=5 TEST=6 ETH=7

			This only changes wire encode/decode mapping; internal CP code
			continues to use eh_if_type_t.

	# ESP_HOSTED_LEGACY_BOOT_CAP_TLVS replaced by ESP_HOSTED_TLV_V1_LINUX
	# (auto-selected in modules/common/eh_tlv/Kconfig.ext)
endmenu
```

## modules/coprocessor/features/eh_cp_feat_rpc_ext_linux/Kconfig.ext
```kconfig
config ESP_HOSTED_CP_FEAT_RPC_LINUX
	bool
	depends on ESP_HOSTED_CP_EXT_RPC
	depends on ESP_HOSTED_CP_RPC_V1_LINUX
	default y

config ESP_HOSTED_CP_FEAT_RPC_LINUX_READY
    bool
    default y if ESP_HOSTED_CP_EXT_RPC && ESP_HOSTED_CP_RPC_V1_LINUX

config ESP_HOSTED_CP_FEAT_RPC_LINUX_AUTO_INIT
    bool "Auto-initialize RPC Linux at boot"
    default y
    depends on ESP_HOSTED_CP_AUTO_FEAT_INIT
    help
        When enabled, RPC Linux feature auto-initializes during eh_cp_init().
        Disable to manually call eh_cp_feat_rpc_ext_linux_init().
```
