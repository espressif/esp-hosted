## modules/coprocessor/features/eh_cp_feat_rpc_ext_mcu/Kconfig.ext
```kconfig
config ESP_HOSTED_CP_FEAT_RPC_MCU
	bool
	depends on ESP_HOSTED_CP_EXT_RPC
	depends on ESP_HOSTED_CP_RPC_V1_MCU
	default y

config ESP_HOSTED_CP_FEAT_RPC_MCU_READY
    bool
    default y if ESP_HOSTED_CP_EXT_RPC && ESP_HOSTED_CP_RPC_V1_MCU

config ESP_HOSTED_CP_FEAT_RPC_MCU_AUTO_INIT
    bool "Auto-initialize RPC MCU at boot"
    default y
    depends on ESP_HOSTED_CP_AUTO_FEAT_INIT
    help
        When enabled, RPC MCU feature auto-initializes during eh_cp_init().
        Disable to manually call eh_cp_feat_rpc_ext_mcu_init().

#menu "ESP-Hosted MCU Configuration"
#    depends on ESP_HOSTED_CP_FOR_MCU
#
#    config ESP_HOSTED_CP_MCU_RPC_TASK_STACK_SIZE
#        int "MCU RPC Task Stack Size"
#        default 4096
#        range 2048 8192
#        help
#            Stack size for the MCU RPC processing task.
#
#    config ESP_HOSTED_CP_MCU_RPC_TASK_PRIORITY
#        int "MCU RPC Task Priority"
#        default 22
#        range 1 25
#        help
#            Priority for the MCU RPC processing task.
#
#    config ESP_HOSTED_CP_MCU_HEARTBEAT_ENABLE
#        bool "Enable Heartbeat"
#        default y
#        help
#            Enable periodic heartbeat messages to MCU host.
#
#    config ESP_HOSTED_CP_MCU_HEARTBEAT_INTERVAL
#        int "Heartbeat Interval (seconds)"
#        depends on ESP_HOSTED_CP_MCU_HEARTBEAT_ENABLE
#        default 30
#        range 10 3600
#        help
#            Interval between heartbeat messages in seconds.
#
##    config ESP_HOSTED_CP_MCU_OTA_ENABLE
##        bool "Enable OTA Updates"
##        default y
##        help
##            Enable Over-The-Air firmware update support for MCU hosts.
#
##    config ESP_HOSTED_CP_MCU_POWER_SAVE_ENABLE
##        bool "Enable Host Power Save"
##        default n
##        help
##            Enable power save coordination with MCU host.
#
#    menu "MCU Network Split Configuration"
#        depends on ESP_HOSTED_CP_FEAT_NW_SPLIT
#
#        config ESP_HOSTED_CP_MCU_DHCP_SERVER_ENABLE
#            bool "Enable DHCP Server"
#            default y
#            help
#                Enable DHCP server functionality in Network Split mode.
#
#        config ESP_HOSTED_CP_MCU_DNS_SERVER_ENABLE
#            bool "Enable DNS Server"
#            default y
#            help
#                Enable DNS server functionality in Network Split mode.
#
#    endmenu
#
#    menu "MCU Debug Configuration"
#
#        config ESP_HOSTED_CP_MCU_DEBUG_STATS
#            bool "Enable MCU Statistics"
#            default y
#            help
#                Enable collection and reporting of MCU-specific statistics.
#
#        config ESP_HOSTED_CP_MCU_DEBUG_VERBOSE
#            bool "Enable Verbose Debug Logging"
#            default n
#            help
#                Enable verbose debug logging for MCU RPC operations.
#
#    endmenu
#
#endmenu
```

## modules/coprocessor/features/eh_cp_feat_system/Kconfig.ext
```kconfig
config ESP_HOSTED_CP_FEAT_SYSTEM
    bool "System (OTA, heartbeat, FW version)"
    depends on ESP_HOSTED_CP
    default y
    help
        Enables system features: OTA update, heartbeat, FW version query, MAC address.

config ESP_HOSTED_CP_FEAT_SYSTEM_READY
    bool
    default y if ESP_HOSTED_CP_FEAT_SYSTEM

config ESP_HOSTED_CP_FEAT_SYSTEM_AUTO_INIT
    bool "Auto-initialize System at boot"
    default y
    depends on ESP_HOSTED_CP_AUTO_FEAT_INIT
    help
        When enabled, System feature auto-initializes during eh_cp_init().
        Disable to manually call eh_cp_feat_system_init().
```

## modules/coprocessor/features/eh_cp_feat_wifi/Kconfig.ext
```kconfig
menuconfig ESP_HOSTED_CP_FEAT_WIFI
    bool "WiFi"
    depends on ESP_HOSTED_CP
    default n
    help
        Enables WiFi feature capability reporting on the coprocessor.

if ESP_HOSTED_CP_FEAT_WIFI

    comment "⚠️  Enable [✓] ESP_HOSTED_CP_WIFI_ENABLED (Component config → ESP-Hosted CP)"
        depends on !ESP_HOSTED_CP_WIFI_ENABLED

    config ESP_HOSTED_CP_FEAT_WIFI_READY
        bool
        default y if ESP_HOSTED_CP_WIFI_ENABLED

    config ESP_HOSTED_CP_FEAT_WIFI_AUTO_INIT
        bool "Auto-initialize WiFi at boot"
        default y
        depends on ESP_HOSTED_CP_AUTO_FEAT_INIT
        help
            When enabled, WiFi feature auto-initializes during eh_cp_init().
            Disable to manually call eh_cp_feat_wifi_init().

    orsource "../eh_cp_feat_wifi_ext_ent/Kconfig.ext"
    orsource "../eh_cp_feat_wifi_ext_itwt/Kconfig.ext"
    orsource "../eh_cp_feat_wifi_ext_dpp/Kconfig.ext"

endif # ESP_HOSTED_CP_FEAT_WIFI
```

## modules/host/Kconfig.ext
```kconfig
menuconfig ESP_HOSTED_HOST_SUBTREE
	bool "Enable host components"
	default y
	depends on ESP_HOSTED_HOST

if ESP_HOSTED_HOST_SUBTREE
	# Host subtree Kconfig routing placeholder
endif
```
