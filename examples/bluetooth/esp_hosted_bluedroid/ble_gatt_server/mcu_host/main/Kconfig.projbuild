## examples/bluetooth/esp_hosted_bluedroid/ble_gatt_server/mcu_host/main/Kconfig.projbuild
```kconfig
menu "BLE GATT Server config"

config EXAMPLE_DEVICE_NAME
    string "BLE device name"
    default "ESP_HOSTED_GATTS"

config EXAMPLE_NOTIFY_INTERVAL_MS
    int "Notification interval (ms)"
    default 1000
    range 100 60000
    help
      The notify-characteristic task increments a counter and pushes
      it to subscribed clients at this cadence.

endmenu
```

## examples/bluetooth/esp_hosted_nimble/bleprph_wifi_coex/mcu_host/main/Kconfig.projbuild
```kconfig
menu "Example Configuration"

    config EXAMPLE_PING_IP
        string "Ping target"
        default "1.1.1.1"
        help
            Hostname or IP the coexistence demo pings to keep WiFi
            traffic alive while BLE advertises.

    config EXAMPLE_PING_COUNT
        int "Ping count"
        default 100
        help
            Number of pings sent (one per second).  Raise for soak
            testing the coexistence path.

endmenu
```

## examples/bluetooth/host_mcu/bluedroid/examples/hosted_hci/ble_advertise_minimal/main/Kconfig.projbuild
```kconfig
menu "BLE Advertise Minimal config"

config EXAMPLE_DEVICE_NAME
    string "BLE device name (advertised)"
    default "ESP_HOSTED_BLE"

config EXAMPLE_ADV_INTERVAL_MS
    int "Advertising interval (ms)"
    default 100
    range 20 10240
    help
      Advertising interval as seen by Bluedroid's `adv_int_min/max`.
      Converted to 0.625 ms units internally.

config EXAMPLE_USE_SETUP_HELPER
    bool "Use one-shot esp_hosted_hci_bluedroid_setup() helper"
    default y
    help
      If y, app_main() calls the helper that does
      connect+controller_init+enable+bridge_attach in one line.
      If n, app_main() calls each step individually (useful for
      learning the sequence or for finer error handling).

endmenu
```

## examples/bluetooth/host_mcu/bluedroid/examples/hosted_hci/classic_bt_discovery/main/Kconfig.projbuild
```kconfig
menu "Classic BT Discovery config"

config EXAMPLE_INQUIRY_DURATION
    int "Inquiry duration (×1.28 s units)"
    default 10
    range 1 48
    help
      How long to listen for nearby Classic BT devices. 10 = ~12.8 s.

config EXAMPLE_PRINT_UNNAMED
    bool "Log devices that don't advertise a friendly name"
    default y

endmenu
```

## examples/bluetooth/host_mcu/nimble/examples/hosted_hci/bleprph_minimal/main/Kconfig.projbuild
```kconfig
menu "BLE Peripheral Minimal config"

config EXAMPLE_DEVICE_NAME
    string "BLE device name (advertised)"
    default "esp-hosted-nim"

endmenu
```

## examples/bluetooth/nimble_hosted_hci/bleprph_gatt/mcu_host/main/Kconfig.projbuild
```kconfig
menu "BLE Peripheral GATT config"

config EXAMPLE_DEVICE_NAME
    string "BLE device name"
    default "esp-hosted-nim-gatt"

config EXAMPLE_NOTIFY_INTERVAL_MS
    int "Notification interval (ms)"
    default 1000
    range 100 60000

endmenu
```

## examples/bluetooth/nimble_hosted_hci/bleprph_wifi_coex/cp/main/Kconfig.projbuild
```kconfig
menu "Bluetooth CP wifi_hosted_hci"

config EXAMPLE_WIFI_HOSTED_HCI_CP
    bool "Enable Wi-Fi + BT(VHCI) CP profile"
    default y
    help
      This example enables Wi-Fi and Bluetooth controller-only mode on CP,
      with BT HCI carried over ESP-Hosted VHCI path.

endmenu
```

## examples/bluetooth/nimble_uart/bleprph_host_only_uart/cp/sdkconfig.defaults.esp32h21
```kconfig
# 1. CPU
#--------
CONFIG_ESP_DEFAULT_CPU_FREQ_MHZ_96=y

# 2. BT Configuration
#---------------------
CONFIG_BT_ENABLED=y
CONFIG_BT_CONTROLLER_ONLY=y
CONFIG_BT_BLUEDROID_ENABLED=
CONFIG_BT_LE_SLEEP_ENABLE=y

# BLE over UART
#-------------------
# Enable below config, delete sdkconfig, build/ and rebuild
CONFIG_BT_LE_HCI_INTERFACE_USE_UART=y
CONFIG_BT_LE_HCI_UART_TX_PIN=19
CONFIG_BT_LE_HCI_UART_RX_PIN=10
CONFIG_BT_LE_HCI_UART_FLOWCTRL=n
# # 4 pin solution is not working yet for c6
# #CONFIG_BT_LE_HCI_UART_RTS_PIN=4
# #CONFIG_BT_LE_HCI_UART_CTS_PIN=5


# Partition Table
#--------------------
CONFIG_PARTITION_TABLE_CUSTOM=y
CONFIG_PARTITION_TABLE_CUSTOM_FILENAME="partitions_eh_cp_ota_4m.csv"

# Mempool
#------------
CONFIG_ESP_CACHE_MALLOC=y


# Optimizations
#-------------------
CONFIG_COMPILER_OPTIMIZATION_PERF=y
```

## examples/common_components/eh_example_common/Kconfig.projbuild
```kconfig
menu "Example Connection Configuration"

    config EH_EXAMPLE_WIFI_SSID
        string "WiFi SSID"
        default "myssid"

    config EH_EXAMPLE_WIFI_PASSWORD
        string "WiFi Password"
        default "mypassword"

    config EH_EXAMPLE_WIFI_MAXIMUM_RETRY
        int "Maximum retry"
        default 6

    choice EH_EXAMPLE_WIFI_BAND
        prompt "WiFi band (dual-band CP, e.g. ESP32-C5)"
        default EH_EXAMPLE_WIFI_BAND_2G
        help
            Only applies to a dual-band CP (SLAVE_SOC_WIFI_SUPPORT_5G). 2G is the
            most reliable for a 2.4 GHz AP; AUTO scans both bands but is slow and
            can stall on the C5; 5G for a 5 GHz AP. A single-band CP (e.g. C6)
            ignores this.
        config EH_EXAMPLE_WIFI_BAND_2G
            bool "2.4 GHz only"
        config EH_EXAMPLE_WIFI_BAND_5G
            bool "5 GHz only"
        config EH_EXAMPLE_WIFI_BAND_AUTO
            bool "Auto (2.4 + 5 GHz)"
    endchoice

    choice EH_EXAMPLE_WIFI_BANDWIDTH
        prompt "STA channel bandwidth"
        default EH_EXAMPLE_WIFI_BW_AUTO
        help
            Fixes the STA channel width, mainly for throughput characterization
            (20 vs 40 MHz). AUTO (default) leaves it to negotiation with the AP.
            HT20 pins 20 MHz; HT40 pins 40 MHz (the AP must offer 40 MHz, else it
            negotiates down). Applied after esp_wifi_start(), before connect; the
            RPC forwards it to the CP. A CP that doesn't support the call logs a
            warning and falls back to negotiation (non-fatal).
        config EH_EXAMPLE_WIFI_BW_AUTO
            bool "Auto (negotiate with AP)"
        config EH_EXAMPLE_WIFI_BW_HT20
            bool "20 MHz (HT20)"
        config EH_EXAMPLE_WIFI_BW_HT40
            bool "40 MHz (HT40)"
    endchoice

    choice EH_EXAMPLE_WIFI_PROTOCOL
        prompt "STA PHY protocol"
        default EH_EXAMPLE_WIFI_PROTO_DEFAULT
        help
            802.11 protocol the STA advertises. "Default" leaves the CP's max
            (typically 11ax on a Wi-Fi 6 SoC) — best for a normal connect. The
            presets matter for throughput tuning: HT40 needs 11n, and on an
            11AX SoC the single-band set_bandwidth caps at HT20, so pin "up to
            11n" + HT40 to force a 40 MHz test. Applied after esp_wifi_start(),
            before bandwidth; RPC-forwarded; non-fatal.
        config EH_EXAMPLE_WIFI_PROTO_DEFAULT
            bool "Default (CP max / negotiated)"
        config EH_EXAMPLE_WIFI_PROTO_LEGACY
            bool "Legacy 11b/g only"
        config EH_EXAMPLE_WIFI_PROTO_11N
            bool "up to 11n (enables HT40)"
        config EH_EXAMPLE_WIFI_PROTO_11AX
            bool "up to 11ax (Wi-Fi 6)"
    endchoice

    config EH_EXAMPLE_WIFI_COUNTRY
        string "WiFi country code"
        default "01"
        help
            Regulatory country code governing which channels are permitted —
            notably which 5 GHz channels are legal. "01" is the worldwide-safe
            set. Empty string leaves the CP default. Applied after
            esp_wifi_start(), before connect (RPC-forwarded); non-fatal if the CP
            rejects the code.

            Supported codes:
              01 (world), AT AU BE BG BR CA CH CN CY CZ DE DK EE ES FI FR GB GR
              HK HR HU IE IN IS IT JP KR LI LT LU LV MT MX NL NO NZ PL PT RO SE
              SI SK TW US

endmenu
```

## examples/common_components/eh_host_bluedroid/Kconfig.ext
```kconfig
menu "ESP-Hosted Bluedroid port"

config ESP_HOSTED_HOST_BT_PORT_BLUEDROID
	bool "Bluedroid hosted-HCI port"
	depends on ESP_HOSTED_HOST_FEAT_BT && BT_BLUEDROID_ENABLED
	default n
	help
	  Build the Bluedroid <-> ESP-Hosted HCI port so a Bluedroid host
	  stack runs over the hosted transport. Requires the BT feature and
	  IDF's Bluedroid host (BT_BLUEDROID_ENABLED).

if ESP_HOSTED_HOST_BT_PORT_BLUEDROID

	config ESP_HOSTED_HOST_BT_PORT_BLUEDROID_AUTO_INIT
		bool "Auto-initialise the Bluedroid port at boot"
		depends on ESP_HOSTED_HOST_AUTO_FEAT_INIT
		default y
		help
		  Run eh_host_bluedroid_init() during host auto-init (priority
		  after feat_bt). Disable to call eh_host_bluedroid_init()/_deinit()
		  from the app yourself.

	config ESP_HOSTED_HCI_BLUEDROID_RX_SCRATCH_SIZE
		int "RX scratch buffer size (bytes)"
		default 1100
		range 260 4096
		help
		  RX scratch buffer for H4 restitching. Default 1100 fits both
		  HCI events (max 257) and ACL (max 1027) with headroom.

	config ESP_HOSTED_HCI_BLUEDROID_DEBUG
		bool "Enable port debug logs"
		default n
		help
		  Verbose logging in the port TU; leave off for production.

endif # ESP_HOSTED_HOST_BT_PORT_BLUEDROID

endmenu
```

## examples/common_components/eh_host_nimble/Kconfig.ext
```kconfig
menu "ESP-Hosted NimBLE port"

config ESP_HOSTED_HOST_BT_PORT_NIMBLE
	bool "NimBLE hosted-HCI port"
	depends on ESP_HOSTED_HOST_FEAT_BT && BT_NIMBLE_ENABLED
	default n
	help
	  Build the NimBLE <-> ESP-Hosted HCI port so a NimBLE host stack
	  runs over the hosted transport. Requires the BT feature and IDF's
	  NimBLE host (BT_NIMBLE_ENABLED).

if ESP_HOSTED_HOST_BT_PORT_NIMBLE

	config ESP_HOSTED_HOST_BT_PORT_NIMBLE_AUTO_INIT
		bool "Auto-initialise the NimBLE port at boot"
		depends on ESP_HOSTED_HOST_AUTO_FEAT_INIT
		default y
		help
		  Run eh_host_nimble_init() during host auto-init (priority after
		  feat_bt). Disable to call eh_host_nimble_init()/_deinit() from
		  the app yourself.

	config ESP_HOSTED_HCI_NIMBLE_DEBUG
		bool "Enable port debug logs"
		default n
		help
		  Verbose logging in the port TU; leave off for production.

endif # ESP_HOSTED_HOST_BT_PORT_NIMBLE

endmenu
```

## examples/common_components/esp_hosted_hci_bluedroid/Kconfig
```kconfig
menu "ESP-Hosted Bluedroid bridge"

config ESP_HOSTED_HCI_BLUEDROID_RX_SCRATCH_SIZE
    int "RX scratch buffer size (bytes)"
    default 1100
    range 260 4096
    help
      RX scratch buffer for H4 restitching. Default 1100 fits both
      HCI events (max 257) and ACL (max 1027) with headroom. Shrink
      for event-only memory-constrained builds; grow if your profile
      uses extended ACL.

config ESP_HOSTED_HCI_BLUEDROID_DEBUG
    bool "Enable bridge debug logs"
    default n
    help
      Verbose logging in the bridge. Useful during bring-up.

endmenu
```

## examples/gpio_expander/linux_802_3_host/c_app/main/Kconfig.projbuild
```kconfig
menu "Example Configuration"

    config EH_USE_LEGACY_API
        bool "Use legacy esp_hosted_* compat-surface main"
        default n
        help
            Build the example from main/legacy/main.c (preserves the
            esp_hosted_* compat surface) instead of main/main.c (which
            uses native eh_host_* APIs).

endmenu
```
