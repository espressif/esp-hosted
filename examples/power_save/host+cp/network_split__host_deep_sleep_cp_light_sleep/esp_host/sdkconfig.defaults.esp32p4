## examples/power_save/host+cp/network_split__host_deep_sleep_cp_light_sleep/esp_host/sdkconfig.defaults.esp32p4
```kconfig
#
# ESP32-P4 specific
#

CONFIG_WIFI_RMT_STATIC_RX_BUFFER_NUM=20
CONFIG_WIFI_RMT_DYNAMIC_RX_BUFFER_NUM=32
CONFIG_WIFI_RMT_DYNAMIC_TX_BUFFER_NUM=32
CONFIG_WIFI_RMT_AMPDU_TX_ENABLED=y
CONFIG_WIFI_RMT_TX_BA_WIN=16
CONFIG_WIFI_RMT_AMPDU_RX_ENABLED=y
CONFIG_WIFI_RMT_RX_BA_WIN=16

CONFIG_LWIP_TCP_SND_BUF_DEFAULT=51200
CONFIG_LWIP_TCP_WND_DEFAULT=65535
CONFIG_LWIP_TCP_RECVMBOX_SIZE=32
CONFIG_LWIP_UDP_RECVMBOX_SIZE=32
CONFIG_LWIP_TCPIP_RECVMBOX_SIZE=32

CONFIG_LWIP_IP_REASS_MAX_PBUFS=15

CONFIG_ESP_WIFI_ENABLE_WIFI_RX_STATS=n
CONFIG_ESP_WIFI_ENABLE_WIFI_TX_STATS=n
CONFIG_LWIP_EXTRA_IRAM_OPTIMIZATION=y
CONFIG_LWIP_TCP_SACK_OUT=y

CONFIG_LWIP_TCPIP_CORE_LOCKING=y
CONFIG_LWIP_TCPIP_CORE_LOCKING_INPUT=y

CONFIG_ESP_HOSTED_P4_DEV_BOARD_FUNC_BOARD=y
```

## examples/power_save/host/network_split__host_deep_sleep/esp_host/sdkconfig.defaults.esp32p4
```kconfig
#
# ESP32-P4 specific
#

CONFIG_WIFI_RMT_STATIC_RX_BUFFER_NUM=10
CONFIG_WIFI_RMT_DYNAMIC_RX_BUFFER_NUM=32
CONFIG_WIFI_RMT_DYNAMIC_TX_BUFFER_NUM=32
CONFIG_WIFI_RMT_AMPDU_TX_ENABLED=y
CONFIG_WIFI_RMT_TX_BA_WIN=32
CONFIG_WIFI_RMT_AMPDU_RX_ENABLED=y
CONFIG_WIFI_RMT_RX_BA_WIN=16

# TCP/IP Performance
CONFIG_LWIP_TCP_SND_BUF_DEFAULT=11520
CONFIG_LWIP_TCP_WND_DEFAULT=32768
CONFIG_LWIP_TCP_RECVMBOX_SIZE=48
CONFIG_LWIP_UDP_RECVMBOX_SIZE=48
CONFIG_LWIP_TCPIP_RECVMBOX_SIZE=48

CONFIG_LWIP_TCP_SACK_OUT=y
CONFIG_ESP_HOSTED_P4_DEV_BOARD_FUNC_BOARD=y
```

## examples/system/get_cp_fw_version/mcu_host/sdkconfig.defaults
```kconfig
# SPDX-License-Identifier: Apache-2.0

# Role: HOST (MCU / ESP-IDF)
CONFIG_ESP_HOSTED=y

CONFIG_ESP_HOSTED_HOST_FEAT_RPC=y
CONFIG_ESP_HOSTED_HOST_FEAT_RPC_EXT_V2=y
CONFIG_ESP_HOSTED_HOST_FEAT_SYSTEM=y


CONFIG_FREERTOS_HZ=1000
```

## examples/system/hosted_events/linux_802_3_host/c_app/sdkconfig.defaults
```kconfig
\
# SPDX-License-Identifier: Apache-2.0
# Per-example Linux host defaults (no global defaults layer).

CONFIG_ESP_HOSTED=y
CONFIG_ESP_HOSTED_HOST=y
CONFIG_ESP_HOSTED_HOST_TYPE_POSIX=y
CONFIG_ESP_HOSTED_HOST_PORT_TYPE_POSIX=y
CONFIG_ESP_HOSTED_HOST_VSERIAL_LINUX=y
CONFIG_SLAVE_IDF_TARGET_ESP32C6=y
CONFIG_ESP_HOSTED_HOST_FEAT_RPC=y
CONFIG_ESP_HOSTED_HOST_FEAT_RPC_EXT_V2=y
CONFIG_ESP_HOSTED_HOST_AUTO_FEAT_INIT=y
CONFIG_ESP_HOSTED_HOST_FEAT_SYSTEM_AUTO_INIT=y

CONFIG_ESP_HOSTED_HOST_FEAT_WIFI=y
CONFIG_ESP_HOSTED_HOST_FEAT_WIFI_AUTO_INIT=y
CONFIG_ESP_HOSTED_HOST_FEAT_HEARTBEAT=y
CONFIG_ESP_HOSTED_HOST_FEAT_HEARTBEAT_AUTO_INIT=y
```

## examples/system/hosted_events/mcu_host/main/Kconfig.projbuild
```kconfig
menu "Example Configuration"

	config EH_USE_LEGACY_API
		bool "Use legacy esp_hosted_* compat-surface main"
		default n
		help
			Build the example from main/legacy/main.c (preserves the
			esp_hosted_* compat surface) instead of main/main.c (which
			uses native eh_host_* APIs).

	 config EXAMPLE_HEARTBEAT_INTERVAL_SEC
		int "Heartbeat Interval in Seconds"
		default 5
		help
		Set the co-processor heartbeat interval

	config EXAMPLE_ENABLE_HEARTBEAT_MONITOR
		bool "Enable heartbeat timeout monitor"
		default y
		help
			Detect if there is a Heartbeat timeout

	config EXAMPLE_HEARTBEAT_TIMEOUT_SEC
		depends on EXAMPLE_ENABLE_HEARTBEAT_MONITOR
		int "Heartbeat Timeout in Seconds"
		default 6
		help
			Set the co-processor heartbeat timeout interval (minimum value should be the Heartbeat interval)

	choice EXAMPLE_HOSTED_RECOVERY_METHOD
		bool "Co-processor Recovery method"
		default EXAMPLE_DO_HOSTED_RECOVERY
		help
			Select the recovery method to use

		config EXAMPLE_DO_HOSTED_RECOVERY
			bool "Restart ESP-Hosted transport"
			help
				Restart the ESP-Hosted transport to attempt recovery

		config EXAMPLE_DO_HOST_RESET
			bool "Restart the Host"
			help
				Restart the Host to recover the system

		config EXAMPLE_DO_NOTHING
			bool "Do nothing"
			help
				Don't do anything when error is received
	endchoice

	config ESP_WIFI_SSID
		string "WiFi SSID"
		default "myssid"
		help
			SSID (network name) for the example to connect to.

	config ESP_WIFI_PASSWORD
		string "WiFi Password"
		default "mypassword"
		help
			WiFi password (WPA or WPA2) for the example to use.

	choice ESP_WIFI_SAE_MODE
		prompt "WPA3 SAE mode selection"
		default ESP_STATION_EXAMPLE_WPA3_SAE_PWE_BOTH
		help
			Select mode for SAE as Hunt and Peck, H2E or both.
		config ESP_STATION_EXAMPLE_WPA3_SAE_PWE_HUNT_AND_PECK
			bool "HUNT AND PECK"
		config ESP_STATION_EXAMPLE_WPA3_SAE_PWE_HASH_TO_ELEMENT
			bool "H2E"
			depends on ESP_WIFI_ENABLE_SAE_H2E
		config ESP_STATION_EXAMPLE_WPA3_SAE_PWE_BOTH
			bool "BOTH"
			depends on ESP_WIFI_ENABLE_SAE_H2E
	endchoice

	config ESP_WIFI_PW_ID
		string "PASSWORD IDENTIFIER"
		depends on  ESP_STATION_EXAMPLE_WPA3_SAE_PWE_HASH_TO_ELEMENT|| ESP_STATION_EXAMPLE_WPA3_SAE_PWE_BOTH
		default ""
		help
			password identifier for SAE H2E

	config ESP_MAXIMUM_RETRY
		int "Maximum retry"
		default 5
		help
			Set the Maximum retry to avoid station reconnecting to the AP unlimited when the AP is really inexistent.

	choice ESP_WIFI_SCAN_AUTH_MODE_THRESHOLD
		prompt "WiFi Scan auth mode threshold"
		default ESP_WIFI_AUTH_WPA2_PSK
		help
			The weakest authmode to accept in the scan mode.
			This value defaults to ESP_WIFI_AUTH_WPA2_PSK in case password is present and ESP_WIFI_AUTH_OPEN is used.
			Please select ESP_WIFI_AUTH_WEP/ESP_WIFI_AUTH_WPA_PSK in case AP is operating in WEP/WPA mode.

		config ESP_WIFI_AUTH_OPEN
			bool "OPEN"
		config ESP_WIFI_AUTH_WEP
			bool "WEP"
		config ESP_WIFI_AUTH_WPA_PSK
			bool "WPA PSK"
		config ESP_WIFI_AUTH_WPA2_PSK
			bool "WPA2 PSK"
		config ESP_WIFI_AUTH_WPA_WPA2_PSK
			bool "WPA/WPA2 PSK"
		config ESP_WIFI_AUTH_WPA3_PSK
			bool "WPA3 PSK"
		config ESP_WIFI_AUTH_WPA2_WPA3_PSK
			bool "WPA2/WPA3 PSK"
		config ESP_WIFI_AUTH_WAPI_PSK
			bool "WAPI PSK"
	endchoice

endmenu
```

## examples/wifi/apsta/linux_802_3_host/c_app/main/Kconfig.projbuild
```kconfig
menu "Example Configuration"

    config EH_USE_LEGACY_API
        bool "Use legacy esp_hosted_* compat-surface main"
        default n
        help
            Build from legacy/main.c (standard ESP-IDF AP+STA code on the
            esp_hosted_* compat surface) instead of main/main.c (native
            eh_host_* API).

    config ESP_WIFI_AP_SSID
        string "SoftAP SSID"
        default "myssid_ap"

    config ESP_WIFI_AP_PASSWORD
        string "SoftAP Password"
        default "mypassword"

    config ESP_WIFI_AP_CHANNEL
        int "SoftAP Channel"
        range 1 13
        default 1

    config ESP_WIFI_AP_MAX_STA_CONN
        int "SoftAP max station connections"
        default 4

    config ESP_WIFI_STA_SSID
        string "Upstream (STA) SSID"
        default "myssid"

    config ESP_WIFI_STA_PASSWORD
        string "Upstream (STA) Password"
        default "mypassword"

endmenu
```

## examples/wifi/apsta/linux_802_3_host/c_app/sdkconfig.defaults
```kconfig
\
# SPDX-License-Identifier: Apache-2.0
# Per-example Linux host defaults (no global defaults layer).

CONFIG_ESP_HOSTED=y
CONFIG_ESP_HOSTED_HOST=y
CONFIG_ESP_HOSTED_HOST_TYPE_POSIX=y
CONFIG_ESP_HOSTED_HOST_PORT_TYPE_POSIX=y
CONFIG_ESP_HOSTED_HOST_VSERIAL_LINUX=y
CONFIG_SLAVE_IDF_TARGET_ESP32C6=y
CONFIG_ESP_HOSTED_HOST_FEAT_RPC=y
CONFIG_ESP_HOSTED_HOST_FEAT_RPC_EXT_V2=y
CONFIG_ESP_HOSTED_HOST_AUTO_FEAT_INIT=y
CONFIG_ESP_HOSTED_HOST_FEAT_SYSTEM_AUTO_INIT=y

CONFIG_ESP_HOSTED_HOST_FEAT_WIFI=y
CONFIG_ESP_HOSTED_HOST_FEAT_WIFI_AUTO_INIT=y
CONFIG_ESP_WIFI_AP_SSID="myssid_ap"
CONFIG_ESP_WIFI_AP_PASSWORD="mypassword"
CONFIG_ESP_WIFI_AP_CHANNEL=1
CONFIG_ESP_WIFI_AP_MAX_STA_CONN=4
CONFIG_ESP_WIFI_STA_SSID="myssid"
CONFIG_ESP_WIFI_STA_PASSWORD="mypassword"
```

## examples/wifi/iperf/mcu_host/sdkconfig.defaults
```kconfig
CONFIG_ESP_SYSTEM_EVENT_TASK_STACK_SIZE=4096

CONFIG_FREERTOS_UNICORE=n
CONFIG_FREERTOS_HZ=1000

CONFIG_ESP_INT_WDT=n
CONFIG_ESP_TASK_WDT_EN=n

CONFIG_LWIP_IRAM_OPTIMIZATION=y
CONFIG_LWIP_TCPIP_TASK_PRIO=23

CONFIG_IPERF_TRAFFIC_TASK_PRIORITY=23
CONFIG_IPERF_REPORT_TASK_PRIORITY=24
CONFIG_COMPILER_OPTIMIZATION_PERF=y

CONFIG_PARTITION_TABLE_SINGLE_APP_LARGE=y

# These two configurations disable the phy pll track feature, only used for experimental
CONFIG_ESP_PHY_DEBUG=y
CONFIG_ESP_PHY_DISABLE_PLL_TRACK=y

CONFIG_ESP_HOSTED=y
CONFIG_ESP_HOSTED_HOST_FEAT_RPC=y
CONFIG_ESP_HOSTED_HOST_FEAT_RPC_EXT_V2=y
CONFIG_ESP_HOSTED_HOST_FEAT_SYSTEM=y
CONFIG_ESP_HOSTED_HOST_FEAT_WIFI=y
# CONFIG_ESP_HOSTED_HOST_FEAT_WIFI_EXT_ITWT is not set
# wifi-cmd has an independent ITWT CLI switch; keep it off for hosted.
# CONFIG_WIFI_CMD_ENABLE_ITWT is not set


CONFIG_SLAVE_IDF_TARGET_ESP32C5=y
CONFIG_ESP_HOSTED_CP_TARGET_ESP3256=y

CONFIG_WIFI_RMT_STATIC_RX_BUFFER_NUM=16
CONFIG_WIFI_RMT_DYNAMIC_RX_BUFFER_NUM=64
CONFIG_WIFI_RMT_DYNAMIC_TX_BUFFER_NUM=64
CONFIG_WIFI_RMT_AMPDU_TX_ENABLED=y
CONFIG_WIFI_RMT_TX_BA_WIN=32
CONFIG_WIFI_RMT_AMPDU_RX_ENABLED=y
CONFIG_WIFI_RMT_RX_BA_WIN=32

CONFIG_LWIP_TCP_SND_BUF_DEFAULT=65534
CONFIG_LWIP_TCP_WND_DEFAULT=65534
CONFIG_LWIP_TCP_RECVMBOX_SIZE=64
CONFIG_LWIP_UDP_RECVMBOX_SIZE=64
CONFIG_LWIP_TCPIP_RECVMBOX_SIZE=64

CONFIG_LWIP_TCP_SACK_OUT=y
```

## examples/wifi/iperf/mcu_host/sdkconfig.defaults.esp32p4
```kconfig
#
# ESP32-P4 specific
#

CONFIG_WIFI_RMT_STATIC_RX_BUFFER_NUM=16
CONFIG_WIFI_RMT_DYNAMIC_RX_BUFFER_NUM=32
CONFIG_WIFI_RMT_DYNAMIC_TX_BUFFER_NUM=32
CONFIG_WIFI_RMT_AMPDU_TX_ENABLED=y
CONFIG_WIFI_RMT_TX_BA_WIN=16
CONFIG_WIFI_RMT_AMPDU_RX_ENABLED=y
CONFIG_WIFI_RMT_RX_BA_WIN=16

CONFIG_LWIP_TCP_SND_BUF_DEFAULT=41760
CONFIG_LWIP_TCP_WND_DEFAULT=65535
CONFIG_LWIP_TCP_RECVMBOX_SIZE=32
CONFIG_LWIP_UDP_RECVMBOX_SIZE=32
CONFIG_LWIP_TCPIP_RECVMBOX_SIZE=32
CONFIG_LWIP_IP_REASS_MAX_PBUFS=15

CONFIG_LWIP_TCPIP_CORE_LOCKING=y
CONFIG_LWIP_TCPIP_CORE_LOCKING_INPUT=y

CONFIG_LWIP_TCP_SACK_OUT=y

#CONFIG_ESP_HOSTED_P4_C5_CORE_BOARD=y
#CONFIG_SLAVE_IDF_TARGET_ESP32C5=y
#
#CONFIG_USJ_ENABLE_USB_SERIAL_JTAG=y
#CONFIG_ESP_CONSOLE_USB_SERIAL_JTAG=y

# Old P4 chip version
#CONFIG_ESP32P4_SELECTS_REV_LESS_V3=y
```

## examples/wifi/itwt/mcu_host/sdkconfig.defaults
```kconfig
# SPDX-License-Identifier: Apache-2.0
# wifi/itwt/mcu_host — Wi-Fi STA + iTWT on host MCU

CONFIG_ESP_HOSTED=y

CONFIG_ESP_HOSTED_HOST_FEAT_RPC=y
CONFIG_ESP_HOSTED_HOST_FEAT_RPC_EXT_V2=y
CONFIG_ESP_HOSTED_HOST_FEAT_SYSTEM=y

CONFIG_ESP_HOSTED_HOST_FEAT_WIFI=y
CONFIG_ESP_HOSTED_HOST_FEAT_WIFI_EXT_ITWT=y


CONFIG_BT_ENABLED=n

# Power management for iTWT
CONFIG_PM_ENABLE=y
CONFIG_FREERTOS_USE_TICKLESS_IDLE=y
CONFIG_PM_SLP_IRAM_OPT=y
CONFIG_PM_RTOS_IDLE_OPT=y
CONFIG_PM_SLP_DISABLE_GPIO=y
CONFIG_ESP_WIFI_SLP_IRAM_OPT=y
CONFIG_ESP_DEFAULT_CPU_FREQ_MHZ_80=y

CONFIG_ESPTOOLPY_FLASHSIZE_4MB=y
CONFIG_PARTITION_TABLE_CUSTOM=y
CONFIG_PARTITION_TABLE_CUSTOM_FILENAME="partitions_eh_cp_ota_4m.csv"

CONFIG_FREERTOS_HZ=1000

# iTWT/sleep — avoid gratuitous ARP wake-ups (matches upstream).
CONFIG_LWIP_ESP_GRATUITOUS_ARP=n
# CONFIG_ESP_GRATUITOUS_ARP is not set
```

## examples/wifi/scan/linux_802_3_host/c_app/main/Kconfig.projbuild
```kconfig
menu "Example Configuration"

    config EH_USE_LEGACY_API
        bool "Use legacy esp_hosted_* compat-surface main"
        default n

    config EXAMPLE_SCAN_LIST_SIZE
        int "Max size of scan list"
        range 0 20
        default 10

endmenu
```

## examples/wifi/softap/linux_802_3_host/c_app/main/Kconfig.projbuild
```kconfig
menu "Example Configuration"

    config EH_USE_LEGACY_API
        bool "Use legacy esp_hosted_* compat-surface main"
        default n
        help
            When enabled, builds the example from legacy/main.c (standard
            ESP-IDF softAP code on the esp_hosted_* compat surface) instead
            of main/main.c (native eh_host_* API).

    config ESP_WIFI_SSID
        string "WiFi SoftAP SSID"
        default "myssid"

    config ESP_WIFI_PASSWORD
        string "WiFi SoftAP Password"
        default "mypassword"

    config ESP_WIFI_CHANNEL
        int "WiFi SoftAP Channel"
        range 1 13
        default 1

    config ESP_MAX_STA_CONN
        int "Max station connections"
        default 4

endmenu
```
