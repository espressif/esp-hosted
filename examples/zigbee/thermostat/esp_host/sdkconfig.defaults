## host/Kconfig.ext
```kconfig
menu "Configure host"
	depends on ESP_HOSTED_HOST

	choice ESP_HOSTED_HOST_TYPE
		prompt "Host Type"
		default ESP_HOSTED_HOST_TYPE_MCU
		help
			Select the host implementation type.
			This selects default transport and vserial backend wiring.

		config ESP_HOSTED_HOST_TYPE_MCU
			bool "MCU host"

		config ESP_HOSTED_HOST_TYPE_POSIX
			bool "Linux host : User Space"

		config ESP_HOSTED_HOST_TYPE_LINUX_KMOD
			bool "Linux host : Kernel Module"
	endchoice

	# Paired coprocessor selection — 1:1 mirror of Wi-Fi Remote's
	# SLAVE_IDF_TARGET choice; matches upstream esp-hosted-mcu.
	config ESP_HOSTED_CP_TARGET_FROM_WIFI_REMOTE
		bool
		default y if SLAVE_IDF_TARGET_ESP32 || SLAVE_IDF_TARGET_ESP32S2 || SLAVE_IDF_TARGET_ESP32S3 || SLAVE_IDF_TARGET_ESP32C2 || SLAVE_IDF_TARGET_ESP32C3 || SLAVE_IDF_TARGET_ESP32C5 || SLAVE_IDF_TARGET_ESP32C6 || SLAVE_IDF_TARGET_ESP32C61
		default n

	choice ESP_HOSTED_CP_TARGET
		bool "Paired coprocessor (other side of bus)"

		default ESP_HOSTED_CP_TARGET_ESP32   if SLAVE_IDF_TARGET_ESP32
		default ESP_HOSTED_CP_TARGET_ESP32S2 if SLAVE_IDF_TARGET_ESP32S2
		default ESP_HOSTED_CP_TARGET_ESP32S3 if SLAVE_IDF_TARGET_ESP32S3
		default ESP_HOSTED_CP_TARGET_ESP32C2 if SLAVE_IDF_TARGET_ESP32C2
		default ESP_HOSTED_CP_TARGET_ESP32C3 if SLAVE_IDF_TARGET_ESP32C3
		default ESP_HOSTED_CP_TARGET_ESP32C5 if SLAVE_IDF_TARGET_ESP32C5
		default ESP_HOSTED_CP_TARGET_ESP32C6 if SLAVE_IDF_TARGET_ESP32C6
		default ESP_HOSTED_CP_TARGET_ESP32C61 if SLAVE_IDF_TARGET_ESP32C61
		default ESP_HOSTED_CP_TARGET_ESP32C6 if !ESP_HOSTED_CP_TARGET_FROM_WIFI_REMOTE

		config ESP_HOSTED_CP_TARGET_ESP32
			depends on SLAVE_IDF_TARGET_ESP32 || !ESP_HOSTED_CP_TARGET_FROM_WIFI_REMOTE
			bool "ESP32"
		config ESP_HOSTED_CP_TARGET_ESP32S2
			depends on SLAVE_IDF_TARGET_ESP32S2 || !ESP_HOSTED_CP_TARGET_FROM_WIFI_REMOTE
			bool "ESP32-S2"
		config ESP_HOSTED_CP_TARGET_ESP32S3
			depends on SLAVE_IDF_TARGET_ESP32S3 || !ESP_HOSTED_CP_TARGET_FROM_WIFI_REMOTE
			bool "ESP32-S3"
		config ESP_HOSTED_CP_TARGET_ESP32C2
			depends on SLAVE_IDF_TARGET_ESP32C2 || !ESP_HOSTED_CP_TARGET_FROM_WIFI_REMOTE
			bool "ESP32-C2"
		config ESP_HOSTED_CP_TARGET_ESP32C3
			depends on SLAVE_IDF_TARGET_ESP32C3 || !ESP_HOSTED_CP_TARGET_FROM_WIFI_REMOTE
			bool "ESP32-C3"
		config ESP_HOSTED_CP_TARGET_ESP32C5
			depends on SLAVE_IDF_TARGET_ESP32C5 || !ESP_HOSTED_CP_TARGET_FROM_WIFI_REMOTE
			bool "ESP32-C5"
		config ESP_HOSTED_CP_TARGET_ESP32C6
			depends on SLAVE_IDF_TARGET_ESP32C6 || !ESP_HOSTED_CP_TARGET_FROM_WIFI_REMOTE
			bool "ESP32-C6"
		config ESP_HOSTED_CP_TARGET_ESP32C61
			depends on SLAVE_IDF_TARGET_ESP32C61 || !ESP_HOSTED_CP_TARGET_FROM_WIFI_REMOTE
			bool "ESP32-C61"

		# BT-only — no Wi-Fi Remote dep.
		config ESP_HOSTED_CP_TARGET_ESP32H2
			bool "ESP32-H2"
		config ESP_HOSTED_CP_TARGET_ESP32H4
			bool "ESP32-H4"
	endchoice

	# Show warning only when Wi-Fi Remote target symbols exist and mismatch
	# the ESP-Hosted CP target selection.
	comment "Conflict: Wi-Fi Remote SLAVE_IDF_TARGET differs from ESP-Hosted CP target"
		depends on ESP_HOSTED_CP_TARGET_FROM_WIFI_REMOTE && ( \
			(ESP_HOSTED_CP_TARGET_ESP32   && !SLAVE_IDF_TARGET_ESP32)   || \
			(ESP_HOSTED_CP_TARGET_ESP32S2 && !SLAVE_IDF_TARGET_ESP32S2) || \
			(ESP_HOSTED_CP_TARGET_ESP32S3 && !SLAVE_IDF_TARGET_ESP32S3) || \
			(ESP_HOSTED_CP_TARGET_ESP32C2 && !SLAVE_IDF_TARGET_ESP32C2) || \
			(ESP_HOSTED_CP_TARGET_ESP32C3 && !SLAVE_IDF_TARGET_ESP32C3) || \
			(ESP_HOSTED_CP_TARGET_ESP32C5 && !SLAVE_IDF_TARGET_ESP32C5) || \
			(ESP_HOSTED_CP_TARGET_ESP32C6 && !SLAVE_IDF_TARGET_ESP32C6) || \
			(ESP_HOSTED_CP_TARGET_ESP32C61 && !SLAVE_IDF_TARGET_ESP32C61) || \
			(ESP_HOSTED_CP_TARGET_ESP32H2) || \
			(ESP_HOSTED_CP_TARGET_ESP32H4) )

	config ESP_HOSTED_IDF_SLAVE_TARGET
		string
		default "esp32"   if ESP_HOSTED_CP_TARGET_ESP32
		default "esp32s2" if ESP_HOSTED_CP_TARGET_ESP32S2
		default "esp32s3" if ESP_HOSTED_CP_TARGET_ESP32S3
		default "esp32c2" if ESP_HOSTED_CP_TARGET_ESP32C2
		default "esp32c3" if ESP_HOSTED_CP_TARGET_ESP32C3
		default "esp32c5" if ESP_HOSTED_CP_TARGET_ESP32C5
		default "esp32c6" if ESP_HOSTED_CP_TARGET_ESP32C6
		default "esp32c61" if ESP_HOSTED_CP_TARGET_ESP32C61
		default "esp32h2" if ESP_HOSTED_CP_TARGET_ESP32H2
		default "esp32h4" if ESP_HOSTED_CP_TARGET_ESP32H4
		default "invalid"

	# H2 / H4 have no Wi-Fi; gate wifi knobs on this symbol.
	config ESP_HOSTED_PRIV_ENABLE_WIFI_OPTIONS
		bool
		default n if ESP_HOSTED_CP_TARGET_ESP32H2 || ESP_HOSTED_CP_TARGET_ESP32H4
		default y

	choice ESP_HOSTED_DEV_BOARD
		prompt "Select PCB Board (Optional)"
		default ESP_HOSTED_P4_DEV_BOARD_NONE

		config ESP_ESP32C5_SPI_RASPI_MATING_BOARD
			bool "ESP32-C5 RaspPi Mating Board (SPI)"
			depends on ESP_HOSTED_HOST_TYPE_POSIX && ESP_HOSTED_CP_TARGET_ESP32C5

		config ESP_HOSTED_P4_DEV_BOARD_NONE
			bool "No specific PCB board"

		config ESP_HOSTED_P4_DEV_BOARD_FUNC_BOARD
			bool "ESP32-P4-Function-EV-Board"
			depends on ESP_HOSTED_HOST_TYPE_MCU && (ESP_HOSTED_CP_TARGET_ESP32C6 || ESP_HOSTED_CP_TARGET_ESP32C5 || ESP_HOSTED_CP_TARGET_ESP32C2)

		config ESP32P4_EYE_C6_BOARD
			bool "ESP32-P4-EYE Board (C6 CP)"
			depends on ESP_HOSTED_CP_TARGET_ESP32C6

		config ESP_HOSTED_P4_C5_CORE_BOARD
			bool "ESP32-P4 + C5 Core Board"
			depends on ESP_HOSTED_CP_TARGET_ESP32C5

		config ESP_HOSTED_P4_C6_CORE_BOARD
			bool "ESP32-P4 + C6 Core Board"
			depends on ESP_HOSTED_CP_TARGET_ESP32C6

		config ESP_HOSTED_P4_C61_CORE_BOARD
			bool "ESP32-P4 + C61 Core Board"
			depends on ESP_HOSTED_CP_TARGET_ESP32C61

		config ESP_HOSTED_C2_C5_MODULE_SUB_BOARD
			bool "ESP32-P4 EV Sub-Board for C2 & C5"
			depends on ESP_HOSTED_HOST_TYPE_MCU && (ESP_HOSTED_CP_TARGET_ESP32C2 || ESP_HOSTED_CP_TARGET_ESP32C5)
	endchoice

	menu "Host core"
		orsource "eh_host_core/Kconfig.ext"
	endmenu

	menu "Host transport"
		orsource "mcu/eh_host_mcu_transport/Kconfig.ext"
		orsource "mcu/eh_host_mcu_vserial/Kconfig.ext"
		orsource "linux/eh_host_linux_vserial/Kconfig.ext"
	endmenu

	menu "RPC Support"
		orsource "features/eh_host_feat_rpc/Kconfig.ext"

	config ESP_HOSTED_HOST_FEAT_RPC_EXT_V2
		bool
		default y
		depends on ESP_HOSTED_HOST_FEAT_RPC
		help
			V2 (rpc_v2.proto, msg_id dispatch) is the only supported
			host RPC ext. The V1 wire (rpc_v1.proto / CtrlMsg) is owned
			at CP-side for external Linux host clients only; no in-tree
			host code speaks V1.

		orsource "features/eh_host_feat_rpc_ext_v2/Kconfig.ext"
	endmenu

	menu "Features"
		orsource "features/eh_host_feat_system/Kconfig.ext"
		# Wi-Fi extensions are nested under the wifi feature's Kconfig.
		orsource "features/eh_host_feat_wifi/Kconfig.ext"
		orsource "features/eh_host_feat_bt/Kconfig.ext"
		orsource "features/eh_host_feat_openthread/Kconfig.ext"
		orsource "features/eh_host_feat_peer_data/Kconfig.ext"
		orsource "features/eh_host_feat_nw_split/Kconfig.ext"
		orsource "features/eh_host_feat_gpio_exp/Kconfig.ext"
		orsource "features/eh_host_feat_cp_ext_coex/Kconfig.ext"
		orsource "features/eh_host_feat_heartbeat/Kconfig.ext"
		orsource "features/eh_host_feat_mem_monitor/Kconfig.ext"
		orsource "features/eh_host_feat_power_save/Kconfig.ext"
		orsource "features/eh_host_feat_cli/Kconfig.ext"
	endmenu

	menu "Port"
		orsource "../port/Kconfig.ext"
	endmenu

	orsource "compat/Kconfig.ext"
endmenu
```

## host/compat/Kconfig.ext
```kconfig
config ESP_HOSTED_HOST_COMPAT
	bool
	default y if ESP_HOSTED_HOST_FEAT_RPC_READY
	help
	  Public esp_hosted_* API surface; thin static inline redirects to
	  the canonical eh_host_* functions. Both surfaces are publicly
	  usable; only 5 orchestration APIs are real (non-inline) symbols.
	  Auto-asserted whenever the RPC base is built.
```

## host/features/eh_host_feat_bt/Kconfig.ext
```kconfig
menuconfig ESP_HOSTED_HOST_FEAT_BT
	bool "Bluetooth"
	default n
	depends on ESP_HOSTED_HOST && ESP_HOSTED_HOST_FEAT_RPC
	depends on ESP_HOSTED_HOST_FEAT_RPC_EXT_V2_READY
	help
	  Stack-agnostic hosted-HCI plumbing: CP controller lifecycle +
	  HCI byte pass-through. Stack bridges (NimBLE/Bluedroid/BlueZ)
	  ship as example components under examples/bluetooth/.

if ESP_HOSTED_HOST_FEAT_BT

	config ESP_HOSTED_HOST_FEAT_BT_MAC
		string "BT MAC address (xx:xx:xx:xx:xx:xx), blank = leave default"
		default ""
		help
		  If non-empty, esp_hosted_bt_stack_setup() applies this BT MAC
		  before bringing the controller up. A runtime cfg.bt_mac overrides
		  it. 48-bit MAC as six colon-separated hex pairs.

endif # ESP_HOSTED_HOST_FEAT_BT

config ESP_HOSTED_HOST_FEAT_BT_READY
	bool
	default y if ESP_HOSTED_HOST_FEAT_BT && ESP_HOSTED_HOST_FEAT_RPC_READY && ESP_HOSTED_HOST_FEAT_RPC_EXT_V2_READY

# Removed in 3.0 — kept only to fail the build on a stale hosted-BT sdkconfig.
config ESP_HOSTED_ENABLE_BT_BLUEDROID
	bool "[REMOVED 3.0] enable CONFIG_BT_BLUEDROID_ENABLED + ESP_HOSTED_HOST_FEAT_BT; call esp_hosted_bt_stack_setup()"
config ESP_HOSTED_BLUEDROID_HCI_VHCI
	bool "[REMOVED 3.0] enable CONFIG_BT_BLUEDROID_ENABLED + ESP_HOSTED_HOST_FEAT_BT; call esp_hosted_bt_stack_setup()"
config ESP_HOSTED_ENABLE_BT_NIMBLE
	bool "[REMOVED 3.0] enable CONFIG_BT_NIMBLE_ENABLED + ESP_HOSTED_HOST_FEAT_BT; call esp_hosted_bt_stack_setup()"
config ESP_HOSTED_NIMBLE_HCI_VHCI
	bool "[REMOVED 3.0] enable CONFIG_BT_NIMBLE_ENABLED + ESP_HOSTED_HOST_FEAT_BT; call esp_hosted_bt_stack_setup()"
```

## host/features/eh_host_feat_cli/Kconfig.ext
```kconfig
menuconfig ESP_HOSTED_HOST_FEAT_CLI
	bool "host cli"
	depends on ESP_HOSTED_HOST && ESP_HOSTED_HOST_TYPE_MCU
	default y if ESP_HOSTED_HOST_FEAT_POWER_SAVE
	default n
	help
	  Enable the host-side CLI feature.  Registers one esp_console
	  command set per dependent feature compiled in (e.g. host_power_save
	  commands when EH_HOST_FEAT_POWER_SAVE_READY is true).

	  Mirrors the CP-side eh_cp_feat_cli surface.

if ESP_HOSTED_HOST_FEAT_CLI

	config ESP_HOSTED_HOST_FEAT_CLI_READY
		bool
		default y

	config ESP_HOSTED_HOST_FEAT_CLI_AUTO_INIT
		bool "Auto-init CLI at boot (register commands during eh_host_init)"
		default y
		depends on ESP_HOSTED_HOST_AUTO_FEAT_INIT
		help
		  When enabled, host CLI feature auto-initializes during the
		  linker-section feature walk and registers its console commands.
		  Disable to manually call eh_host_feat_cli_register_commands()
		  from the app after esp_console_new_repl_* setup.

endif # ESP_HOSTED_HOST_FEAT_CLI
```

## host/features/eh_host_feat_cp_ext_coex/Kconfig.ext
```kconfig
menuconfig ESP_HOSTED_HOST_FEAT_CP_EXT_COEX
	bool "External Coexistence"
	default n
	depends on ESP_HOSTED_HOST && ESP_HOSTED_HOST_FEAT_RPC
	depends on ESP_HOSTED_HOST_FEAT_RPC_EXT_V2_READY
	help
	  Drives the coprocessor's external PTA (Packet Traffic Arbiter)
	  lines: grant/request/priority pins, work-mode selection, grant
	  delay, disable.  Used when a second radio (Wi-Fi / BT) on the
	  host board needs to share the air with the CP radio.

if ESP_HOSTED_HOST_FEAT_CP_EXT_COEX

	config ESP_HOSTED_HOST_FEAT_CP_EXT_COEX_AUTO_INIT
		bool "Auto-initialize Ext-Coex feature at boot"
		default y
		depends on ESP_HOSTED_HOST_AUTO_FEAT_INIT
		help
		  When enabled, eh_host_feat_cp_ext_coex_init() runs during the
		  linker-section auto-init walk.

	config ESP_HOSTED_HOST_FEAT_CP_EXT_COEX_ADVANCE
		bool "Enable advanced ext-coex controls"
		default n
		help
		  Enables advanced ext-coex control paths (work mode/grant
		  delay/validate-high) when supported by coprocessor.

endif # ESP_HOSTED_HOST_FEAT_CP_EXT_COEX

config ESP_HOSTED_HOST_FEAT_CP_EXT_COEX_READY
	bool
	default y if ESP_HOSTED_HOST_FEAT_CP_EXT_COEX && ESP_HOSTED_HOST_FEAT_RPC_READY && ESP_HOSTED_HOST_FEAT_RPC_EXT_V2_READY
```

## host/features/eh_host_feat_gpio_exp/Kconfig.ext
```kconfig
menuconfig ESP_HOSTED_HOST_FEAT_GPIO_EXP
	bool "GPIO Expander"
	default n
	depends on ESP_HOSTED_HOST && ESP_HOSTED_HOST_FEAT_RPC
	depends on ESP_HOSTED_HOST_FEAT_RPC_EXT_V2_READY
	help
	  Exposes the coprocessor's GPIO controller to host callers as a
	  "GPIO expander" — a set of RPCs that configure, read, write,
	  interrupt-enable and hold pins on the CP device.

	  This is distinct from the host's local GPIO (served by the
	  eh_port_gpio port API on the host MCU or Linux).  The expander
	  acts on CP-side pins only; the two surfaces do not share
	  numbering or lifecycle.

if ESP_HOSTED_HOST_FEAT_GPIO_EXP

	config ESP_HOSTED_HOST_FEAT_GPIO_EXP_AUTO_INIT
		bool "Auto-initialize GPIO-expander feature at boot"
		default y
		depends on ESP_HOSTED_HOST_AUTO_FEAT_INIT
		help
		  When enabled, eh_host_feat_gpio_exp_init() runs during the
		  linker-section auto-init walk.

endif # ESP_HOSTED_HOST_FEAT_GPIO_EXP

config ESP_HOSTED_HOST_FEAT_GPIO_EXP_READY
	bool
	default y if ESP_HOSTED_HOST_FEAT_GPIO_EXP && ESP_HOSTED_HOST_FEAT_RPC_READY && ESP_HOSTED_HOST_FEAT_RPC_EXT_V2_READY
```

## host/features/eh_host_feat_heartbeat/Kconfig.ext
```kconfig
menuconfig ESP_HOSTED_HOST_FEAT_HEARTBEAT
	bool "Heartbeat"
	default n
	depends on ESP_HOSTED_HOST && ESP_HOSTED_HOST_FEAT_RPC
	depends on ESP_HOSTED_HOST_FEAT_RPC_EXT_V2_READY
	help
	  Requires the MCU V1 RPC extension — ConfigHeartbeat IDs live in
	  the Rpc proto family.  Linux-FG (CtrlMsg) equivalent deferred.

	  Configures a periodic liveness heartbeat with the coprocessor
	  and subscribes the CP-side heartbeat events.  This is the
	  control-plane heartbeat only — distinct from CP-side sleep
	  features (eh_cp_feat_host_ps deep-sleep GPIO wakeup config and
	  example-scope light-sleep integration via host_ps callbacks).

if ESP_HOSTED_HOST_FEAT_HEARTBEAT

	config ESP_HOSTED_HOST_FEAT_HEARTBEAT_AUTO_INIT
		bool "Auto-initialize Heartbeat configurator at boot"
		default y
		depends on ESP_HOSTED_HOST_AUTO_FEAT_INIT
		help
		  When enabled, eh_host_feat_heartbeat_init() runs during the
		  linker-section auto-init walk.

endif # ESP_HOSTED_HOST_FEAT_HEARTBEAT

config ESP_HOSTED_HOST_FEAT_HEARTBEAT_READY
	bool
	default y if ESP_HOSTED_HOST_FEAT_HEARTBEAT && ESP_HOSTED_HOST_FEAT_RPC_READY && ESP_HOSTED_HOST_FEAT_RPC_EXT_V2_READY
```

## host/features/eh_host_feat_mem_monitor/Kconfig.ext
```kconfig
menuconfig ESP_HOSTED_HOST_FEAT_MEM_MONITOR
	bool "Memory Monitor"
	default n
	depends on ESP_HOSTED_HOST && ESP_HOSTED_HOST_FEAT_RPC
	depends on ESP_HOSTED_HOST_FEAT_RPC_EXT_V2_READY
	help
	  Host-side mirror of coprocessor/features/eh_cp_feat_mem_monitor.
	  Provides eh_host_set_mem_monitor() — the V1 typed wrapper that
	  mirrors upstream esp_hosted_set_mem_monitor() verbatim: takes an
	  esp_hosted_config_mem_monitor_t (config = enable / disable /
	  no-change, report_always flag, and interval_sec) plus an out
	  esp_hosted_curr_mem_info_t snapshot of the current heap
	  watermarks (total / min free, internal + external cap classes).
	  Drives the CP handler for RPC__REQ__MEM_MONITOR
	  (eh_cp_feat_rpc_ext_v2_handler_req_mem_monitor.c) and
	  subscribes to inbound Event_MemMonitor — dispatched onto
	  ESP_HOSTED_EVENT (id = ESP_HOSTED_EVENT_MEM_MONITOR) with
	  payload esp_hosted_event_mem_info_t.  Enabling this config
	  plugs init/deinit into the auto-init walk and registers the
	  event handlers.

if ESP_HOSTED_HOST_FEAT_MEM_MONITOR

	config ESP_HOSTED_HOST_FEAT_MEM_MONITOR_AUTO_INIT
		bool "Auto-initialize mem-monitor feature at boot"
		default y
		depends on ESP_HOSTED_HOST_AUTO_FEAT_INIT

endif # ESP_HOSTED_HOST_FEAT_MEM_MONITOR

config ESP_HOSTED_HOST_FEAT_MEM_MONITOR_READY
	bool
	default y if ESP_HOSTED_HOST_FEAT_MEM_MONITOR && ESP_HOSTED_HOST_FEAT_RPC_READY && ESP_HOSTED_HOST_FEAT_RPC_EXT_V2_READY
```
