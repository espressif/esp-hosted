## host/features/eh_host_feat_nw_split/Kconfig.ext
```kconfig
menuconfig ESP_HOSTED_HOST_FEAT_NW_SPLIT
	bool "Network Split"
	default n
	depends on ESP_HOSTED_HOST && ESP_HOSTED_HOST_FEAT_RPC
	depends on ESP_HOSTED_HOST_FEAT_RPC_EXT_V2_READY
	depends on ESP_HOSTED_HOST_FEAT_WIFI_READY
	help
	  Host-side counterpart of the CP Network-Split feature:
	    - Owns the host STA netif lifecycle (ownership configurable
	      below: APP_EXTERNAL / INTERNAL_DHCP / INTERNAL_STATIC).
	    - Subscribes to the CP's DHCP/DNS status event and re-emits
	      it on the host event base (slot
	      ESP_HOSTED_EVENT_NW_SPLIT_STATUS) for app code to consume.
	    - In INTERNAL_STATIC mode, applies the CP-supplied IP/DNS
	      directly to the host netif (faster IP-up than host DHCP).
	    - Drives Req_SetDhcpDnsStatus / Req_GetDhcpDnsStatus through
	      the active MCU V1 RPC extension for synchronous lease pushes
	      and snapshot reads.

	  Wire IDs: Req_SetDhcpDnsStatus = 352, Req_GetDhcpDnsStatus = 353,
	  Event_DhcpDnsStatus = 777 (gen_v2.h).

if ESP_HOSTED_HOST_FEAT_NW_SPLIT

	config ESP_HOSTED_HOST_FEAT_NW_SPLIT_AUTO_INIT
		bool "Auto-initialize Network-Split feature at boot"
		default y
		depends on ESP_HOSTED_HOST_AUTO_FEAT_INIT
		help
		  When enabled, eh_host_feat_nw_split_init() runs during the
		  linker-section auto-init walk.  Disable to drive lifecycle
		  manually from the app.

	choice ESP_HOSTED_HOST_FEAT_NW_SPLIT_NETIF
		prompt "Host-side STA netif ownership + IP source"
		default ESP_HOSTED_HOST_FEAT_NW_SPLIT_NETIF_APP_EXTERNAL
		help
		  Selects who creates the host-side STA netif and how host IP
		  is sourced.

		config ESP_HOSTED_HOST_FEAT_NW_SPLIT_NETIF_APP_EXTERNAL
			bool "External: app owns the netif"
			help
			  App creates WIFI_STA_DEF (for example,
			  esp_netif_create_default_wifi_sta) before
			  esp_hosted_init. nw_split looks it up, uses it, and
			  applies the CP-supplied IP/DNS to that netif.

		config ESP_HOSTED_HOST_FEAT_NW_SPLIT_NETIF_INTERNAL_DHCP
			bool "Internal + DHCP: nw_split creates netif, host runs DHCP"
			help
			  nw_split creates default STA netif and host DHCP runs via
			  the normal Wi-Fi/IP event pipeline.
			  Requires CONFIG_WIFI_CMD_NO_LWIP=y so wifi-cmd/app does not
			  create WIFI_STA_DEF a second time.

		config ESP_HOSTED_HOST_FEAT_NW_SPLIT_NETIF_INTERNAL_STATIC
			bool "Internal + static: nw_split creates netif, CP provides IP"
			help
			  nw_split creates STA netif with DHCP client disabled and
			  applies static IP/DNS from CP's Event_DhcpDnsStatus.
			  Requires CONFIG_WIFI_CMD_NO_LWIP=y so wifi-cmd/app does not
			  create WIFI_STA_DEF a second time.
	endchoice

	menu "LWIP port config"
		help
		  Host/CP port-range partition for Network Split. Keep host-local
		  and CP-remote ranges non-overlapping.

		menu "Host side (local) LWIP port config"
			config LWIP_TCP_LOCAL_PORT_RANGE_START  # ignore: multiple-definition
				int "Host TCP start port"
				default 49152
				help
				  Host-local TCP range start.

			config LWIP_TCP_LOCAL_PORT_RANGE_END  # ignore: multiple-definition
				int "Host TCP end port"
				default 61439
				help
				  Host-local TCP range end.

			config LWIP_UDP_LOCAL_PORT_RANGE_START  # ignore: multiple-definition
				int "Host UDP start port"
				default 49152
				help
				  Host-local UDP range start.

			config LWIP_UDP_LOCAL_PORT_RANGE_END  # ignore: multiple-definition
				int "Host UDP end port"
				default 61439
				help
				  Host-local UDP range end.
		endmenu

		menu "CP side (remote) LWIP port config"
			config LWIP_TCP_REMOTE_PORT_RANGE_START  # ignore: multiple-definition
				int "CP TCP start port"
				default 61440
				help
				  CP-remote TCP range start.

			config LWIP_TCP_REMOTE_PORT_RANGE_END  # ignore: multiple-definition
				int "CP TCP end port"
				default 65535
				help
				  CP-remote TCP range end.

			config LWIP_UDP_REMOTE_PORT_RANGE_START  # ignore: multiple-definition
				int "CP UDP start port"
				default 61440
				help
				  CP-remote UDP range start.

			config LWIP_UDP_REMOTE_PORT_RANGE_END  # ignore: multiple-definition
				int "CP UDP end port"
				default 65535
				help
				  CP-remote UDP range end.
		endmenu
	endmenu

endif # ESP_HOSTED_HOST_FEAT_NW_SPLIT

config ESP_HOSTED_HOST_FEAT_NW_SPLIT_READY
	bool
	default y if ESP_HOSTED_HOST_FEAT_NW_SPLIT && ESP_HOSTED_HOST_FEAT_RPC_READY && ESP_HOSTED_HOST_FEAT_RPC_EXT_V2_READY && ESP_HOSTED_HOST_FEAT_WIFI_READY
```

## host/features/eh_host_feat_openthread/Kconfig.ext
```kconfig
menuconfig ESP_HOSTED_HOST_FEAT_OPENTHREAD
	bool "OpenThread (RCP control)"
	default n
	depends on ESP_HOSTED_HOST && ESP_HOSTED_HOST_FEAT_RPC
	depends on ESP_HOSTED_HOST_FEAT_RPC_EXT_V2_READY
	help
	  Feature-layer policy for OpenThread RCP lifecycle over
	  RpcReqFeatureControl.  When enabled, the host can drive
	  init / deinit / start / stop / query of OpenThread on the
	  co-processor, and the local port layer publishes the
	  RCP UART pin / baud config to the host OT stack.

if ESP_HOSTED_HOST_FEAT_OPENTHREAD

	config ESP_HOSTED_HOST_FEAT_OPENTHREAD_AUTO_INIT
		bool "Auto-initialize OpenThread feature at boot"
		default y
		depends on ESP_HOSTED_HOST_AUTO_FEAT_INIT

	config ESP_HOSTED_OT_HOST_ENABLE
		bool
		default y

	# HOST_-prefixed to avoid clashing with the CP-side choice in the combined tree.
	choice ESP_HOSTED_OT_HOST_INTERFACE
		bool "OpenThread RCP transport (host side)"
		default ESP_HOSTED_OT_HOST_TRANSPORT_UART

		config ESP_HOSTED_OT_HOST_TRANSPORT_UART
			bool "Dedicated UART"
			help
				Dedicated UART link between this host and the
				OpenThread RCP.

		config ESP_HOSTED_OT_HOST_TRANSPORT_HOSTED
			bool "ESP-Hosted transport (not supported yet)"
			help
				Tunnel the OpenThread spinel over the shared
				ESP-Hosted transport.  Not implemented yet.
	endchoice

	if ESP_HOSTED_OT_HOST_TRANSPORT_UART

		config ESP_HOSTED_OT_HOST_UART_PORT
			int "UART port"
			default 1
			range 0 2

		config ESP_HOSTED_OT_HOST_PIN_TO_RCP_TX
			int "Host TX pin (to RCP RX)"
			default 11

		config ESP_HOSTED_OT_HOST_PIN_TO_RCP_RX
			int "Host RX pin (from RCP TX)"
			default 10

		config ESP_HOSTED_OT_HOST_UART_BAUDRATE
			int "Baud rate"
			default 460800
			range 9600 3500000

		choice ESP_HOSTED_OT_HOST_UART_PRIV_NUM_DATA_BITS
			bool "Number of Data Bits"
			default ESP_HOSTED_OT_HOST_UART_PRIV_NUM_DATA_BITS_8

			config ESP_HOSTED_OT_HOST_UART_PRIV_NUM_DATA_BITS_5
				bool "5 Bits"
			config ESP_HOSTED_OT_HOST_UART_PRIV_NUM_DATA_BITS_6
				bool "6 Bits"
			config ESP_HOSTED_OT_HOST_UART_PRIV_NUM_DATA_BITS_7
				bool "7 Bits"
			config ESP_HOSTED_OT_HOST_UART_PRIV_NUM_DATA_BITS_8
				bool "8 Bits"
		endchoice

		config ESP_HOSTED_OT_HOST_UART_NUM_DATA_BITS
			int
			default 0 if ESP_HOSTED_OT_HOST_UART_PRIV_NUM_DATA_BITS_5
			default 1 if ESP_HOSTED_OT_HOST_UART_PRIV_NUM_DATA_BITS_6
			default 2 if ESP_HOSTED_OT_HOST_UART_PRIV_NUM_DATA_BITS_7
			default 3 if ESP_HOSTED_OT_HOST_UART_PRIV_NUM_DATA_BITS_8

		choice ESP_HOSTED_OT_HOST_UART_PRIV_PARITY
			bool "Parity"
			default ESP_HOSTED_OT_HOST_UART_PRIV_PARITY_NONE

			config ESP_HOSTED_OT_HOST_UART_PRIV_PARITY_NONE
				bool "None"
			config ESP_HOSTED_OT_HOST_UART_PRIV_PARITY_EVEN
				bool "Even"
			config ESP_HOSTED_OT_HOST_UART_PRIV_PARITY_ODD
				bool "Odd"
		endchoice

		config ESP_HOSTED_OT_HOST_UART_PARITY
			int
			default 0 if ESP_HOSTED_OT_HOST_UART_PRIV_PARITY_NONE
			default 2 if ESP_HOSTED_OT_HOST_UART_PRIV_PARITY_EVEN
			default 3 if ESP_HOSTED_OT_HOST_UART_PRIV_PARITY_ODD

		choice ESP_HOSTED_OT_HOST_UART_PRIV_STOP_BITS
			bool "Number of Stop Bits"
			default ESP_HOSTED_OT_HOST_UART_PRIV_STOP_BITS_1

			config ESP_HOSTED_OT_HOST_UART_PRIV_STOP_BITS_1
				bool "1"
			config ESP_HOSTED_OT_HOST_UART_PRIV_STOP_BITS_1_5
				bool "1.5"
			config ESP_HOSTED_OT_HOST_UART_PRIV_STOP_BITS_2
				bool "2"
		endchoice

		config ESP_HOSTED_OT_HOST_UART_STOP_BITS
			int
			default 1 if ESP_HOSTED_OT_HOST_UART_PRIV_STOP_BITS_1
			default 2 if ESP_HOSTED_OT_HOST_UART_PRIV_STOP_BITS_1_5
			default 3 if ESP_HOSTED_OT_HOST_UART_PRIV_STOP_BITS_2

	endif # ESP_HOSTED_OT_HOST_TRANSPORT_UART

endif # ESP_HOSTED_HOST_FEAT_OPENTHREAD

config ESP_HOSTED_HOST_FEAT_OPENTHREAD_READY
	bool
	default y if ESP_HOSTED_HOST_FEAT_OPENTHREAD && \
	             ESP_HOSTED_HOST_FEAT_RPC_READY && \
	             ESP_HOSTED_HOST_FEAT_RPC_EXT_V2_READY && \
	             OPENTHREAD_ENABLED

comment "⚠  Host OpenThread feature requires CONFIG_OPENTHREAD_ENABLED"
	depends on ESP_HOSTED_HOST_FEAT_OPENTHREAD && !OPENTHREAD_ENABLED
```

## host/features/eh_host_feat_peer_data/Kconfig.ext
```kconfig
menuconfig ESP_HOSTED_HOST_FEAT_PEER_DATA
	bool "Peer Data Transfer"
	default n
	depends on ESP_HOSTED_HOST && ESP_HOSTED_HOST_FEAT_RPC
	depends on ESP_HOSTED_HOST_FEAT_RPC_EXT_V2_READY
	help
	  Requires the MCU V1 RPC extension — Custom_RPC IDs only exist
	  in the Rpc proto family.  Linux-FG (CtrlMsg) support is deferred.

	  Exposes a typed-blob send/echo RPC and subscribes the
	  per-peer tx/rx status events from the CP side.

if ESP_HOSTED_HOST_FEAT_PEER_DATA

	config ESP_HOSTED_HOST_FEAT_PEER_DATA_AUTO_INIT
		bool "Auto-initialize Peer-Data feature at boot"
		default y
		depends on ESP_HOSTED_HOST_AUTO_FEAT_INIT
		help
		  When enabled, eh_host_feat_peer_data_init() runs during the
		  linker-section auto-init walk.

	config ESP_HOSTED_HOST_FEAT_PEER_DATA_MAX_CUSTOM_MSG_HANDLERS
		int "Maximum custom message handlers"
		range 1 32
		default 3
		help
		  Max concurrent custom RPC message handlers.

endif # ESP_HOSTED_HOST_FEAT_PEER_DATA

config ESP_HOSTED_HOST_FEAT_PEER_DATA_READY
	bool
	default y if ESP_HOSTED_HOST_FEAT_PEER_DATA && ESP_HOSTED_HOST_FEAT_RPC_READY && ESP_HOSTED_HOST_FEAT_RPC_EXT_V2_READY
```

## host/features/eh_host_feat_power_save/Kconfig.ext
```kconfig
menuconfig ESP_HOSTED_HOST_FEAT_POWER_SAVE
	bool "Allow host to power save"
	depends on SOC_LIGHT_SLEEP_SUPPORTED || (SOC_DEEP_SLEEP_SUPPORTED && (SOC_GPIO_SUPPORT_DEEPSLEEP_WAKEUP || SOC_GPIO_SUPPORT_HP_PERIPH_PD_SLEEP_WAKEUP))
	default n
	help
	  When the host enters power-save (light/deep sleep), this feature
	  notifies the CP via the bus_inform_slave_host_power_save_*
	  contract so the CP can adapt buffering / hold reset GPIO across
	  the host's sleep.

	  On Linux user-space the kmod owns the bus, so the start path is
	  a no-op (returns ESP_ERR_NOT_SUPPORTED).

if ESP_HOSTED_HOST_FEAT_POWER_SAVE

	config ESP_HOSTED_HOST_FEAT_POWER_SAVE_READY
		bool
		default y

	config ESP_HOSTED_HOST_FEAT_POWER_SAVE_AUTO_INIT
		bool "Auto-initialize Host Power Save feature at boot"
		default y
		depends on ESP_HOSTED_HOST_AUTO_FEAT_INIT
		help
		  When enabled, eh_host_power_save_init() runs during the
		  linker-section auto-init walk so the wakeup-reason capture
		  happens on first boot before any feature uses it.

	menuconfig ESP_HOSTED_HOST_FEAT_POWER_SAVE_DEEP_SLEEP_ALLOWED
		bool "Allow host to enter deep sleep. Slave will wakeup host using GPIO"
		depends on (SOC_GPIO_SUPPORT_DEEPSLEEP_WAKEUP || SOC_GPIO_SUPPORT_HP_PERIPH_PD_SLEEP_WAKEUP) && SOC_DEEP_SLEEP_SUPPORTED
		default y
		help
			Allow host to deep sleep for highest power saving. Only RTC memory and RTC GPIOs remain
			powered during deep sleep. Slave will wake up host using a GPIO when needed. Host must
			configure a valid RTC GPIO for wakeup. Deep sleep provides maximum power savings but has
			longer wakeup time compared to light sleep.

	if ESP_HOSTED_HOST_FEAT_POWER_SAVE_DEEP_SLEEP_ALLOWED

		config ESP_HOSTED_HOST_FEAT_POWER_SAVE_WAKEUP_GPIO_RANGE_MIN
			int
			default 6 if ESP_HOSTED_P4_DEV_BOARD_FUNC_BOARD && !ESP_HOSTED_HOST_TRANSPORT_BUS_SPI_HD
			default 4 if ESP_HOSTED_P4_DEV_BOARD_FUNC_BOARD && ESP_HOSTED_HOST_TRANSPORT_BUS_SPI_HD
			default 2 if ESP_HOSTED_P4_C5_CORE_BOARD
			default -1 if IDF_TARGET_ESP32P4
			default -1

		config ESP_HOSTED_HOST_FEAT_POWER_SAVE_WAKEUP_GPIO_RANGE_MAX
			int
			default 6 if ESP_HOSTED_P4_DEV_BOARD_FUNC_BOARD && !ESP_HOSTED_HOST_TRANSPORT_BUS_SPI_HD
			default 4 if ESP_HOSTED_P4_DEV_BOARD_FUNC_BOARD && ESP_HOSTED_HOST_TRANSPORT_BUS_SPI_HD
			default 2 if ESP_HOSTED_P4_C5_CORE_BOARD
			default 15 if IDF_TARGET_ESP32P4
			default 100

		config ESP_HOSTED_HOST_FEAT_POWER_SAVE_WAKEUP_GPIO
			int "Host in: Host Wakeup GPIO"
			default 5 if ESP_HOSTED_C2_C5_MODULE_SUB_BOARD
			default 6 if ESP_HOSTED_P4_DEV_BOARD_FUNC_BOARD && !ESP_HOSTED_HOST_TRANSPORT_BUS_SPI_HD
			default 4 if ESP_HOSTED_P4_DEV_BOARD_FUNC_BOARD && ESP_HOSTED_HOST_TRANSPORT_BUS_SPI_HD
			default -1 if (ESP_HOSTED_P4_C6_CORE_BOARD || ESP_HOSTED_P4_C61_CORE_BOARD || ESP32P4_EYE_C6_BOARD)
			default 6 if IDF_TARGET_ESP32P4 && ESP_HOSTED_CP_TARGET_ESP32C5 && !ESP_HOSTED_P4_C5_CORE_BOARD
			default 6 if IDF_TARGET_ESP32P4 && !ESP_HOSTED_CP_TARGET_ESP32C6 && !ESP_HOSTED_CP_TARGET_ESP32C5 && !ESP_HOSTED_CP_TARGET_ESP32C61
			default 1 if IDF_TARGET_ESP32C3
			default 2 if ESP_HOSTED_P4_C5_CORE_BOARD
			default -1 if (ESP_HOSTED_P4_DEV_BOARD_NONE || ESP_HOSTED_P4_C6_CORE_BOARD || ESP_HOSTED_P4_C61_CORE_BOARD)
			range ESP_HOSTED_HOST_FEAT_POWER_SAVE_WAKEUP_GPIO_RANGE_MIN ESP_HOSTED_HOST_FEAT_POWER_SAVE_WAKEUP_GPIO_RANGE_MAX
			help
				GPIO number to use for host wakeup from sleep.
				Set to -1 to disable GPIO wakeup.
				Only RTC GPIOs are supported for deep-sleep-wakeup.

		choice
			prompt "Host Wakeup GPIO Level"
			default ESP_HOSTED_HOST_FEAT_POWER_SAVE_WAKEUP_GPIO_LEVEL_HIGH

			config ESP_HOSTED_HOST_FEAT_POWER_SAVE_WAKEUP_GPIO_LEVEL_HIGH
				bool "High"
			config ESP_HOSTED_HOST_FEAT_POWER_SAVE_WAKEUP_GPIO_LEVEL_LOW
				bool "Low"
		endchoice

		config ESP_HOSTED_HOST_FEAT_POWER_SAVE_WAKEUP_GPIO_LEVEL
			int
			default 1 if ESP_HOSTED_HOST_FEAT_POWER_SAVE_WAKEUP_GPIO_LEVEL_HIGH
			default 0 if ESP_HOSTED_HOST_FEAT_POWER_SAVE_WAKEUP_GPIO_LEVEL_LOW
			help
				GPIO level to use for host wakeup from sleep.
				Set to 0 to use low level, set to 1 to use high level.

		# Config Validation
		if !ESP_HOSTED_HOST_TRANSPORT_BUS_SDIO && ESP_HOSTED_HOST_CP_RESET_STRATEGY_ONLY_IF_NECESSARY
			comment "Error: Invalid configuration. Slave reset is mandatory for non SDIO transports"
		endif

		if ESP_HOSTED_HOST_FEAT_POWER_SAVE_WAKEUP_GPIO = -1
			comment "Error: Host wake-up GPIO is mandatory"
		endif

		if ESP_HOSTED_HOST_CP_RESET_STRATEGY_ONLY_IF_NECESSARY && !ESP_HOSTED_HOST_TRANSPORT_RESTART_ON_FAILURE
			comment "Recommended: enable 'Restart host on runtime transport failure' if communication with slave fails"
		endif

	endif # ESP_HOSTED_HOST_FEAT_POWER_SAVE_DEEP_SLEEP_ALLOWED

endif # ESP_HOSTED_HOST_FEAT_POWER_SAVE
```

## host/features/eh_host_feat_rpc/Kconfig.ext
```kconfig
config ESP_HOSTED_HOST_FEAT_RPC
	bool
	default y
	depends on ESP_HOSTED_HOST

config ESP_HOSTED_HOST_FEAT_RPC_READY
	bool
	default y if ESP_HOSTED_HOST_FEAT_RPC

config ESP_HOSTED_HOST_RPC_READY_WAIT_MS
	int "RPC ready wait timeout (ms)"
	default 5000
	range 0 60000
	help
	  When an RPC API is called before RPC LL reaches READY, the LL
	  waits up to this timeout for readiness instead of failing
	  immediately. 0 disables waiting and preserves fail-fast behavior.
```
