## examples/mem_monitor/mcu_host/main/Kconfig.projbuild
```kconfig
menu "Example Configuration"

	config EH_USE_LEGACY_API
		bool "Use legacy esp_hosted_* compat-surface main"
		default n
		help
			Build the example from main/legacy/main.c (preserves the
			esp_hosted_* compat surface) instead of main/main.c (which
			uses native eh_host_* APIs).

	config EXAMPLE_MEM_MONITOR_QUERY_ONLY_ONCE
		bool "Query Memory Info only once"
		default n
		help
			Query the memory on the co-processor only once.

	if !EXAMPLE_MEM_MONITOR_QUERY_ONLY_ONCE

	config EXAMPLE_MEM_MONITOR_INTERVAL_SEC
		int "Memory Monitor Interval (in seconds)"
		default 10
		help
			Set the interval for doing memory checks on the co-processor.

	config EXAMPLE_MEM_MONITOR_REPORT_ALWAYS
		bool "Always send a memory report"
		default y
		help
			When enabled, the co-processor sends a memory report every interval.
			When disabled, the co-processor sends a memory report only when free
			memory drops below a configured threshold.

	config EXAMPLE_MEM_MONITOR_INTERNAL_DMA_THRESHOLD
		depends on !EXAMPLE_MEM_MONITOR_REPORT_ALWAYS
		int "Threshold for internal DMA Heap Memory (in bytes)"
		default 8192
		help
			Memory threshold that triggers a report. 0 disables the threshold.

	config EXAMPLE_MEM_MONITOR_INTERNAL_8BIT_THRESHOLD
		depends on !EXAMPLE_MEM_MONITOR_REPORT_ALWAYS
		int "Threshold for internal 8-Bit Heap Memory (in bytes)"
		default 8192
		help
			Memory threshold that triggers a report. 0 disables the threshold.

	config EXAMPLE_MEM_MONITOR_EXTERNAL_DMA_THRESHOLD
		depends on !EXAMPLE_MEM_MONITOR_REPORT_ALWAYS
		int "Threshold for external DMA Heap Memory (in bytes)"
		default 8192
		help
			Memory threshold that triggers a report. 0 disables the threshold.

	config EXAMPLE_MEM_MONITOR_EXTERNAL_8BIT_THRESHOLD
		depends on !EXAMPLE_MEM_MONITOR_REPORT_ALWAYS
		int "Threshold for external 8-Bit Heap Memory (in bytes)"
		default 8192
		help
			Memory threshold that triggers a report. 0 disables the threshold.

	endif

	menu "Wifi Config"

		config ESP_WIFI_SSID
			string "WiFi SSID"
			default "myssid"
			help
				SSID (network name) for the example to connect to.

		config ESP_WIFI_PASSWORD
			string "WiFi Password"
			default "mypassword"
			help
				WiFi password (WPA or WPA2) for the example to use.

		choice ESP_WIFI_SAE_MODE
			prompt "WPA3 SAE mode selection"
			default ESP_STATION_EXAMPLE_WPA3_SAE_PWE_BOTH
			help
				Select mode for SAE as Hunt and Peck, H2E or both.
			config ESP_STATION_EXAMPLE_WPA3_SAE_PWE_HUNT_AND_PECK
				bool "HUNT AND PECK"
			config ESP_STATION_EXAMPLE_WPA3_SAE_PWE_HASH_TO_ELEMENT
				bool "H2E"
				depends on ESP_WIFI_ENABLE_SAE_H2E
			config ESP_STATION_EXAMPLE_WPA3_SAE_PWE_BOTH
				bool "BOTH"
				depends on ESP_WIFI_ENABLE_SAE_H2E
		endchoice

		config ESP_WIFI_PW_ID
			string "PASSWORD IDENTIFIER"
			depends on ESP_STATION_EXAMPLE_WPA3_SAE_PWE_HASH_TO_ELEMENT|| ESP_STATION_EXAMPLE_WPA3_SAE_PWE_BOTH
			default ""
			help
				Password identifier for SAE H2E.

		config ESP_MAXIMUM_RETRY
			int "Maximum retry"
			default 5
			help
				Maximum retry to avoid the station reconnecting unlimited
				when the AP is unreachable.

		choice ESP_WIFI_SCAN_AUTH_MODE_THRESHOLD
			prompt "WiFi Scan auth mode threshold"
			default ESP_WIFI_AUTH_WPA2_PSK
			help
				The weakest authmode to accept in scan mode.

			config ESP_WIFI_AUTH_OPEN
				bool "OPEN"
			config ESP_WIFI_AUTH_WEP
				bool "WEP"
			config ESP_WIFI_AUTH_WPA_PSK
				bool "WPA PSK"
			config ESP_WIFI_AUTH_WPA2_PSK
				bool "WPA2 PSK"
			config ESP_WIFI_AUTH_WPA_WPA2_PSK
				bool "WPA/WPA2 PSK"
			config ESP_WIFI_AUTH_WPA3_PSK
				bool "WPA3 PSK"
			config ESP_WIFI_AUTH_WPA2_WPA3_PSK
				bool "WPA2/WPA3 PSK"
			config ESP_WIFI_AUTH_WAPI_PSK
				bool "WAPI PSK"
		endchoice
	endmenu
endmenu
```

## examples/mem_monitor/mcu_host/sdkconfig.defaults
```kconfig
# SPDX-License-Identifier: Apache-2.0

# Role/runtime
CONFIG_ESP_HOSTED=y

# Minimal hosted feature set for mem_monitor scenario
CONFIG_ESP_HOSTED_HOST_FEAT_RPC=y
CONFIG_ESP_HOSTED_HOST_FEAT_RPC_EXT_V2=y
CONFIG_ESP_HOSTED_HOST_FEAT_SYSTEM=y
CONFIG_ESP_HOSTED_HOST_FEAT_WIFI=y
CONFIG_ESP_HOSTED_HOST_FEAT_MEM_MONITOR=y
CONFIG_ESP_WIFI_REMOTE_LIBRARY_HOSTED=y
CONFIG_SLAVE_IDF_TARGET_ESP32C6=y

# System
CONFIG_FREERTOS_HZ=1000
```

## examples/network_split/iperf/mcu_host/main/Kconfig.projbuild
```kconfig
menu "ESP-Hosted Example Config"
	config EXAMPLE_NW_SPLIT_ECHO_SERVER
		bool "Run a TCP echo server on the host stack (network-split routing test)"
		default n
		help
			Start a TCP echo server on the host stack at ECHO_PORT (a host
			port-range port). A client reaching it proves the 802.3 split routed
			that port class to the host; CP-local ports go to the coprocessor.
			Off by default — enabled by the network-split routing test.

	config EXAMPLE_NW_SPLIT_ECHO_PORT
		int "Host echo server TCP port"
		depends on EXAMPLE_NW_SPLIT_ECHO_SERVER
		default 49999
		help
			Must lie in the host port range (49152-61439) so the split routes it
			to the host stack.

	menu "Example to run"
		depends on ESP_HOSTED_CP_EXT_NW_SPLIT

		config ESP_HOSTED_CP_EXAMPLE_MQTT_CLIENT
			bool "MQTT client example"
			default n

		menu "MQTT client config"
			depends on ESP_HOSTED_CP_EXAMPLE_MQTT_CLIENT

			choice BROKER_CHOICE
				prompt "MQTT Broker"
				default BROKER_HIVEMQ

				config BROKER_ECLIPSEPROJECTS
					bool "mqtt.eclipseprojects.io"
				config BROKER_HIVEMQ
					bool "broker.hivemq.com"
			endchoice

			config BROKER_URL
				string
				default "mqtt://mqtt.eclipseprojects.io" if BROKER_ECLIPSEPROJECTS
				default "mqtt://broker.hivemq.com" if BROKER_HIVEMQ
				help
					URL of the broker to connect to

			config BROKER_URL_FROM_STDIN
				bool
				default y if BROKER_URL = "FROM_STDIN"

		endmenu

		config ESP_HOSTED_CP_EXAMPLE_HTTP_CLIENT
			bool "HTTP client example"
			default n

		menu "HTTP client config"
			depends on ESP_HOSTED_CP_EXAMPLE_HTTP_CLIENT

			config HTTP_WEBSERVER
				string "HTTP webserver to send req"
				default "example.com"

			config HTTP_WEBSERVER_PORT
				string "HTTP webserver port"
				default "80"

			config HTTP_WEBSERVER_PATH
				string "HTTP webserver path"
				default "/"

			config HTTP_REQ_DELAY
				int "Delay after every http request (seconds)"
				default 10

		endmenu
	endmenu
endmenu
```

## examples/network_split/station/linux_802_3_host/py_app/main/Kconfig.projbuild
```kconfig
menu "Example Connection Configuration"

    config EH_EXAMPLE_WIFI_SSID
        string "WiFi SSID"
        default "myssid"

    config EH_EXAMPLE_WIFI_PASSWORD
        string "WiFi Password"
        default "mypassword"

    config EH_EXAMPLE_WIFI_MAXIMUM_RETRY
        int "Maximum retry"
        default 6

    choice EH_EXAMPLE_WIFI_BAND
        prompt "WiFi band (dual-band CP, e.g. ESP32-C5)"
        default EH_EXAMPLE_WIFI_BAND_2G
        help
            Only applies to a dual-band CP (SLAVE_SOC_WIFI_SUPPORT_5G). 2G is the
            most reliable for a 2.4 GHz AP; AUTO scans both bands but is slow and
            can stall on the C5; 5G for a 5 GHz AP. A single-band CP (e.g. C6)
            ignores this.
        config EH_EXAMPLE_WIFI_BAND_2G
            bool "2.4 GHz only"
        config EH_EXAMPLE_WIFI_BAND_5G
            bool "5 GHz only"
        config EH_EXAMPLE_WIFI_BAND_AUTO
            bool "Auto (2.4 + 5 GHz)"
    endchoice

endmenu
```

## examples/network_split/station/mcu_host/main/Kconfig.projbuild
```kconfig
menu "Example WiFi Configuration"
    comment "Wi-Fi SSID/auth/SAE config is in esp_hosted_examples_common (EH_EXAMPLE_WIFI_*)"
endmenu
```

## examples/network_split/station/mcu_host/sdkconfig.defaults
```kconfig
CONFIG_ESP_WIFI_SOFTAP_SUPPORT=n

CONFIG_EH_EXAMPLE_WIFI_SSID="myssid"
CONFIG_EH_EXAMPLE_WIFI_PASSWORD="mypassword"
CONFIG_EH_EXAMPLE_WIFI_MAXIMUM_RETRY=6
CONFIG_EH_EXAMPLE_WIFI_AUTH_WPA2_PSK=y

# OTA partition layout
CONFIG_ESPTOOLPY_FLASHSIZE_4MB=y
CONFIG_PARTITION_TABLE_CUSTOM=y
CONFIG_PARTITION_TABLE_CUSTOM_FILENAME="partitions_eh_cp_ota_4m.csv"

CONFIG_FREERTOS_HZ=1000
CONFIG_ESP_WIFI_NVS_ENABLED=y
CONFIG_COMPILER_OPTIMIZATION_PERF=y

# Throughput / latency hardening (matches upstream host_network_split__power_save)
CONFIG_FREERTOS_UNICORE=n
CONFIG_ESP_INT_WDT=n
CONFIG_ESP_TASK_WDT_EN=n
CONFIG_LWIP_IRAM_OPTIMIZATION=y
CONFIG_LWIP_TCPIP_TASK_PRIO=23

CONFIG_ESP_HOSTED=y
CONFIG_ESP_HOSTED_HOST_FEAT_RPC=y
CONFIG_ESP_HOSTED_HOST_FEAT_RPC_EXT_V2=y
CONFIG_ESP_HOSTED_HOST_FEAT_SYSTEM=y
CONFIG_ESP_HOSTED_HOST_FEAT_WIFI=y
CONFIG_ESP_HOSTED_HOST_FEAT_NW_SPLIT=y
CONFIG_ESP_WIFI_REMOTE_LIBRARY_HOSTED=y
```

## examples/ota/coprocessor_ota/mcu_host/main/Kconfig.projbuild
```kconfig
menu "ESP-Hosted Coprocessor OTA Config"

choice OTA_METHOD
    prompt "Select OTA Method"
    default OTA_METHOD_HTTPS
    help
        Choose the OTA method for updating slave firmware.

config OTA_METHOD_HTTPS
    bool "HTTP OTA"
    help
        Download firmware from HTTPS URL

config OTA_METHOD_LITTLEFS
    bool "LittleFS OTA"
    help
        Read firmware from LittleFS filesystem

config OTA_METHOD_PARTITION
    bool "Partition OTA"
    help
        Read firmware from dedicated partition

endchoice

########### OTA with Partition ########
config OTA_PARTITION_LABEL
    string "Partition Label"
    depends on OTA_METHOD_PARTITION
    default "slave_fw"
    help
        Label of the partition containing firmware

########### OTA with Littlefs #########
config OTA_DELETE_FILE_AFTER_FLASH
    depends on OTA_METHOD_LITTLEFS
    bool "Delete OTA file from LittleFS/FatFS etc, once finished"
    default y

########### OTA with HTTPS ############
menu "WiFi Connection"
    depends on OTA_METHOD_HTTPS
    config ESP_WIFI_SSID
        string "WiFi SSID"
        default "MyWiFiSSID"
        help
            SSID (network name) for the example to connect to.

    config ESP_WIFI_PASSWORD
        string "WiFi Password"
        default "MyWiFiPass@123"
        help
            WiFi password (WPA or WPA2) for the example to use.

    config ESP_MAXIMUM_RETRY
        int "Maximum retry"
        default 5
        help
            Set the Maximum retry to avoid station reconnecting to the AP unlimited when the AP is really inexistent.

endmenu

menu "HTTPS OTA Configuration"
    depends on OTA_METHOD_HTTPS

    config OTA_USE_SELF_SIGNED_CERT
        bool "Use self-signed certificate (Testing Only)"
        default n
        help
            Enable this ONLY for testing with self-signed certificates.
            Disable for production use with CA-signed certificates.

            When enabled, the component will use an embedded certificate
            from certs/server_cert.pem for HTTPS validation.

            When disabled, the component will use the ESP32 CA certificate
            bundle which supports major CAs like Let's Encrypt, DigiCert, etc.

    config OTA_SKIP_CERT_CN_CHECK
        bool "Skip certificate Common Name check"
        depends on OTA_USE_SELF_SIGNED_CERT
        default n
        help
            Skip Common Name validation in self-signed certificates.
            Only enable if you cannot match the CN with your server IP/hostname.

            WARNING: This reduces security. Use only for testing.

    config OTA_HTTPS_TIMEOUT_MS
        int "HTTPS connection timeout (milliseconds)"
        default 30000
        range 5000 120000
        help
            Timeout for HTTPS connection and SSL handshake.
            Increase if you have slow network or server.

    config OTA_SERVER_URL
        string "OTA Server URL"
        default "https://192.168.1.3:8443/firmware.bin"
        help
            HTTPS URL of the OTA firmware file.
            Must start with https://

endmenu

########### OTA Verification Options ############
menu "OTA Verification Options"

    config OTA_VERSION_CHECK_HOST_SLAVE
        bool "Host-Slave version compatibility check"
        default y
        help
            Check if host and slave firmware have compatible major.minor versions.
            If host is X.Y.Z and slave is A.B.C, warn if X.Y != A.B.

            This ensures compatible API versions between host and slave.

    config OTA_VERSION_CHECK_SLAVEFW_SLAVE
        bool "Skip OTA if slave firmware versions match"
        default y
        help
            Compare current running slave firmware version with new firmware version.
            Skip OTA if versions are identical to avoid unnecessary updates.

            Disable this to force OTA even when versions match.

endmenu

config EH_USE_LEGACY_API
    bool "Use legacy esp_hosted_* compat-surface main"
    default n
    help
        Build the example from main/legacy/main.c (preserves the
        esp_hosted_* compat surface) instead of main/main.c (which
        uses native eh_host_* APIs).

endmenu
```

## examples/power_save/cp/shut_down_cp_when_unused/mcu_host/main/Kconfig.projbuild
```kconfig
menu "Example Configuration"

    config ESP_WIFI_SSID
        string "WiFi SSID"
        default "myssid"
        help
            SSID (network name) for the example to connect to.

    config ESP_WIFI_PASSWORD
        string "WiFi Password"
        default "mypassword"
        help
            WiFi password (WPA or WPA2) for the example to use.

    config ESP_MAXIMUM_RETRY
        int "Maximum retry"
        default 5
        help
            Set the Maximum retry to avoid station reconnecting to the AP unlimited
            when the AP is really inexistent.

    config EH_USE_LEGACY_API
        bool "Use legacy esp_hosted_* compat-surface main"
        default n
        help
            Build the example from main/legacy/main.c (preserves the
            esp_hosted_* compat surface) instead of main/main.c (which
            uses native eh_host_* APIs).

endmenu
```

## examples/power_save/cp/shut_down_cp_when_unused/mcu_host/sdkconfig.defaults
```kconfig
CONFIG_ESP_HOSTED=y
CONFIG_ESP_HOSTED_HOST_FEAT_RPC=y
CONFIG_ESP_HOSTED_HOST_FEAT_RPC_EXT_V2=y
CONFIG_ESP_HOSTED_HOST_FEAT_SYSTEM=y

CONFIG_ESP_HOSTED_HOST_FEAT_WIFI=y
CONFIG_ESP_HOSTED_HOST_FEAT_POWER_SAVE=y

CONFIG_ESP_WIFI_SSID="myssid"
CONFIG_ESP_WIFI_PASSWORD="mypassword"

# Heap tracing (optional)
CONFIG_PARTITION_TABLE_OFFSET=0x10000
CONFIG_HEAP_TRACING_STANDALONE=y
CONFIG_HEAP_TRACING=y
CONFIG_HEAP_TRACING_STACK_DEPTH=10
CONFIG_ESP_SYSTEM_USE_FRAME_POINTER=y

CONFIG_FREERTOS_HZ=1000
```
