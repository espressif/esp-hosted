## modules/coprocessor/eh_cp_transport/Kconfig.cp.sdio
```kconfig
menu "SDIO Configuration"
	depends on EH_TRANSPORT_CP_SDIO

	config EH_TRANSPORT_CP_SDIO_STREAMING_MODE
		bool "Enable SDIO Streaming Mode"
		default n if ESP_HOSTED_CP_FOR_LINUX
		default y if ESP_HOSTED_CP_FOR_MCU
		help
			Enable Streaming Mode. Host to receive queued data from slave
			as one stream instead of individual packets. This can improve
			host SDIO read performance by doing one large read transaction
			instead of many smaller read transactions.

	config EH_TRANSPORT_CP_SDIO_CHECKSUM
		bool "Enable SDIO checksum"
		default n
		help
			ENABLE/DISABLE software SDIO checksum

	config EH_TRANSPORT_CP_SDIO_GPIO_RESET
		int "Slave GPIO pin to reset itself"
		default -1
		help
			Host uses this pin to reset the slave ESP. To re-use ESP 'RST' or 'EN' GPIO, set value to -1


	choice EH_TRANSPORT_CP_SDIO_SPEED
		prompt "SDIO Bus Speed"
		default EH_TRANSPORT_CP_SDIO_HIGH_SPEED
		help
			Select the SDIO Slave Bus Speed. Actual speed in use depends on SDIO bus speed the SDIO Master can support

		config EH_TRANSPORT_CP_SDIO_DEFAULT_SPEED
			bool "Default Speed"

		config EH_TRANSPORT_CP_SDIO_HIGH_SPEED
			bool "High Speed"
	endchoice

	menu "Hosted SDIO GPIOs"
		config EH_TRANSPORT_CP_SDIO_PIN_CMD
			int "CMD GPIO number"
			range 15 15 if IDF_TARGET_ESP32
			range 18 18 if IDF_TARGET_ESP32C6
			range 25 25 if IDF_TARGET_ESP32C61
			range 10 10 if IDF_TARGET_ESP32C5
			default 15 if IDF_TARGET_ESP32
			default 18 if IDF_TARGET_ESP32C6
			default 25 if IDF_TARGET_ESP32C61
			default 10 if IDF_TARGET_ESP32C5
			help
				Value cannot be configured. Displayed for reference.

		config EH_TRANSPORT_CP_SDIO_PIN_CLK
			int "CLK GPIO number"
			range 14 14 if IDF_TARGET_ESP32
			range 19 19 if IDF_TARGET_ESP32C6
			range 26 26 if IDF_TARGET_ESP32C61
			range 9 9 if IDF_TARGET_ESP32C5
			default 14 if IDF_TARGET_ESP32
			default 19 if IDF_TARGET_ESP32C6
			default 26 if IDF_TARGET_ESP32C61
			default 9 if IDF_TARGET_ESP32C5
			help
				Value cannot be configured. Displayed for reference.

		config EH_TRANSPORT_CP_SDIO_PIN_D0
			int "D0 GPIO number"
			range 2 2 if IDF_TARGET_ESP32
			range 20 20 if IDF_TARGET_ESP32C6
			range 27 27 if IDF_TARGET_ESP32C61
			range 8 8 if IDF_TARGET_ESP32C5
			default 2 if IDF_TARGET_ESP32
			default 20 if IDF_TARGET_ESP32C6
			default 27 if IDF_TARGET_ESP32C61
			default 8 if IDF_TARGET_ESP32C5
			help
				Value cannot be configured. Displayed for reference.

		config EH_TRANSPORT_CP_SDIO_PIN_D1
			int "D1 GPIO number"
			range 4 4 if IDF_TARGET_ESP32
			range 21 21 if IDF_TARGET_ESP32C6
			range 28 28 if IDF_TARGET_ESP32C61
			range 7 7 if IDF_TARGET_ESP32C5
			default 4 if IDF_TARGET_ESP32
			default 21 if IDF_TARGET_ESP32C6
			default 28 if IDF_TARGET_ESP32C61
			default 7 if IDF_TARGET_ESP32C5
			help
				Value cannot be configured. Displayed for reference.

		config EH_TRANSPORT_CP_SDIO_PIN_D2
			int "D2 GPIO number"
			range 12 12 if IDF_TARGET_ESP32
			range 22 22 if IDF_TARGET_ESP32C6
			range 22 22 if IDF_TARGET_ESP32C61
			range 14 14 if IDF_TARGET_ESP32C5
			default 12 if IDF_TARGET_ESP32
			default 22 if IDF_TARGET_ESP32C6
			default 22 if IDF_TARGET_ESP32C61
			default 14 if IDF_TARGET_ESP32C5
			help
				Value cannot be configured. Displayed for reference.

		config EH_TRANSPORT_CP_SDIO_PIN_D3
			int "D3 GPIO number"
			range 13 13 if IDF_TARGET_ESP32
			range 23 23 if IDF_TARGET_ESP32C6
			range 23 23 if IDF_TARGET_ESP32C61
			range 13 13 if IDF_TARGET_ESP32C5
			default 13 if IDF_TARGET_ESP32
			default 23 if IDF_TARGET_ESP32C6
			default 23 if IDF_TARGET_ESP32C61
			default 13 if IDF_TARGET_ESP32C5
			help
				Value cannot be configured. Displayed for reference.
	endmenu

	choice EH_TRANSPORT_CP_SDIO_TIMING
		prompt "SDIO Slave Timing"
		default EH_TRANSPORT_CP_SDIO_NSEND_PSAMPLE if IDF_TARGET_ESP32C6 && ESP_HOSTED_CP_FOR_LINUX
		default EH_TRANSPORT_CP_SDIO_PSEND_PSAMPLE
		help
			Select the SDIO timing used by slave. Default value works with most
			SDMMC controllers but if transfer errors are encountered, selecting a
			different timing may help resolve the errors.
			See https://docs.espressif.com/projects/esp-idf/en/latest/esp32/api-reference/peripherals/sdio_slave.html#_CPPv419sdio_slave_timing_t
			for more information

		config EH_TRANSPORT_CP_SDIO_PSEND_PSAMPLE
			bool "Send at positive edge, sample at positive edge"

		config EH_TRANSPORT_CP_SDIO_NSEND_PSAMPLE
			bool "Send at negative edge, sample at positive edge"

		config EH_TRANSPORT_CP_SDIO_PSEND_NSAMPLE
			bool "Send at positive edge, sample at negative edge"

		config EH_TRANSPORT_CP_SDIO_NSEND_NSAMPLE
			bool "Send at negative edge, sample at negative edge"
	endchoice

	config EH_TRANSPORT_CP_SDIO_TX_Q_SIZE
		int "SDIO TX queue size"
		default 10 if IDF_TARGET_ESP32C61
		default 20
		help
			Very small TX queue will lower ESP --> SDIO -- Host data rate

	config EH_TRANSPORT_CP_SDIO_RX_Q_SIZE
		int "SDIO RX queue size"
		default 10 if IDF_TARGET_ESP32C61
		default 20
		help
			Very small RX queue will lower ESP <-- SDIO -- Host data rate

endmenu
```

## modules/coprocessor/eh_cp_transport/Kconfig.cp.spi
```kconfig
menu "SPI Configuration"
	depends on EH_TRANSPORT_CP_SPI

	# High-level user configurations
	config EH_TRANSPORT_CP_SPI_CHECKSUM
		bool "Enable SPI checksum"
		default y
		help
			Enable/disable software SPI checksum for data integrity

	# Internal configurations with sensible defaults
	choice EH_TRANSPORT_CP_SPI_MODE
		bool "Slave SPI mode"
		default EH_TRANSPORT_CP_SPI_MODE_2 if IDF_TARGET_ESP32
		default EH_TRANSPORT_CP_SPI_MODE_3

		config EH_TRANSPORT_CP_SPI_MODE_0
			bool "Slave SPI mode 0"

		config EH_TRANSPORT_CP_SPI_MODE_1
			bool "Slave SPI mode 1"

		config EH_TRANSPORT_CP_SPI_MODE_2
			bool "Slave SPI mode 2"

		config EH_TRANSPORT_CP_SPI_MODE_3
			bool "Slave SPI mode 3"
	endchoice

	config EH_TRANSPORT_CP_SPI_MODE_VALUE
		int
		default 0 if EH_TRANSPORT_CP_SPI_MODE_0
		default 1 if EH_TRANSPORT_CP_SPI_MODE_1
		default 2 if EH_TRANSPORT_CP_SPI_MODE_2
		default 3 if EH_TRANSPORT_CP_SPI_MODE_3
		default 3

	choice EH_TRANSPORT_CP_SPI_CONTROLLER
		bool "SPI controller to use"
		default EH_TRANSPORT_CP_SPI_CONTROLLER_HSPI

		config EH_TRANSPORT_CP_SPI_CONTROLLER_HSPI
			bool "FSPI/HSPI"
			help
				HSPI/FSPI: SPI_controller_1

		config EH_TRANSPORT_CP_SPI_CONTROLLER_VSPI
			depends on IDF_TARGET_ESP32
			bool "VSPI"
			help
				VSPI: SPI_controller_2
	endchoice

	config EH_TRANSPORT_CP_SPI_CONTROLLER_NUM
		int
		default 2 if EH_TRANSPORT_CP_SPI_CONTROLLER_VSPI
		default 1

	menu "SPI GPIO Configuration"
		config EH_TRANSPORT_CP_SPI_HSPI_GPIO_MOSI
			depends on EH_TRANSPORT_CP_SPI_CONTROLLER_HSPI
			int "Slave GPIO pin for Host MOSI"
			default 20 if ESP_HOST_DEV_BOARD_P4_FUNC_BOARD
			default 13 if IDF_TARGET_ESP32
			default 11 if IDF_TARGET_ESP32S2 || IDF_TARGET_ESP32S3
			default 1 if IDF_TARGET_ESP32C5 && ESP_ESP32C5_SPI_RASPI_MATING_BOARD
			default 7

		config EH_TRANSPORT_CP_SPI_HSPI_GPIO_MISO
			depends on EH_TRANSPORT_CP_SPI_CONTROLLER_HSPI
			int "Slave GPIO pin for Host MISO"
			default 21 if ESP_HOST_DEV_BOARD_P4_FUNC_BOARD
			default 12 if IDF_TARGET_ESP32
			default 13 if IDF_TARGET_ESP32S2 || IDF_TARGET_ESP32S3
			default 6 if IDF_TARGET_ESP32C5 && ESP_ESP32C5_SPI_RASPI_MATING_BOARD
			default 2

		config EH_TRANSPORT_CP_SPI_HSPI_GPIO_CLK
			depends on EH_TRANSPORT_CP_SPI_CONTROLLER_HSPI
			int "Slave GPIO pin for Host CLK"
			default 19 if ESP_HOST_DEV_BOARD_P4_FUNC_BOARD
			default 3 if IDF_TARGET_ESP32C5 && ESP_HOSTED_CP_FOR_MCU
			default 0 if IDF_TARGET_ESP32C2 && C2_C5_MODULE_SUB_BOARD
			default 14 if IDF_TARGET_ESP32
			default 12 if IDF_TARGET_ESP32S2 || IDF_TARGET_ESP32S3
			default 27 if IDF_TARGET_ESP32C5 && ESP_ESP32C5_SPI_RASPI_MATING_BOARD
			default 6

		config EH_TRANSPORT_CP_SPI_HSPI_GPIO_CS
			depends on EH_TRANSPORT_CP_SPI_CONTROLLER_HSPI
			int "Slave GPIO pin for Host CS"
			default 18 if ESP_HOST_DEV_BOARD_P4_FUNC_BOARD
			default 15 if IDF_TARGET_ESP32
			default 10 if IDF_TARGET_ESP32S2 || IDF_TARGET_ESP32S3
			default 4 if IDF_TARGET_ESP32C5 && ESP_ESP32C5_SPI_RASPI_MATING_BOARD
			default 10

		config EH_TRANSPORT_CP_SPI_VSPI_GPIO_MOSI
			depends on EH_TRANSPORT_CP_SPI_CONTROLLER_VSPI
			int "Slave GPIO pin for Host MOSI"
			default 23

		config EH_TRANSPORT_CP_SPI_VSPI_GPIO_MISO
			depends on EH_TRANSPORT_CP_SPI_CONTROLLER_VSPI
			int "Slave GPIO pin for Host MISO"
			default 19

		config EH_TRANSPORT_CP_SPI_VSPI_GPIO_CLK
			depends on EH_TRANSPORT_CP_SPI_CONTROLLER_VSPI
			int "Slave GPIO pin for Host CLK"
			default 18

		config EH_TRANSPORT_CP_SPI_VSPI_GPIO_CS
			depends on EH_TRANSPORT_CP_SPI_CONTROLLER_VSPI
			int "Slave GPIO pin for Host CS"
			default 5

		config EH_TRANSPORT_CP_SPI_GPIO_MOSI
			int
			default EH_TRANSPORT_CP_SPI_VSPI_GPIO_MOSI if EH_TRANSPORT_CP_SPI_CONTROLLER_VSPI
			default EH_TRANSPORT_CP_SPI_HSPI_GPIO_MOSI

		config EH_TRANSPORT_CP_SPI_GPIO_MISO
			int
			default EH_TRANSPORT_CP_SPI_VSPI_GPIO_MISO if EH_TRANSPORT_CP_SPI_CONTROLLER_VSPI
			default EH_TRANSPORT_CP_SPI_HSPI_GPIO_MISO

		config EH_TRANSPORT_CP_SPI_GPIO_CLK
			int
			default EH_TRANSPORT_CP_SPI_VSPI_GPIO_CLK if EH_TRANSPORT_CP_SPI_CONTROLLER_VSPI
			default EH_TRANSPORT_CP_SPI_HSPI_GPIO_CLK

		config EH_TRANSPORT_CP_SPI_GPIO_CS
			int
			default EH_TRANSPORT_CP_SPI_VSPI_GPIO_CS if EH_TRANSPORT_CP_SPI_CONTROLLER_VSPI
			default EH_TRANSPORT_CP_SPI_HSPI_GPIO_CS

		config EH_TRANSPORT_CP_SPI_GPIO_HANDSHAKE
			int "Slave GPIO pin for handshake"
			default 22 if ESP_HOST_DEV_BOARD_P4_FUNC_BOARD
			default 18 if IDF_TARGET_ESP32C2 && C2_C5_MODULE_SUB_BOARD
			default 3 if IDF_TARGET_ESP32C2 && !C2_C5_MODULE_SUB_BOARD
			default 4 if IDF_TARGET_ESP32C5 && C2_C5_MODULE_SUB_BOARD
			default 1 if IDF_TARGET_ESP32C5 && !C2_C5_MODULE_SUB_BOARD
			default 25 if IDF_TARGET_ESP32C5 && ESP_ESP32C5_SPI_RASPI_MATING_BOARD
			default 3 if IDF_TARGET_ESP32C2 || IDF_TARGET_ESP32C3 || IDF_TARGET_ESP32C5 || IDF_TARGET_ESP32C6
			default 17 if IDF_TARGET_ESP32S3 || IDF_TARGET_ESP32S2
			default 2 if ESP_HOSTED_CP_FOR_LINUX
			default 26

		config EH_TRANSPORT_CP_SPI_GPIO_DATA_READY
			int "Slave GPIO pin for data ready interrupt"
			default 23 if ESP_HOST_DEV_BOARD_P4_FUNC_BOARD
			default 1 if IDF_TARGET_ESP32C2 && C2_C5_MODULE_SUB_BOARD
			default 4 if IDF_TARGET_ESP32C2 && !C2_C5_MODULE_SUB_BOARD
			default 0 if IDF_TARGET_ESP32C5 && C2_C5_MODULE_SUB_BOARD
			default 4 if IDF_TARGET_ESP32C5 && !C2_C5_MODULE_SUB_BOARD && ESP_HOSTED_CP_FOR_MCU
			default 2 if IDF_TARGET_ESP32C5 && ESP_ESP32C5_SPI_RASPI_MATING_BOARD
			default 4

		config EH_TRANSPORT_CP_SPI_GPIO_RESET
			int "Slave GPIO pin to reset itself"
			default -1

	endmenu

	config EH_TRANSPORT_CP_SPI_DEASSERT_HS_ON_CS
		bool "Deassert Handshake when SPI CS is deasserted"
		default n if IDF_TARGET_ESP32 && ESP_HOSTED_CP_FOR_LINUX
		default y if ESP_HOSTED_CP_FOR_MCU
		default y

	config EH_TRANSPORT_CP_SPI_TX_Q_SIZE
		int "ESP to Host SPI queue size"
		default 10 if IDF_TARGET_ESP32
		default 6 if IDF_TARGET_ESP32C2 && BT_ENABLED
		default 10 if IDF_TARGET_ESP32C2
		default 20

	config EH_TRANSPORT_CP_SPI_RX_Q_SIZE
		int "Host to ESP SPI queue size"
		default 10 if IDF_TARGET_ESP32
		default 6 if IDF_TARGET_ESP32C2 && BT_ENABLED
		default 7 if IDF_TARGET_ESP32C2
		default 20

endmenu
```

## modules/coprocessor/eh_cp_transport/Kconfig.cp.spi_hd
```kconfig
menu "SPI Half-duplex Configuration"
	depends on EH_TRANSPORT_CP_SPI_HD

	choice EH_TRANSPORT_CP_SPI_HD_MODE
		bool "Slave SPI mode"
		default EH_TRANSPORT_CP_SPI_HD_MODE_3

		config EH_TRANSPORT_CP_SPI_HD_MODE_0
			bool "Slave SPI mode 0"

		config EH_TRANSPORT_CP_SPI_HD_MODE_1
			bool "Slave SPI mode 1"

		config EH_TRANSPORT_CP_SPI_HD_MODE_2
			bool "Slave SPI mode 2"

		config EH_TRANSPORT_CP_SPI_HD_MODE_3
			bool "Slave SPI mode 3"
	endchoice

	config EH_TRANSPORT_CP_SPI_HD_MODE_VALUE
		int
		default 0 if EH_TRANSPORT_CP_SPI_HD_MODE_0
		default 1 if EH_TRANSPORT_CP_SPI_HD_MODE_1
		default 2 if EH_TRANSPORT_CP_SPI_HD_MODE_2
		default 3 if EH_TRANSPORT_CP_SPI_HD_MODE_3

	choice EH_TRANSPORT_CP_SPI_HD_DATA_LINES
		bool "Number of Data Lines"
		default EH_TRANSPORT_CP_SPI_HD_4_DATA_LINES

		config EH_TRANSPORT_CP_SPI_HD_4_DATA_LINES
			bool "4 data lines"

		config EH_TRANSPORT_CP_SPI_HD_2_DATA_LINES
			bool "2 data lines"
	endchoice

	config EH_TRANSPORT_CP_SPI_HD_NUM_DATA_LINES
		int
		default 4 if EH_TRANSPORT_CP_SPI_HD_4_DATA_LINES
		default 2 if EH_TRANSPORT_CP_SPI_HD_2_DATA_LINES

	menu "SPI HD GPIO Configuration"
		config EH_TRANSPORT_CP_SPI_HD_GPIO_CS
			int "CS GPIO pin"
			default 18 if ESP_HOST_DEV_BOARD_P4_FUNC_BOARD
			default 10

		config EH_TRANSPORT_CP_SPI_HD_GPIO_CLK
			int "CLK GPIO pin"
			default 19 if ESP_HOST_DEV_BOARD_P4_FUNC_BOARD
			default 3 if IDF_TARGET_ESP32C5
			default 0 if IDF_TARGET_ESP32C2
			default 6

		config EH_TRANSPORT_CP_SPI_HD_GPIO_D0
			int "D0 GPIO pin"
			default 20 if ESP_HOST_DEV_BOARD_P4_FUNC_BOARD
			default 7

		config EH_TRANSPORT_CP_SPI_HD_GPIO_D1
			int "D1 GPIO pin"
			default 21 if ESP_HOST_DEV_BOARD_P4_FUNC_BOARD
			default 2

		config EH_TRANSPORT_CP_SPI_HD_GPIO_D2
			depends on EH_TRANSPORT_CP_SPI_HD_4_DATA_LINES
			int "D2 GPIO pin"
			default 22 if ESP_HOST_DEV_BOARD_P4_FUNC_BOARD
			default 5

		config EH_TRANSPORT_CP_SPI_HD_GPIO_D3
			depends on EH_TRANSPORT_CP_SPI_HD_4_DATA_LINES
			int "D3 GPIO pin"
			default 23 if ESP_HOST_DEV_BOARD_P4_FUNC_BOARD
			default 4

		config EH_TRANSPORT_CP_SPI_HD_GPIO_DATA_READY
			int "Data Ready GPIO pin"
			default 2 if ESP_HOST_DEV_BOARD_P4_FUNC_BOARD
			default 0 if IDF_TARGET_ESP32C5
			default 1 if IDF_TARGET_ESP32C2
			default 11

		choice EH_TRANSPORT_CP_SPI_HD_DR_ACTIVE
			bool "DataReady GPIO Active Level"
			default EH_TRANSPORT_CP_SPI_HD_DR_ACTIVE_HIGH

			config EH_TRANSPORT_CP_SPI_HD_DR_ACTIVE_HIGH
				bool "Active High"
			config EH_TRANSPORT_CP_SPI_HD_DR_ACTIVE_LOW
				bool "Active Low"
		endchoice

		config EH_TRANSPORT_CP_SPI_HD_GPIO_RESET
			int "Reset GPIO pin"
			default -1

	endmenu

	config EH_TRANSPORT_CP_SPI_HD_Q_SIZE
		int "Queue size"
		default 12 if IDF_TARGET_ESP32C2
		default 10 if IDF_TARGET_ESP32C5
		default 20

	config EH_TRANSPORT_CP_SPI_HD_CHECKSUM
		bool "Checksum ENABLE/DISABLE"
		default y

endmenu
```
