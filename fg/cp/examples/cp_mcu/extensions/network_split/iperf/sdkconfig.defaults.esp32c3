## modules/coprocessor/eh_cp_transport/Kconfig.cp.uart
```kconfig
menu "UART Configuration"
	depends on EH_TRANSPORT_CP_UART

	config EH_TRANSPORT_CP_UART_PORT
		int "UART Port to Use"
		default 1
		range 0 2 if IDF_TARGET_ESP32
		range 0 1 if IDF_TARGET_ESP32C2 || IDF_TARGET_ESP32C3 || IDF_TARGET_ESP32C5 || IDF_TARGET_ESP32C6
		range 0 2 if IDF_TARGET_ESP32C61
		range 0 1 if IDF_TARGET_ESP32S2
		range 0 2 if IDF_TARGET_ESP32S3

	config EH_TRANSPORT_CP_UART_PIN_TX
		int "TX GPIO number"
		default 13 if IDF_TARGET_ESP32
		default 5 if IDF_TARGET_ESP32C2 || IDF_TARGET_ESP32C3
		default 14 if IDF_TARGET_ESP32C5
		default 21 if IDF_TARGET_ESP32C6
		default 5 if IDF_TARGET_ESP32S2 || IDF_TARGET_ESP32S3

	config EH_TRANSPORT_CP_UART_PIN_RX
		int "RX GPIO number"
		default 12 if IDF_TARGET_ESP32
		default 4 if IDF_TARGET_ESP32C2 || IDF_TARGET_ESP32C3
		default 13 if IDF_TARGET_ESP32C5
		default 20 if IDF_TARGET_ESP32C6
		default 4 if IDF_TARGET_ESP32S2 || IDF_TARGET_ESP32S3

	config EH_TRANSPORT_CP_UART_BAUDRATE
		int "Baud Rate"
		default 921600
		range 9600 3500000

	config EH_TRANSPORT_CP_UART_NUM_DATA_BITS
		int "Number of Data Bits"
		default 8
		range 5 8

	choice EH_TRANSPORT_CP_UART_PARITY
		bool "Parity"
		default EH_TRANSPORT_CP_UART_PARITY_NONE

		config EH_TRANSPORT_CP_UART_PARITY_NONE
			bool "None"

		config EH_TRANSPORT_CP_UART_PARITY_EVEN
			bool "Even"

		config EH_TRANSPORT_CP_UART_PARITY_ODD
			bool "Odd"
	endchoice

	config EH_TRANSPORT_CP_UART_PARITY_VALUE
		int
		default 0 if EH_TRANSPORT_CP_UART_PARITY_NONE
		default 1 if EH_TRANSPORT_CP_UART_PARITY_EVEN
		default 2 if EH_TRANSPORT_CP_UART_PARITY_ODD

	choice EH_TRANSPORT_CP_UART_STOP_BITS
		bool "Number of Stop Bits"
		default EH_TRANSPORT_CP_UART_STOP_BITS_1

		config EH_TRANSPORT_CP_UART_STOP_BITS_1
			bool "1"

		config EH_TRANSPORT_CP_UART_STOP_BITS_1_5
			bool "1.5"

		config EH_TRANSPORT_CP_UART_STOP_BITS_2
			bool "2"
	endchoice

	config EH_TRANSPORT_CP_UART_STOP_BITS_VALUE
		int
		default 0 if EH_TRANSPORT_CP_UART_STOP_BITS_1
		default 1 if EH_TRANSPORT_CP_UART_STOP_BITS_1_5
		default 2 if EH_TRANSPORT_CP_UART_STOP_BITS_2

	config EH_TRANSPORT_CP_UART_GPIO_RESET
		int "Slave GPIO pin to reset itself"
		default -1

	config EH_TRANSPORT_CP_UART_TX_Q_SIZE
		int "Tx Queue Size"
		default 5

	config EH_TRANSPORT_CP_UART_RX_Q_SIZE
		int "Rx Queue Size"
		default 5

	config EH_TRANSPORT_CP_UART_CHECKSUM
		bool "UART checksum ENABLE/DISABLE"
		default y

endmenu
```

## modules/coprocessor/eh_cp_transport/Kconfig.ext
```kconfig
menu "CP transport"
	depends on ESP_HOSTED_CP

	choice EH_TRANSPORT_CP_INTERFACE
		depends on ESP_HOSTED_CP
		prompt "Communication bus (co-processor <== bus ==> host)"
		default EH_TRANSPORT_CP_SDIO if SOC_SDIO_SLAVE_SUPPORTED
		default EH_TRANSPORT_CP_SPI if SOC_GPSPI_SUPPORTED

	config EH_TRANSPORT_CP_SPI
		bool "SPI Full Duplex"
		depends on SOC_GPSPI_SUPPORTED

	config EH_TRANSPORT_CP_SDIO
		bool "SDIO"
		depends on SOC_SDIO_SLAVE_SUPPORTED

	config EH_TRANSPORT_CP_SPI_HD
		bool "SPI Half Duplex"
		depends on SOC_GPSPI_SUPPORTED && ESP_HOSTED_CP_FOR_MCU

	config EH_TRANSPORT_CP_UART
		bool "UART"
		depends on SOC_UART_SUPPORTED && ESP_HOSTED_CP_FOR_MCU
	endchoice

# Memory pool configuration
	config ESP_CACHE_MALLOC
		depends on ESP_HOSTED_CP
		bool "Enable Mempool"
		default n if IDF_TARGET_ESP32C2 && ESP_HOSTED_CP_FOR_LINUX
		default y if ESP_HOSTED_CP_FOR_MCU
		default y
		help
			Mempool will help to alloc buffer without going to heap for every memory allocation or free

# 	menu "ESP-Hosted-Transport-CP Debugging"
# 		config ESP_RAW_THROUGHPUT_TRANSPORT
# 			bool "RawTP: Transport level throughput debug test"
# 			default n
# 			help
# 				Find max transport performance which helps to assess stability of porting done
#
# 		config ESP_RAW_TP_ESP_TO_HOST_PKT_LEN
# 			depends on ESP_RAW_THROUGHPUT_TRANSPORT
# 			int "RawTP: ESP to Host packet size"
# 			range 1 1500
# 			default 1460
#
# 		config ESP_RAW_TP_REPORT_INTERVAL
# 			depends on ESP_RAW_THROUGHPUT_TRANSPORT
# 			int "RawTP: periodic duration to report stats accumulated"
# 			default 1 if ESP_HOSTED_CP_FOR_LINUX__802_03
# 			default 10 if ESP_HOSTED_CP_FOR_MCU
# 			default 1
#
# #		config ESP_PKT_STATS
# #			bool "Transport level packet stats"
# #			default n
# #			help
# #				On comparing with slave packet stats helps to understand any packet loss at hosted
# #
# #		config ESP_PKT_STATS_INTERVAL_SEC
# #			depends on ESP_PKT_STATS
# #			int "Packet stats reporting interval (sec)"
# #			default 30
# #
# #		config ESP_HOSTED_FUNCTION_PROFILING
# #			bool "Enable function execution time profiling"
# #			default n
# #			help
# #				Enable this option to measure and report function execution times.
# #				This is useful for performance profiling and optimization.
# #
# #		config ESP_HOSTED_FUNCTION_PROFILING_MAX_ENTRIES
# #			int "Maximum number of functions to profile"
# #			depends on ESP_HOSTED_FUNCTION_PROFILING
# #			default 10
# #			range 1 50
# #			help

orsource "./Kconfig.cp.spi"
orsource "./Kconfig.cp.sdio"
orsource "./Kconfig.cp.spi_hd"
orsource "./Kconfig.cp.uart"
endmenu
```

## modules/coprocessor/features/eh_cp_feat_bt/Kconfig.ext
```kconfig
menuconfig ESP_HOSTED_CP_FEAT_BT
    bool "Bluetooth"
    depends on ESP_HOSTED_CP
    default n
    help
        Enables Bluetooth feature on the coprocessor.

if ESP_HOSTED_CP_FEAT_BT

    comment "⚠️  Enable [✓] ESP_HOSTED_CP_BT_ENABLED (Component config → ESP-Hosted CP)"
        depends on !ESP_HOSTED_CP_BT_ENABLED

    choice ESP_HOSTED_CP_FEAT_BT_HCI_MODE
        prompt "BT HCI transport"
        depends on ESP_HOSTED_CP_BT_ENABLED
        default ESP_HOSTED_CP_FEAT_BT_HCI_VHCI
        help
            Select BT HCI transport mode for ESP-Hosted.

        config ESP_HOSTED_CP_FEAT_BT_HCI_VHCI
            bool "HCI over VHCI (SPI/SDIO/SPI-HD)"
            help
                BT HCI packets routed over the host transport interface.
                Requires IDF BT controller configured for VHCI mode.

        config ESP_HOSTED_CP_FEAT_BT_HCI_UART
            bool "HCI over UART"
            help
                BT HCI packets routed over a dedicated UART.
                Requires IDF BT controller configured for UART HCI mode.
    endchoice

    comment "⚠️  IDF BT controller not in VHCI mode — enable VHCI in Component config → Bluetooth → Controller"
        depends on ESP_HOSTED_CP_FEAT_BT_HCI_VHCI && !(BTDM_CONTROLLER_HCI_MODE_VHCI || BT_CTRL_HCI_MODE_VHCI || BT_LE_HCI_INTERFACE_USE_RAM)

    comment "⚠️  IDF BT controller not in UART mode — enable UART HCI in Component config → Bluetooth → Controller"
        depends on ESP_HOSTED_CP_FEAT_BT_HCI_UART && !(BT_HCI_UART_NO || BT_CTRL_HCI_MODE_UART_H4 || BT_LE_HCI_INTERFACE_USE_UART)

    config ESP_HOSTED_CP_FEAT_BT_HCI_VHCI_READY
        bool
        default y if ESP_HOSTED_CP_FEAT_BT_HCI_VHCI && (BTDM_CONTROLLER_HCI_MODE_VHCI || BT_CTRL_HCI_MODE_VHCI || BT_LE_HCI_INTERFACE_USE_RAM)

    config ESP_HOSTED_CP_FEAT_BT_HCI_UART_READY
        bool
        default y if ESP_HOSTED_CP_FEAT_BT_HCI_UART && (BT_HCI_UART_NO || BT_CTRL_HCI_MODE_UART_H4 || BT_LE_HCI_INTERFACE_USE_UART)

    config ESP_HOSTED_CP_FEAT_BT_AUTO_INIT
        bool "Auto-initialize Bluetooth at boot"
        default y
        depends on ESP_HOSTED_CP_AUTO_FEAT_INIT
        help
            When enabled, Bluetooth feature auto-initializes during eh_cp_init().
            Disable to manually call eh_cp_feat_bt_init().

endif # ESP_HOSTED_CP_FEAT_BT

config ESP_HOSTED_CP_FEAT_BT_READY
    bool
    default y if ESP_HOSTED_CP_FEAT_BT && ESP_HOSTED_CP_BT_ENABLED && (ESP_HOSTED_CP_FEAT_BT_HCI_VHCI_READY || ESP_HOSTED_CP_FEAT_BT_HCI_UART_READY)
```

## modules/coprocessor/features/eh_cp_feat_cli/Kconfig.ext
```kconfig
menuconfig ESP_HOSTED_CP_FEAT_CLI
	depends on ESP_HOSTED_CP && ESP_HOSTED_CP_FOR_MCU
	bool "CLI Shell"
	default y if ESP_HOSTED_CP_FEAT_HOST_PS
	default n if !ESP_HOSTED_CP_FEAT_HOST_PS
	help
		Enable CLI shell for debugging and control purposes.

if ESP_HOSTED_CP_FEAT_CLI

	config ESP_HOSTED_CP_FEAT_CLI_READY
		bool
		default y if ESP_HOSTED_CP_FOR_MCU

	config ESP_HOSTED_CP_CLI_NEW_INSTANCE
		bool "Create new instance & do not re-use existing session if any"
		default y

	config ESP_HOSTED_CP_FEAT_CLI_AUTO_INIT
	    bool "Auto-initialize CLI at boot"
	    default y
	    depends on ESP_HOSTED_CP_AUTO_FEAT_INIT
	    help
	        When enabled, CLI feature auto-initializes during eh_cp_init().
	        Disable to manually call eh_cp_feat_cli_init().

endif # ESP_HOSTED_CP_FEAT_CLI
```

## modules/coprocessor/features/eh_cp_feat_ext_coex/Kconfig.ext
```kconfig
config ESP_HOSTED_CP_FEAT_EXT_COEX
    bool "External Coexistence"
    depends on ESP_HOSTED_CP
    default n
    help
        Enables external coexistence GPIO wire-type configuration via RPC.

comment "⚠️  Requires CONFIG_ESP_COEX_EXTERNAL_COEXIST_ENABLE and BT disabled"
    depends on ESP_HOSTED_CP_FEAT_EXT_COEX && !ESP_COEX_EXTERNAL_COEXIST_ENABLE

config ESP_HOSTED_CP_FEAT_EXT_COEX_READY
    bool
    default y if ESP_HOSTED_CP_FEAT_EXT_COEX && ESP_COEX_EXTERNAL_COEXIST_ENABLE

config ESP_HOSTED_CP_FEAT_EXT_COEX_AUTO_INIT
    bool "Auto-initialize External Coexistence at boot"
    default y
    depends on ESP_HOSTED_CP_AUTO_FEAT_INIT
    help
        When enabled, External Coexistence feature auto-initializes during eh_cp_init().
        Disable to manually call eh_cp_feat_ext_coex_init().
```

## modules/coprocessor/features/eh_cp_feat_gpio_exp/Kconfig.ext
```kconfig
config ESP_HOSTED_CP_FEAT_GPIO_EXP
    bool "GPIO Expander"
    depends on ESP_HOSTED_CP
    default n
    help
        Enables remote GPIO control from the host via RPC.

config ESP_HOSTED_CP_FEAT_GPIO_EXP_READY
    bool
    default y if ESP_HOSTED_CP_FEAT_GPIO_EXP

config ESP_HOSTED_CP_FEAT_GPIO_EXP_AUTO_INIT
    bool "Auto-initialize GPIO Expander at boot"
    default y
    depends on ESP_HOSTED_CP_AUTO_FEAT_INIT
    help
        When enabled, GPIO Expander feature auto-initializes during eh_cp_init().
        Disable to manually call eh_cp_feat_gpio_exp_init().
```
