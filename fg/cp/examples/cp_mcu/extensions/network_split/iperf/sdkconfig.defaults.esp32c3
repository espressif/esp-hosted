## fg/cp/examples/cp_mcu/extensions/network_split/iperf/sdkconfig.defaults.esp32c3
```kconfig
# iperf config
#-------------

# Hosted config
#----------------
CONFIG_ESP_CACHE_MALLOC=y
#       --- Debugging ---
#CONFIG_ESP_HOSTED_FUNCTION_PROFILING=y
#CONFIG_ESP_PKT_STATS=y

#       --- Network split ---


# BLE disabled in this example by default
## BLE Config
##-----------
#CONFIG_BT_ENABLED=y
#CONFIG_BT_CONTROLLER_ONLY=y
#CONFIG_BT_BLUEDROID_ENABLED=
#CONFIG_BT_LE_SLEEP_ENABLE=y
#
##  --- (Opt 1) Hci over SPI/SDIO ---
##-----------------------
#CONFIG_BT_LE_HCI_INTERFACE_USE_RAM=y
#
##  --- (Opt 2) Hci over UART ---
##-------------------
## Enable below config, delete sdkconfig, build/ and rebuild
## CONFIG_BT_LE_HCI_INTERFACE_USE_UART=y


# Wifi config
#------------

CONFIG_ESP_WIFI_STATIC_RX_BUFFER_NUM=20
CONFIG_ESP_WIFI_DYNAMIC_RX_BUFFER_NUM=40
CONFIG_ESP_WIFI_DYNAMIC_TX_BUFFER_NUM=40
CONFIG_ESP_WIFI_AMPDU_TX_ENABLED=y
CONFIG_ESP_WIFI_TX_BA_WIN=32
CONFIG_ESP_WIFI_AMPDU_RX_ENABLED=y
CONFIG_ESP_WIFI_RX_BA_WIN=32


# Optimizations
#-------------------
#CONFIG_LWIP_EXTRA_IRAM_OPTIMIZATION=y
CONFIG_COMPILER_OPTIMIZATION_PERF=y
CONFIG_ESPTOOLPY_FLASHMODE_QIO=y
CONFIG_ESP_WIFI_RX_IRAM_OPT=y
CONFIG_ESP_WIFI_IRAM_OPT=y
CONFIG_ESP_DEFAULT_CPU_FREQ_MHZ_160=y
CONFIG_FREERTOS_PLACE_FUNCTIONS_INTO_FLASH=y
CONFIG_SPI_MASTER_ISR_IN_IRAM=n


# Partition Table
#--------------------
CONFIG_PARTITION_TABLE_CUSTOM=y
CONFIG_PARTITION_TABLE_CUSTOM_FILENAME="partitions_eh_cp_ota_4m.csv"
```

## fg/cp/examples/cp_mcu/extensions/network_split/station/main/Kconfig.projbuild
```kconfig
menu "Example WiFi Configuration"
    comment "Uses EXAMPLE_WIFI_* symbols from protocol_examples_common"
endmenu
```

## fg/cp/examples/cp_mcu/extensions/network_split/station/sdkconfig.defaults.esp32c5
```kconfig
# Hosted config
#---------------------
#       --- transport ---
# ESP_HOSTED_TRANSPORT_CP_SDIO_NSEND_PSAMPLE=y
CONFIG_ESP_HOSTED_TRANSPORT_CP_SDIO=y

# For SPI Full duplex C6 on ESP32-P4-Function-EV-Board, please uncomment below
#CONFIG_ESP_HOST_DEV_BOARD_P4_FUNC_BOARD=y
#CONFIG_ESP_HOSTED_TRANSPORT_CP_SPI=y

#       --- Memory ---
CONFIG_ESP_CACHE_MALLOC=y
#       --- Debugging ---
#CONFIG_ESP_HOSTED_FUNCTION_PROFILING=y
#CONFIG_ESP_PKT_STATS=y

#       --- Network split ---


# BLE disabled in this example by default
## BLE Config
##-----------
#CONFIG_BT_ENABLED=y
#CONFIG_BT_CONTROLLER_ONLY=y
#CONFIG_BT_BLUEDROID_ENABLED=
#CONFIG_BT_LE_SLEEP_ENABLE=y
#
##  --- (Opt 1) Hci over SPI/SDIO ---
##-----------------------
#CONFIG_BT_LE_HCI_INTERFACE_USE_RAM=y
#
##  --- (Opt 2) Hci over UART ---
##-------------------
## Enable below config, delete sdkconfig, build/ and rebuild
## CONFIG_BT_LE_HCI_INTERFACE_USE_UART=y

# Wifi config
#------------

CONFIG_ESP_WIFI_STATIC_RX_BUFFER_NUM=20
CONFIG_ESP_WIFI_DYNAMIC_RX_BUFFER_NUM=48
CONFIG_ESP_WIFI_DYNAMIC_TX_BUFFER_NUM=48
CONFIG_ESP_WIFI_AMPDU_TX_ENABLED=y
CONFIG_ESP_WIFI_TX_BA_WIN=32
CONFIG_ESP_WIFI_AMPDU_RX_ENABLED=y
CONFIG_ESP_WIFI_RX_BA_WIN=22

# LWIP config
#----------------
CONFIG_LWIP_TCP_SND_BUF_DEFAULT=7200
CONFIG_LWIP_TCP_WND_DEFAULT=11520
CONFIG_LWIP_TCP_RECVMBOX_SIZE=16
CONFIG_LWIP_UDP_RECVMBOX_SIZE=16
CONFIG_LWIP_TCPIP_RECVMBOX_SIZE=32
CONFIG_LWIP_TCP_SACK_OUT=y
CONFIG_LWIP_TCPIP_CORE_LOCKING=y
CONFIG_LWIP_TCPIP_CORE_LOCKING_INPUT=y

CONFIG_ESP_WIFI_ENABLE_WIFI_RX_STATS=n
CONFIG_ESP_WIFI_ENABLE_WIFI_TX_STATS=n

# Optimizations
#-------------------
CONFIG_LWIP_EXTRA_IRAM_OPTIMIZATION=n
CONFIG_COMPILER_OPTIMIZATION_PERF=y
CONFIG_ESPTOOLPY_FLASHMODE_QIO=y
CONFIG_ESPTOOLPY_FLASHFREQ_80M=y
CONFIG_ESP_WIFI_RX_IRAM_OPT=y
CONFIG_ESP_WIFI_IRAM_OPT=y
CONFIG_ESP_DEFAULT_CPU_FREQ_MHZ_240=y
CONFIG_FREERTOS_PLACE_FUNCTIONS_INTO_FLASH=y


# Partition Table
#--------------------
CONFIG_PARTITION_TABLE_CUSTOM=y
CONFIG_PARTITION_TABLE_CUSTOM_FILENAME="partitions_eh_cp_ota_4m.csv"
```

## fg/cp/examples/cp_mcu/extensions/network_split__host_power_save/sdkconfig.defaults.esp32c2
```kconfig
# C2 26 MHz XTAL chips
# C2 generally in MP has 26MHz.
# If your C2 has 40MHz, just comment below lines
#---------------------------------
CONFIG_SOC_XTAL_SUPPORT_26M=y
CONFIG_XTAL_FREQ_26=y
# Hosted config
#----------------
CONFIG_ESP_CACHE_MALLOC=y
CONFIG_ESP_DEFAULT_TASK_STACK_SIZE=2048
#       --- Debugging ---
#CONFIG_ESP_HOSTED_FUNCTION_PROFILING=y
#CONFIG_ESP_PKT_STATS=y

#       --- Network split ---


# BLE disabled in this example by default
## BLE Config
##-----------
#CONFIG_BT_ENABLED=y
#CONFIG_BT_CONTROLLER_ONLY=y
#CONFIG_BT_BLUEDROID_ENABLED=
#CONFIG_BT_LE_SLEEP_ENABLE=y
#
#  --- (Opt 1) Hci over SPI/SDIO ---
#CONFIG_BT_LE_HCI_INTERFACE_USE_RAM=y
#
#  --- (Opt 2) Hci over UART ---
##-------------------
## Enable below config, delete sdkconfig, build/ and rebuild
## CONFIG_BT_LE_HCI_INTERFACE_USE_UART=y

# Wifi config
#------------
CONFIG_ESP_WIFI_STATIC_RX_BUFFER_NUM=14
CONFIG_ESP_WIFI_DYNAMIC_RX_BUFFER_NUM=14
CONFIG_ESP_WIFI_DYNAMIC_TX_BUFFER_NUM=18
CONFIG_ESP_WIFI_AMPDU_TX_ENABLED=y
CONFIG_ESP_WIFI_TX_BA_WIN=16
CONFIG_ESP_WIFI_AMPDU_RX_ENABLED=y
CONFIG_ESP_WIFI_RX_BA_WIN=14


# Optimizations
#-------------------
CONFIG_COMPILER_OPTIMIZATION_SIZE=y
#CONFIG_COMPILER_OPTIMIZATION_PERF=y
CONFIG_ESPTOOLPY_FLASHMODE_QIO=y
CONFIG_ESP_WIFI_RX_IRAM_OPT=n
CONFIG_ESP_WIFI_IRAM_OPT=n
CONFIG_ESP_DEFAULT_CPU_FREQ_MHZ_120=y
CONFIG_FREERTOS_PLACE_FUNCTIONS_INTO_FLASH=y
CONFIG_FREERTOS_UNICORE=y


# Partition Table
#--------------------
CONFIG_PARTITION_TABLE_CUSTOM=y
CONFIG_PARTITION_TABLE_CUSTOM_FILENAME="partitions_eh_cp_ota_2m.csv"
CONFIG_ESPTOOLPY_FLASHSIZE_4MB=n
CONFIG_ESPTOOLPY_FLASHSIZE_2MB=y
```

## fg/cp/examples/cp_mcu/extensions/peer_data_transfer/sdkconfig.defaults
```kconfig
# Host Type Configuration - MCU Host
# CONFIG_ESP_HOSTED_CP_FOR_LINUX__802_03 is not set
CONFIG_ESP_HOSTED_CP_FOR_MCU=y
CONFIG_ESP_HOSTED_CP_RPC_V1_MCU=y

# BT Configuration
CONFIG_BT_ENABLED=n
# Wi-Fi and BT disabled for this example
CONFIG_ESP_WIFI_ENABLED=n
CONFIG_BT_ENABLED=n

# OTA
CONFIG_ESPTOOLPY_FLASHSIZE_4MB=y
CONFIG_PARTITION_TABLE_CUSTOM=y
CONFIG_PARTITION_TABLE_CUSTOM_FILENAME="partitions_eh_cp_ota_4m.csv"

# OS
CONFIG_FREERTOS_HZ=1000

# Feature
CONFIG_ESP_HOSTED_CP_FEAT_PEER_DATA_TRANSFER=y
```

## fg/cp/examples/cp_mcu/extensions/wifi_dpp/sdkconfig.defaults
```kconfig
# Host Type Configuration - MCU Host
CONFIG_ESP_HOSTED_CP_FOR_MCU=y
CONFIG_ESP_HOSTED_CP_RPC_V1_MCU=y

# WiFi + DPP extensions
CONFIG_ESP_HOSTED_CP_FEAT_WIFI=y
CONFIG_ESP_HOSTED_CP_FEAT_WIFI_EXT_DPP=y
CONFIG_ESP_WIFI_DPP_SUPPORT=y

# BT disabled
CONFIG_BT_ENABLED=n

# Flash layout — DPP pulls in wpa_supplicant DPP + mbedtls,
# exceeding 1 MB default app partition. Use single-app large (~3 MB).
CONFIG_ESPTOOLPY_FLASHSIZE_4MB=y
CONFIG_PARTITION_TABLE_CUSTOM=y
CONFIG_PARTITION_TABLE_CUSTOM_FILENAME="partitions_eh_cp_ota_4m.csv"

CONFIG_FREERTOS_HZ=1000
```

## fg/cp/examples/cp_mcu/extensions/wifi_enterprise/sdkconfig.defaults
```kconfig
# Host Type Configuration - MCU Host
CONFIG_ESP_HOSTED_CP_FOR_MCU=y
CONFIG_ESP_HOSTED_CP_RPC_V1_MCU=y

# WiFi + Enterprise extensions
CONFIG_ESP_HOSTED_CP_FEAT_WIFI=y
CONFIG_ESP_HOSTED_CP_FEAT_WIFI_EXT_ENT=y
CONFIG_ESP_WIFI_ENTERPRISE_SUPPORT=y

# BT disabled
CONFIG_BT_ENABLED=n

# Flash layout — WiFi Enterprise pulls in mbedtls + wpa_supplicant enterprise,
# exceeding 1 MB default app partition. Use single-app large layout (~3 MB app).
CONFIG_ESPTOOLPY_FLASHSIZE_4MB=y
CONFIG_PARTITION_TABLE_CUSTOM=y
CONFIG_PARTITION_TABLE_CUSTOM_FILENAME="partitions_eh_cp_ota_4m.csv"

# OS
CONFIG_FREERTOS_HZ=1000
```

## fg/cp/examples/cp_mcu/extensions/wifi_itwt/sdkconfig.defaults
```kconfig
# Host Type Configuration - MCU Host
CONFIG_ESP_HOSTED_CP_FOR_MCU=y
CONFIG_ESP_HOSTED_CP_RPC_V1_MCU=y

# WiFi + iTWT extensions
CONFIG_ESP_HOSTED_CP_FEAT_WIFI=y
CONFIG_ESP_HOSTED_CP_FEAT_WIFI_EXT_ITWT=y

# BT disabled
CONFIG_BT_ENABLED=n

# Power management for iTWT
CONFIG_PM_ENABLE=y
CONFIG_FREERTOS_USE_TICKLESS_IDLE=y
CONFIG_PM_SLP_IRAM_OPT=y
CONFIG_PM_RTOS_IDLE_OPT=y
CONFIG_PM_SLP_DISABLE_GPIO=y
CONFIG_ESP_WIFI_SLP_IRAM_OPT=y
CONFIG_ESP_DEFAULT_CPU_FREQ_MHZ_80=y

# OTA
CONFIG_ESPTOOLPY_FLASHSIZE_4MB=y
CONFIG_PARTITION_TABLE_CUSTOM=y
CONFIG_PARTITION_TABLE_CUSTOM_FILENAME="partitions_eh_cp_ota_4m.csv"

# OS
CONFIG_FREERTOS_HZ=1000
```

## fg/cp/examples/cp_mcu/minimal/bt/sdkconfig.defaults
```kconfig
# Host Type Configuration - MCU Host
CONFIG_ESP_HOSTED_CP_FOR_MCU=y
CONFIG_ESP_HOSTED_CP_RPC_V1_MCU=y

# BT Configuration
CONFIG_ESP_WIFI_ENABLED=n
CONFIG_BT_ENABLED=y
CONFIG_BT_CONTROLLER_ONLY=y

# OTA
CONFIG_ESPTOOLPY_FLASHSIZE_4MB=y
CONFIG_PARTITION_TABLE_CUSTOM=y
CONFIG_PARTITION_TABLE_CUSTOM_FILENAME="partitions_eh_cp_ota_4m.csv"

CONFIG_FREERTOS_HZ=1000

CONFIG_ESP_HOSTED_CP_FEAT_BT=y
```

## fg/host/components/eh_host_transport/Kconfig
```kconfig
menu "ESP Hosted Transport Host Configuration"

    choice ESP_HOSTED_HOST_PLATFORM
        prompt "Host Platform Type"
        default ESP_HOSTED_HOST_PLATFORM_MCU if IDF_TARGET
        help
            Select the host platform type for ESP-Hosted transport

        config ESP_HOSTED_HOST_PLATFORM_MCU
            bool "MCU Platform (ESP-IDF)"
            help
                Use MCU platform transport drivers (ESP32, etc. as host)

        config ESP_HOSTED_HOST_PLATFORM_LINUX
            bool "Linux Kernel Platform"
            help
                Use Linux kernel transport drivers (handled via Makefile)

    endchoice

    # MCU platform specific configurations
    if ESP_HOSTED_HOST_PLATFORM_MCU

        choice ESP_HOSTED_HOST_MCU_TRANSPORT
            prompt "MCU Transport Type"
            default ESP_HOSTED_HOST_MCU_TRANSPORT_SPI
            help
                Select transport interface for MCU host

            config ESP_HOSTED_HOST_MCU_TRANSPORT_SPI
                bool "SPI Transport"

            config ESP_HOSTED_HOST_MCU_TRANSPORT_SDIO
                bool "SDIO Transport"

            config ESP_HOSTED_HOST_MCU_TRANSPORT_SPI_HD
                bool "SPI Half-Duplex Transport"

            config ESP_HOSTED_HOST_MCU_TRANSPORT_UART
                bool "UART Transport"

        endchoice

        config ESP_HOSTED_HOST_MCU_MAX_BUFFER_SIZE
            int "Maximum Buffer Size"
            default 1600
            range 512 4096
            help
                Maximum buffer size for transport operations

    endif # ESP_HOSTED_HOST_PLATFORM_MCU

endmenu
```

## host/csk_porting/esp-hosted/Kconfig
```kconfig
# SPDX-License-Identifier: Apache-2.0

menuconfig ESP_HOSTED
	bool "ESP-Hosted support"
	select PROTOBUF_C

if ESP_HOSTED

config HOSTED_INIT_TIMEOUT
	int "Hosted Init Timeout(s)"
	default 3

config HOSTED_TRANSACTION_STACK
	int "Hosted Transaction Thread Stack"
	default 2048

config HOSTED_TRANSACTION_PRIORITY
	int "Hosted Transaction Thread priority"
	default -1

config HOSTED_PROCESS_RX_STACK
	int "Hosted Processing Thread Stack"
	default 2048

config HOSTED_PROCESS_RX_PRIORITY
	int "Hosted Processing Thread priority"
	default -1

config HOSTED_TX_QUEUE_LEN
	int "Hosted TX Queue Len"
	default 30

config HOSTED_RX_QUEUE_LEN
	int "Hosted RX Queue Len"
	default 30

config HOSTED_SERIALIF_QUEUE_LEN
	int "Hosted Serial if queue len"
	default 50

config HOSTED_NETIF_QUEUE_LEN
	int "Hosted Net if queue len"
	default 50

endif # ESP_HOSTED
```

## modules/common/eh_common/Kconfig.ext
```kconfig
menu "Common config (Host & Coprocessor)"
	depends on ESP_HOSTED

	config ESP_HOSTED_COMMON_CHECKSUM_ENABLED
		bool "Enable packet checksum"
		default n
		default y if EH_TRANSPORT_CP_SDIO_CHECKSUM || EH_TRANSPORT_CP_SPI_CHECKSUM || EH_TRANSPORT_CP_SPI_HD_CHECKSUM || EH_TRANSPORT_CP_UART_CHECKSUM
		help
			Enable XOR checksum over packet header and payload.
			Must match the setting on the peer (host or coprocessor).

endmenu
```

## modules/common/eh_tlv/Kconfig.ext
```kconfig
# TLV group selection — hidden, auto-selected from RPC version.
# Sourced by coprocessor (and later host) parent Kconfig.
# No user-visible options.

config ESP_HOSTED_TLV_V1_LINUX
    bool
    default y if ESP_HOSTED_CP_RPC_V1_LINUX

config ESP_HOSTED_TLV_V1_MCU
    bool
    default y if ESP_HOSTED_CP_RPC_V1_MCU || ESP_HOSTED_CP_RPC_V2

config ESP_HOSTED_TLV_V2
    bool
    default y if ESP_HOSTED_CP_RPC_V2
```

## modules/coprocessor/Kconfig.ext
```kconfig
menu "Configure coprocessor"
	depends on ESP_HOSTED_CP

	# CP: Host type selection for coprocessor configuration
	choice ESP_HOSTED_CP_TYPE
		prompt "Which host this coprocessor connects to?"
		default ESP_HOSTED_CP_FOR_LINUX__802_03
		help
			Select the type of host that will communicate with this coprocessor.
			This affects GPIO pin assignments, queue sizes, and other configuration defaults.

		config ESP_HOSTED_CP_FOR_LINUX__802_03
			bool "Linux host based on 802.03 (RPC, Former name - FG)"

		config ESP_HOSTED_CP_FOR_LINUX__802_11
			bool "Linux host based on 802.11 (wpa_supplicant, Former name - NG)"

		config ESP_HOSTED_CP_FOR_MCU
			bool "MCU host"
	endchoice

	config ESP_HOSTED_CP_FOR_LINUX
		bool
		default y if ESP_HOSTED_CP_FOR_LINUX__802_03 || ESP_HOSTED_CP_FOR_LINUX__802_11

	choice ESP_HOST_DEV_BOARD
		depends on ESP_HOSTED_CP && (ESP_HOSTED_CP_FOR_MCU || ESP_HOSTED_CP_FOR_LINUX)
		prompt "Select for PCB Board (Optional)"
		default ESP_HOST_DEV_BOARD_NONE
		help
			Preconfigures GPIOs to use based on an ESP Development Board

		# Linux FG specific board configurations
		config ESP_ESP32C5_SPI_RASPI_MATING_BOARD
			bool "ESP32-C5 RaspPi Mating Board (SPI)"
			depends on ESP_HOSTED_CP_FOR_LINUX && IDF_TARGET_ESP32C5

		# MCU specific board configurations
		config ESP_HOST_DEV_BOARD_NONE
			bool "No specific PCB board"

		config ESP_HOST_DEV_BOARD_P4_FUNC_BOARD
			bool "ESP32-P4-Function-EV-Board"
			depends on ESP_HOSTED_CP_FOR_MCU && IDF_TARGET_ESP32C6

		config C2_C5_MODULE_SUB_BOARD
			bool "ESP32-P4 EV Sub-Board for C2 & C5"
			depends on ESP_HOSTED_CP_FOR_MCU && (IDF_TARGET_ESP32C2 || IDF_TARGET_ESP32C5)

	endchoice

	orsource "eh_cp_core/Kconfig.ext"
	orsource "eh_cp_transport/Kconfig.ext"

	# RPC support is its own top-level entry under coprocessor configuration.
	orsource "features/eh_cp_feat_rpc/Kconfig.ext"

	# TLV group selection (hidden, auto from RPC version)
	orsource "../common/eh_tlv/Kconfig.ext"

	menu "Features"
		orsource "features/eh_cp_feat_rpc_ext_linux/Kconfig.ext"
		orsource "features/eh_cp_feat_rpc_ext_mcu/Kconfig.ext"

		orsource "features/eh_cp_feat_wifi/Kconfig.ext"

		orsource "features/eh_cp_feat_bt/Kconfig.ext"
		orsource "features/eh_cp_feat_host_ps/Kconfig.ext"
		orsource "features/eh_cp_feat_system/Kconfig.ext"
		orsource "features/eh_cp_feat_nw_split/Kconfig.ext"
		orsource "features/eh_cp_feat_peer_data/Kconfig.ext"
		orsource "features/eh_cp_feat_gpio_exp/Kconfig.ext"
		orsource "features/eh_cp_feat_mem_monitor/Kconfig.ext"
		orsource "features/eh_cp_feat_ext_coex/Kconfig.ext"
		orsource "features/eh_cp_feat_light_sleep/Kconfig.ext"
		orsource "features/eh_cp_feat_cli/Kconfig.ext"
	endmenu

endmenu
```
